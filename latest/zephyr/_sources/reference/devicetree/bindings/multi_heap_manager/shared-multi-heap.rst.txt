## latest/zephyr/_sources/reference/devicetree/bindings/pinctrl/nxp,kinetis-pinctrl.rst.txt
```
:orphan:

.. raw:: html

    <!--
    FIXME: do not limit page width until content uses another representation
    format other than tables
    -->
    <style>.wy-nav-content { max-width: none; !important }</style>

.. dtcompatible:: nxp,kinetis-pinctrl
.. _dtbinding_nxp_kinetis_pinctrl:

nxp,kinetis-pinctrl
###################

Vendor: :ref:`NXP Semiconductors <dt_vendor_nxp>`

Description
***********



.. code-block:: none

   Kinetis pinctrl node. This node will define pin configurations in pin groups,
   and has the 'pinctrl' node identifier in the SOC's devicetree. Each group
   within the pin configuration defines the pin configuration for a peripheral,
   and each numbered subgroup in the pin group defines all the pins for that
   peripheral with the same configuration properties. The 'pins' property in
   a group selects the pins to be configured, and the remaining properties set
   configuration values for those pins. Here is an example group for UART0 pins:

   uart0_default: uart0_default {
     group0 {
       pins = <UART0_RX_PTB16
         UART0_TX_PTB17>;
       drive-strength = "low";
       slew-rate = "fast";
       };
   };

   If only the required properties are supplied, the pin configuration register
   will be assigned the following values:
   PCR_PS=0,
   PCR_PE=0,
   PCR_ODE=0,
   PCR_SRE=<slew-rate selection>,
   PCR_DSE=<drive-strength selection>,
   PCR_PFE=0

Properties
**********

Top level properties
====================


These property descriptions apply to "nxp,kinetis-pinctrl"
nodes themselves. This page also describes child node
properties in the following sections.

.. tabs::

   .. group-tab:: Node specific properties

      Properties not inherited from the base binding file.

      (None)

   .. group-tab:: Deprecated node specific properties

      Deprecated properties not inherited from the base binding file.

      (None)

   .. group-tab:: Base properties

      Properties inherited from the base binding file, which defines
      common properties that may be set on many nodes. Not all of these
      may apply to the "nxp,kinetis-pinctrl" compatible.

      .. list-table::
         :widths: 1 1 4
         :header-rows: 1

         * - Name
           - Type
           - Details

         * - ``status``
           - ``string``
           - .. code-block:: none

                indicates the operational status of a device


             Legal values: ``'ok'``, ``'okay'``, ``'disabled'``, ``'reserved'``, ``'fail'``, ``'fail-sss'``

             See :ref:`dt-important-props` for more information.

         * - ``compatible``
           - ``string-array``
           - .. code-block:: none

                compatible strings


             This property is **required**.

             See :ref:`dt-important-props` for more information.

         * - ``reg``
           - ``array``
           - .. code-block:: none

                register space


             See :ref:`dt-important-props` for more information.

         * - ``reg-names``
           - ``string-array``
           - .. code-block:: none

                name of each register space


         * - ``interrupts``
           - ``array``
           - .. code-block:: none

                interrupts for device


             See :ref:`dt-important-props` for more information.

         * - ``interrupts-extended``
           - ``compound``
           - .. code-block:: none

                extended interrupt specifier for device


         * - ``interrupt-names``
           - ``string-array``
           - .. code-block:: none

                name of each interrupt


         * - ``interrupt-parent``
           - ``phandle``
           - .. code-block:: none

                phandle to interrupt controller node


         * - ``label``
           - ``string``
           - .. code-block:: none

                Human readable string describing the device (used as device_get_binding() argument)


             See :ref:`dt-important-props` for more information.

         * - ``clocks``
           - ``phandle-array``
           - .. code-block:: none

                Clock gate information


         * - ``clock-names``
           - ``string-array``
           - .. code-block:: none

                name of each clock


         * - ``#address-cells``
           - ``int``
           - .. code-block:: none

                number of address cells in reg property


         * - ``#size-cells``
           - ``int``
           - .. code-block:: none

                number of size cells in reg property


         * - ``dmas``
           - ``phandle-array``
           - .. code-block:: none

                DMA channels specifiers


         * - ``dma-names``
           - ``string-array``
           - .. code-block:: none

                Provided names of DMA channel specifiers


         * - ``io-channels``
           - ``phandle-array``
           - .. code-block:: none

                IO channels specifiers


         * - ``io-channel-names``
           - ``string-array``
           - .. code-block:: none

                Provided names of IO channel specifiers


         * - ``mboxes``
           - ``phandle-array``
           - .. code-block:: none

                mailbox / IPM channels specifiers


         * - ``mbox-names``
           - ``string-array``
           - .. code-block:: none

                Provided names of mailbox / IPM channel specifiers


         * - ``wakeup-source``
           - ``boolean``
           - .. code-block:: none

                Property to identify that a device can be used as wake up source.

                When this property is provided a specific flag is set into the
                device that tells the system that the device is capable of
                wake up the system.

                Wake up capable devices are disabled (interruptions will not wake up
                the system) by default but they can be enabled at runtime if necessary.



         * - ``power-domain``
           - ``phandle``
           - .. code-block:: none


                Power domain the device belongs to.

                The device will be notified when the power domain it belongs to is either
                suspended or resumed.






Grandchild node properties
==========================

.. list-table::
   :widths: 1 1 4
   :header-rows: 1

   * - Name
     - Type
     - Details

   * - ``pinmux``
     - ``array``
     - .. code-block:: none

          Pin mux selections for this group. See the soc level pinctrl DTSI file
          in NXP's HAL for a defined list of these options



       This property is **required**.

   * - ``drive-strength``
     - ``string``
     - .. code-block:: none

          Pin output drive strength. Sets the DSE field in the PORTx_PCRn register.
          0 DSE_0- low drive strength when pin is configured as output
          1 DSE_1- high drive strength when pin is configured as output



       This property is **required**.

       Legal values: ``'low'``, ``'high'``

   * - ``slew-rate``
     - ``string``
     - .. code-block:: none

          Pin output slew rate. Sets the SRE field in the PORTx_PCRn register.
          0 SRE_0_slow- slow slew rate when pin is configured as output
          1 SRE_1_fast- fast slew rate when pin is configured as output



       This property is **required**.

       Legal values: ``'slow'``, ``'fast'``

   * - ``nxp,passive-filter``
     - ``boolean``
     - .. code-block:: none

          Enable passive filter on pin. Sets the PFE field in the PORTx_PCRn register.



   * - ``bias-pull-up``
     - ``boolean``
     - .. code-block:: none

          enable pull-up resistor


   * - ``bias-pull-down``
     - ``boolean``
     - .. code-block:: none

          enable pull-down resistor


   * - ``drive-open-drain``
     - ``boolean``
     - .. code-block:: none

          drive with open drain (hardware AND)
```
