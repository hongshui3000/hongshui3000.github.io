## latest/zephyr/_sources/reference/devicetree/bindings/pinctrl/telink,b91-pinctrl.rst.txt
```
:orphan:

.. raw:: html

    <!--
    FIXME: do not limit page width until content uses another representation
    format other than tables
    -->
    <style>.wy-nav-content { max-width: none; !important }</style>

.. dtcompatible:: telink,b91-pinctrl
.. _dtbinding_telink_b91_pinctrl:

telink,b91-pinctrl
##################

Vendor: :ref:`Telink Semiconductor <dt_vendor_telink>`

Description
***********



.. code-block:: none

   The Telink B91 pin controller is a singleton node responsible for
   controlling pin function selection and pin properties. For example, you can
   use this node to route UART0 TX to pin PB2 and enable the pull-up resistor
   on the pin.

   The node has the 'pinctrl' node label set in your SoC's devicetree,
   so you can modify it like this:

     &pinctrl {
             /* your modifications go here */
     };

   All device pin configurations should be placed in child nodes of the
   'pinctrl' node, as shown in this example:

     /* You can put this in places like a board-pinctrl.dtsi file in
      * your board directory, or a devicetree overlay in your application.
      */

     /* include pre-defined pins and functions for the SoC used by the board */
     #include <dt-bindings/pinctrl/b91-pinctrl.h>

     &pinctrl {
       /* configuration for UART0 TX default state */
       uart0_tx_pb2_default: uart0_tx_pb2_default {
         /* configure PB2 as B91_FUNC_C */
         pinmux = <B91_PINMUX_SET(B91_PORT_B, B91_PIN_2, B91_FUNC_C)>;
       };
       /* configuration for UART0 RX default state */
       uart0_rx_pb3_default: uart0_rx_pb3_default {
         /* configure PB2 as B91_FUNC_C */
         pinmux = <B91_PINMUX_SET(B91_PORT_B, B91_PIN_3, B91_FUNC_C)>;
       };
     };

   The 'uart0_tx_pb2_default' child node encodes the pin configurations
   for a particular state of a device; in this case, the default
   (that is, active) sate. You would specify the low-power configuration for
   the same device in a separate child node.

   A pin configuration can also specify pin properties such as the
   'bias-pull-up' property. Here is a list of supported standard pin
   properties:

   - bias-disable
   - bias-pull-down
   - bias-pull-up

   To link pin configurations with a device, use a pinctrl-N property for some
   number N, like this example you could place in your board's DTS file:

     #include "board-pinctrl.dtsi"

     &uart0 {
       pinctrl-0 = <&uart0_tx_pb2_default &uart0_rx_pb3_default>;
       pinctrl-1 = <&uart0_tx_pb2_sleep &uart0_rx_pb3_sleep>;
       pinctrl-names = "default", "sleep";
     };

Properties
**********

Top level properties
====================


These property descriptions apply to "telink,b91-pinctrl"
nodes themselves. This page also describes child node
properties in the following sections.

.. tabs::

   .. group-tab:: Node specific properties

      Properties not inherited from the base binding file.

      .. list-table::
         :widths: 1 1 4
         :header-rows: 1

         * - Name
           - Type
           - Details

         * - ``pad-mul-sel``
           - ``int``
           - .. code-block:: none

                PinMux pad_mul_sel register value. Pin functions depend on it.

                For instance:
                Function C of PB2 configs the pin to UART0_TX if pad_mul_sel is set to <1>.
                But, the same function configs the same pin to DAC_I_DAT2_I if pad_mul_sel is set to <0>.

                Refer to the Telink TLSR9 specs to get more information about pins configuration.



             This property is **required**.



   .. group-tab:: Deprecated node specific properties

      Deprecated properties not inherited from the base binding file.

      (None)

   .. group-tab:: Base properties

      Properties inherited from the base binding file, which defines
      common properties that may be set on many nodes. Not all of these
      may apply to the "telink,b91-pinctrl" compatible.

      .. list-table::
         :widths: 1 1 4
         :header-rows: 1

         * - Name
           - Type
           - Details

         * - ``reg``
           - ``array``
           - .. code-block:: none

                register space


             This property is **required**.

             See :ref:`dt-important-props` for more information.

         * - ``label``
           - ``string``
           - .. code-block:: none

                Human readable string describing the device (used as device_get_binding() argument)


             This property is **required**.

             See :ref:`dt-important-props` for more information.

         * - ``status``
           - ``string``
           - .. code-block:: none

                indicates the operational status of a device


             Legal values: ``'ok'``, ``'okay'``, ``'disabled'``, ``'reserved'``, ``'fail'``, ``'fail-sss'``

             See :ref:`dt-important-props` for more information.

         * - ``compatible``
           - ``string-array``
           - .. code-block:: none

                compatible strings


             This property is **required**.

             See :ref:`dt-important-props` for more information.

         * - ``reg-names``
           - ``string-array``
           - .. code-block:: none

                name of each register space


         * - ``interrupts``
           - ``array``
           - .. code-block:: none

                interrupts for device


             See :ref:`dt-important-props` for more information.

         * - ``interrupts-extended``
           - ``compound``
           - .. code-block:: none

                extended interrupt specifier for device


         * - ``interrupt-names``
           - ``string-array``
           - .. code-block:: none

                name of each interrupt


         * - ``interrupt-parent``
           - ``phandle``
           - .. code-block:: none

                phandle to interrupt controller node


         * - ``clocks``
           - ``phandle-array``
           - .. code-block:: none

                Clock gate information


         * - ``clock-names``
           - ``string-array``
           - .. code-block:: none

                name of each clock


         * - ``#address-cells``
           - ``int``
           - .. code-block:: none

                number of address cells in reg property


         * - ``#size-cells``
           - ``int``
           - .. code-block:: none

                number of size cells in reg property


         * - ``dmas``
           - ``phandle-array``
           - .. code-block:: none

                DMA channels specifiers


         * - ``dma-names``
           - ``string-array``
           - .. code-block:: none

                Provided names of DMA channel specifiers


         * - ``io-channels``
           - ``phandle-array``
           - .. code-block:: none

                IO channels specifiers


         * - ``io-channel-names``
           - ``string-array``
           - .. code-block:: none

                Provided names of IO channel specifiers


         * - ``mboxes``
           - ``phandle-array``
           - .. code-block:: none

                mailbox / IPM channels specifiers


         * - ``mbox-names``
           - ``string-array``
           - .. code-block:: none

                Provided names of mailbox / IPM channel specifiers


         * - ``wakeup-source``
           - ``boolean``
           - .. code-block:: none

                Property to identify that a device can be used as wake up source.

                When this property is provided a specific flag is set into the
                device that tells the system that the device is capable of
                wake up the system.

                Wake up capable devices are disabled (interruptions will not wake up
                the system) by default but they can be enabled at runtime if necessary.



         * - ``power-domain``
           - ``phandle``
           - .. code-block:: none


                Power domain the device belongs to.

                The device will be notified when the power domain it belongs to is either
                suspended or resumed.






Child node properties
=====================

.. list-table::
   :widths: 1 1 4
   :header-rows: 1

   * - Name
     - Type
     - Details

   * - ``pinmux``
     - ``int``
     - .. code-block:: none

          Telink B91 pin's configuration (port, pin and function).



       This property is **required**.

   * - ``bias-disable``
     - ``boolean``
     - .. code-block:: none

          disable any pin bias


   * - ``bias-pull-up``
     - ``boolean``
     - .. code-block:: none

          enable pull-up resistor


   * - ``bias-pull-down``
     - ``boolean``
     - .. code-block:: none

          enable pull-down resistor
```

## latest/zephyr/_sources/reference/devicetree/bindings/power/zephyr,power-state.rst.txt
```
:orphan:

.. raw:: html

    <!--
    FIXME: do not limit page width until content uses another representation
    format other than tables
    -->
    <style>.wy-nav-content { max-width: none; !important }</style>

.. dtcompatible:: zephyr,power-state
.. _dtbinding_zephyr_power_state:

zephyr,power-state
##################

Vendor: :ref:`Zephyr-specific binding <dt_vendor_zephyr>`

Description
***********



.. code-block:: none

   Properties for power management state

Properties
**********

.. tabs::

   .. group-tab:: Node specific properties

      Properties not inherited from the base binding file.

      .. list-table::
         :widths: 1 1 4
         :header-rows: 1

         * - Name
           - Type
           - Details

         * - ``power-state-name``
           - ``string``
           - .. code-block:: none

                indicates a power state


             This property is **required**.

             Legal values: ``'active'``, ``'runtime-idle'``, ``'suspend-to-idle'``, ``'standby'``, ``'suspend-to-ram'``, ``'suspend-to-disk'``, ``'soft-off'``

         * - ``substate-id``
           - ``int``
           - .. code-block:: none

                Platform specific identification.


         * - ``min-residency-us``
           - ``int``
           - .. code-block:: none

                Minimum residency duration in microseconds. It is the minimum time for a
                given idle state to be worthwhile energywise. It includes the time to enter
                in this state.



         * - ``exit-latency-us``
           - ``int``
           - .. code-block:: none

                Worst case latency in microseconds required to exit the idle state.





   .. group-tab:: Deprecated node specific properties

      Deprecated properties not inherited from the base binding file.

      (None)

   .. group-tab:: Base properties

      Properties inherited from the base binding file, which defines
      common properties that may be set on many nodes. Not all of these
      may apply to the "zephyr,power-state" compatible.

      (None)
```
