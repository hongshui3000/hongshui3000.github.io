## latest/zephyr/_sources/reference/devicetree/bindings/pinctrl/nordic,nrf-pinctrl.rst.txt
```
:orphan:

.. raw:: html

    <!--
    FIXME: do not limit page width until content uses another representation
    format other than tables
    -->
    <style>.wy-nav-content { max-width: none; !important }</style>

.. dtcompatible:: nordic,nrf-pinctrl
.. _dtbinding_nordic_nrf_pinctrl:

nordic,nrf-pinctrl
##################

Vendor: :ref:`Nordic Semiconductor <dt_vendor_nordic>`

Description
***********



.. code-block:: none

   The nRF pin controller is a singleton node responsible for controlling
   pin function selection and pin properties. For example, you can use this
   node to route UART0 RX to pin P0.1 and enable the pull-up resistor on the
   pin.

   The node has the 'pinctrl' node label set in your SoC's devicetree,
   so you can modify it like this:

     &pinctrl {
             /* your modifications go here */
     };

   All device pin configurations should be placed in child nodes of the
   'pinctrl' node, as shown in this example:

     /* You can put this in places like a board-pinctrl.dtsi file in
      * your board directory, or a devicetree overlay in your application.
      */
     &pinctrl {
       /* configuration for uart0 device, default state */
       uart0_default: uart0_default {
         /* group 1 ('group1' name is arbitrary) */
         group1 {
           /* configure P0.1 as UART_TX and P0.2 as UART_RTS */
           psels = <NRF_PSEL(UART_TX, 0, 1)>, <NRF_PSEL(UART_RTS, 0, 2)>;
         };
         /* group 2 */
         group2 {
           /* configure P0.3 as UART_RX and P0.4 as UART_CTS */
           psels = <NRF_PSEL(UART_RX, 0, 3)>, <NRF_PSEL(UART_CTS, 0, 4)>;
           /* both P0.3 and P0.4 are configured with pull-up */
           bias-pull-up;
         };
       };
     };

   The 'uart0_default' child node encodes the pin configurations for a
   particular state of a device; in this case, the default (that is, active)
   state. You would specify the low-power configuration for the same device
   in a separate child node.

   As shown, pin configurations are organized in groups within each child node.
   Each group can specify a list of pin function selections in the 'psels'
   property. The NRF_PSEL macro is used to specify a pin function selection.
   Available pin functions can be found in the
   include/dt-bindings/pinctrl/nrf-pinctrl.h header file.

   A group can also specify shared pin properties common to all the specified
   pins, such as the 'bias-pull-up' property in group 2. Here is a list of
   supported standard pin properties:

   - bias-disable: Disable pull-up/down (default behavior, not required).
   - bias-pull-up: Enable pull-up resistor.
   - bias-pull-down: Enable pull-down resistor.
   - low-power-enable: Configure pin as an input with input buffer
     disconnected.

   Note that bias options are mutually exclusive.

   To link this pin configuration with a device, use a pinctrl-N property
   for some number N, like this example you could place in your board's DTS
   file:

      #include "board-pinctrl.dtsi"

      &uart0 {
            pinctrl-0 = <&uart0_default>;
            pinctrl-names = "default";
      };

Properties
**********

Top level properties
====================


These property descriptions apply to "nordic,nrf-pinctrl"
nodes themselves. This page also describes child node
properties in the following sections.

.. tabs::

   .. group-tab:: Node specific properties

      Properties not inherited from the base binding file.

      (None)

   .. group-tab:: Deprecated node specific properties

      Deprecated properties not inherited from the base binding file.

      (None)

   .. group-tab:: Base properties

      Properties inherited from the base binding file, which defines
      common properties that may be set on many nodes. Not all of these
      may apply to the "nordic,nrf-pinctrl" compatible.

      .. list-table::
         :widths: 1 1 4
         :header-rows: 1

         * - Name
           - Type
           - Details

         * - ``status``
           - ``string``
           - .. code-block:: none

                indicates the operational status of a device


             Legal values: ``'ok'``, ``'okay'``, ``'disabled'``, ``'reserved'``, ``'fail'``, ``'fail-sss'``

             See :ref:`dt-important-props` for more information.

         * - ``compatible``
           - ``string-array``
           - .. code-block:: none

                compatible strings


             This property is **required**.

             See :ref:`dt-important-props` for more information.

         * - ``reg``
           - ``array``
           - .. code-block:: none

                register space


             See :ref:`dt-important-props` for more information.

         * - ``reg-names``
           - ``string-array``
           - .. code-block:: none

                name of each register space


         * - ``interrupts``
           - ``array``
           - .. code-block:: none

                interrupts for device


             See :ref:`dt-important-props` for more information.

         * - ``interrupts-extended``
           - ``compound``
           - .. code-block:: none

                extended interrupt specifier for device


         * - ``interrupt-names``
           - ``string-array``
           - .. code-block:: none

                name of each interrupt


         * - ``interrupt-parent``
           - ``phandle``
           - .. code-block:: none

                phandle to interrupt controller node


         * - ``label``
           - ``string``
           - .. code-block:: none

                Human readable string describing the device (used as device_get_binding() argument)


             See :ref:`dt-important-props` for more information.

         * - ``clocks``
           - ``phandle-array``
           - .. code-block:: none

                Clock gate information


         * - ``clock-names``
           - ``string-array``
           - .. code-block:: none

                name of each clock


         * - ``#address-cells``
           - ``int``
           - .. code-block:: none

                number of address cells in reg property


         * - ``#size-cells``
           - ``int``
           - .. code-block:: none

                number of size cells in reg property


         * - ``dmas``
           - ``phandle-array``
           - .. code-block:: none

                DMA channels specifiers


         * - ``dma-names``
           - ``string-array``
           - .. code-block:: none

                Provided names of DMA channel specifiers


         * - ``io-channels``
           - ``phandle-array``
           - .. code-block:: none

                IO channels specifiers


         * - ``io-channel-names``
           - ``string-array``
           - .. code-block:: none

                Provided names of IO channel specifiers


         * - ``mboxes``
           - ``phandle-array``
           - .. code-block:: none

                mailbox / IPM channels specifiers


         * - ``mbox-names``
           - ``string-array``
           - .. code-block:: none

                Provided names of mailbox / IPM channel specifiers


         * - ``wakeup-source``
           - ``boolean``
           - .. code-block:: none

                Property to identify that a device can be used as wake up source.

                When this property is provided a specific flag is set into the
                device that tells the system that the device is capable of
                wake up the system.

                Wake up capable devices are disabled (interruptions will not wake up
                the system) by default but they can be enabled at runtime if necessary.



         * - ``power-domain``
           - ``phandle``
           - .. code-block:: none


                Power domain the device belongs to.

                The device will be notified when the power domain it belongs to is either
                suspended or resumed.






Grandchild node properties
==========================

.. list-table::
   :widths: 1 1 4
   :header-rows: 1

   * - Name
     - Type
     - Details

   * - ``psels``
     - ``array``
     - .. code-block:: none

          An array of pins sharing the same group properties. The pins should
          be defined using the NRF_PSEL utility macro that encodes the port,
          pin and function.



       This property is **required**.

   * - ``drive-mode``
     - ``int``
     - .. code-block:: none

          Pin output drive mode. Available drive modes are pre-defined in
          nrf-pinctrl.h. Note that extra modes may not be available on certain
          devices. Defaults to standard mode for 0 and 1 (NRF_DRIVE_S0S1), the
          SoC default.



   * - ``bias-disable``
     - ``boolean``
     - .. code-block:: none

          disable any pin bias


   * - ``bias-pull-up``
     - ``boolean``
     - .. code-block:: none

          enable pull-up resistor


   * - ``bias-pull-down``
     - ``boolean``
     - .. code-block:: none

          enable pull-down resistor


   * - ``low-power-enable``
     - ``boolean``
     - .. code-block:: none

          enable low power mode
```

## latest/zephyr/_sources/reference/devicetree/bindings/pinctrl/nuvoton,npcx-pslctrl-conf.rst.txt
```
:orphan:

.. raw:: html

    <!--
    FIXME: do not limit page width until content uses another representation
    format other than tables
    -->
    <style>.wy-nav-content { max-width: none; !important }</style>

.. dtcompatible:: nuvoton,npcx-pslctrl-conf
.. _dtbinding_nuvoton_npcx_pslctrl_conf:

nuvoton,npcx-pslctrl-conf
#########################

Vendor: :ref:`Nuvoton Technology Corporation <dt_vendor_nuvoton>`

Description
***********



.. code-block:: none

   Nuvoton NPCX pads configuration map between Pin Mux controller and
   Power Switch Logic (PSL) controller driver instances.

Properties
**********

Top level properties
====================

No top-level properties.

Child node properties
=====================

.. list-table::
   :widths: 1 1 4
   :header-rows: 1

   * - Name
     - Type
     - Details

   * - ``offset``
     - ``int``
     - .. code-block:: none

          Offset in PSL_CTS for status and detection mode.


       This property is **required**.

   * - ``pinctrl-0``
     - ``phandles``
     - .. code-block:: none

          Pinmux controller configuration for PSL io pads.


       This property is **required**.

   * - ``polarity-0``
     - ``phandles``
     - .. code-block:: none

          Active polarity configuration for PSL io pads.


       This property is **required**.

   * - ``flag``
     - ``int``
     - .. code-block:: none

          Detection mode and type for wake-up event detection.
          5 = Configures PSL input in detecting rising edge.
          6 = Configures PSL input in in detecting level high state.
          9 = Configures PSL input in detecting falling edge.
          10 = Configures PSL input in detecting level low state.



       Legal values: ``5``, ``6``, ``9``, ``10``
```
