## latest/zephyr/_sources/reference/devicetree/bindings/pinctrl/renesas,rcar-pfc.rst.txt
```
:orphan:

.. raw:: html

    <!--
    FIXME: do not limit page width until content uses another representation
    format other than tables
    -->
    <style>.wy-nav-content { max-width: none; !important }</style>

.. dtcompatible:: renesas,rcar-pfc
.. _dtbinding_renesas_rcar_pfc:

renesas,rcar-pfc
################

Vendor: :ref:`Renesas Electronics Corporation <dt_vendor_renesas>`

Description
***********



.. code-block:: none

   Renesas R-Car Pin Function Controller node
   This binding gives a base representation of the R-Car pins configuration.
   The R-Car pin controller is a singleton node responsible for controlling
   pin function selection and pin properties. For example, you can use this
   node to route CAN0 TX A to pin 'RD', and enable pull-up resistor as well
   as driving ability.

   The node has the 'pfc' node label set in your SoC's devicetree, so you can
   modify it like this:

   &pfc {
        /* your modifications go here */
   };

   All device pin configurations should be placed in child nodes of the
   'pfc' node, as shown in this example:
     /* You can put this in places like a board-pinctrl.dtsi file in
      * your board directory, or a devicetree overlay in your application.
      */

     /* include pre-defined pins and functions for the SoC used by the board */
     #include <dt-bindings/pinctrl/renesas/pinctrl-r8a77951.h>

     &pfc {
       /* configuration for can0 data a tx default state */
       can0_data_a_tx_default: can0_data_a_tx_default {
         /* configure PIN_RD as FUNC_CAN0_TX_A */
         pin = <PIN_RD FUNC_CAN0_TX_A>;
       };
       /* configuration for can0 data a rx default state */
       can0_data_a_rx_default: can0_data_a_rx_default {
         /* configure PIN_RD_WR as FUNC_CAN0_RX_A */
         pin = <PIN_RD_WR FUNC_CAN0_RX_A>;
       };
     };

   The 'can0_data_a_tx_default' child node encodes the pin configurations
   for a particular state of a device; in this case, the default
   (that is, active) sate. You would specify the low-power configuration for
   the same device in a separate child node.

   A pin configuration can also specify pin properties such as the
   'bias-pull-up' property. Here is a list of supported standard pin
   properties:

   - bias-disable
   - bias-pull-down
   - bias-pull-up
   - drive-strength

   To link pin configurations with a device, use a pinctrl-N property for some
   number N, like this example you could place in your board's DTS file:

     #include "board-pinctrl.dtsi"

     &can0 {
       pinctrl-0 = <&can0_data_a_tx_default &can0_data_a_rx_default>;
       pinctrl-1 = <&can0_data_a_tx_sleep &can0_data_a_rx_sleep>;
       pinctrl-names = "default", "sleep";
     };

Properties
**********

Top level properties
====================


These property descriptions apply to "renesas,rcar-pfc"
nodes themselves. This page also describes child node
properties in the following sections.

.. tabs::

   .. group-tab:: Node specific properties

      Properties not inherited from the base binding file.

      (None)

   .. group-tab:: Deprecated node specific properties

      Deprecated properties not inherited from the base binding file.

      (None)

   .. group-tab:: Base properties

      Properties inherited from the base binding file, which defines
      common properties that may be set on many nodes. Not all of these
      may apply to the "renesas,rcar-pfc" compatible.

      .. list-table::
         :widths: 1 1 4
         :header-rows: 1

         * - Name
           - Type
           - Details

         * - ``reg``
           - ``array``
           - .. code-block:: none

                register space


             This property is **required**.

             See :ref:`dt-important-props` for more information.

         * - ``status``
           - ``string``
           - .. code-block:: none

                indicates the operational status of a device


             Legal values: ``'ok'``, ``'okay'``, ``'disabled'``, ``'reserved'``, ``'fail'``, ``'fail-sss'``

             See :ref:`dt-important-props` for more information.

         * - ``compatible``
           - ``string-array``
           - .. code-block:: none

                compatible strings


             This property is **required**.

             See :ref:`dt-important-props` for more information.

         * - ``reg-names``
           - ``string-array``
           - .. code-block:: none

                name of each register space


         * - ``interrupts``
           - ``array``
           - .. code-block:: none

                interrupts for device


             See :ref:`dt-important-props` for more information.

         * - ``interrupts-extended``
           - ``compound``
           - .. code-block:: none

                extended interrupt specifier for device


         * - ``interrupt-names``
           - ``string-array``
           - .. code-block:: none

                name of each interrupt


         * - ``interrupt-parent``
           - ``phandle``
           - .. code-block:: none

                phandle to interrupt controller node


         * - ``label``
           - ``string``
           - .. code-block:: none

                Human readable string describing the device (used as device_get_binding() argument)


             See :ref:`dt-important-props` for more information.

         * - ``clocks``
           - ``phandle-array``
           - .. code-block:: none

                Clock gate information


         * - ``clock-names``
           - ``string-array``
           - .. code-block:: none

                name of each clock


         * - ``#address-cells``
           - ``int``
           - .. code-block:: none

                number of address cells in reg property


         * - ``#size-cells``
           - ``int``
           - .. code-block:: none

                number of size cells in reg property


         * - ``dmas``
           - ``phandle-array``
           - .. code-block:: none

                DMA channels specifiers


         * - ``dma-names``
           - ``string-array``
           - .. code-block:: none

                Provided names of DMA channel specifiers


         * - ``io-channels``
           - ``phandle-array``
           - .. code-block:: none

                IO channels specifiers


         * - ``io-channel-names``
           - ``string-array``
           - .. code-block:: none

                Provided names of IO channel specifiers


         * - ``mboxes``
           - ``phandle-array``
           - .. code-block:: none

                mailbox / IPM channels specifiers


         * - ``mbox-names``
           - ``string-array``
           - .. code-block:: none

                Provided names of mailbox / IPM channel specifiers


         * - ``wakeup-source``
           - ``boolean``
           - .. code-block:: none

                Property to identify that a device can be used as wake up source.

                When this property is provided a specific flag is set into the
                device that tells the system that the device is capable of
                wake up the system.

                Wake up capable devices are disabled (interruptions will not wake up
                the system) by default but they can be enabled at runtime if necessary.



         * - ``power-domain``
           - ``phandle``
           - .. code-block:: none


                Power domain the device belongs to.

                The device will be notified when the power domain it belongs to is either
                suspended or resumed.






Child node properties
=====================

.. list-table::
   :widths: 1 1 4
   :header-rows: 1

   * - Name
     - Type
     - Details

   * - ``pin``
     - ``array``
     - .. code-block:: none

          The array is expected to have up to two elements. The first element is
          the pin the second optional element is the pin function.



       This property is **required**.

   * - ``drive-strength``
     - ``int``
     - .. code-block:: none

          maximum sink or source current in mA


       Legal values: ``3``, ``6``, ``9``, ``12``, ``15``, ``18``, ``21``, ``24``

   * - ``bias-disable``
     - ``boolean``
     - .. code-block:: none

          disable any pin bias


   * - ``bias-pull-up``
     - ``boolean``
     - .. code-block:: none

          enable pull-up resistor


   * - ``bias-pull-down``
     - ``boolean``
     - .. code-block:: none

          enable pull-down resistor
```
