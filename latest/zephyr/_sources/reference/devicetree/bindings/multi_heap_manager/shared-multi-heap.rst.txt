## latest/zephyr/_sources/reference/devicetree/bindings/pinctrl/raspberrypi,pico-pinctrl.rst.txt
```
:orphan:

.. raw:: html

    <!--
    FIXME: do not limit page width until content uses another representation
    format other than tables
    -->
    <style>.wy-nav-content { max-width: none; !important }</style>

.. dtcompatible:: raspberrypi,pico-pinctrl
.. _dtbinding_raspberrypi_pico_pinctrl:

raspberrypi,pico-pinctrl
########################

Vendor: :ref:`Raspberry Pi Foundation <dt_vendor_raspberrypi>`

Description
***********



.. code-block:: none

   The RPi Pico pin controller is a node responsible for controlling
   pin function selection and pin properties, such as routing a UART0 Rx
   to pin 1 and enabling the pullup resistor on that pin.

   The node has the 'pinctrl' node label set in your SoC's devicetree,
   so you can modify it like this:

     &pinctrl {
             /* your modifications go here */
     };

   All device pin configurations should be placed in child nodes of the
   'pinctrl' node, as shown in this example:

     /* You can put this in places like a board-pinctrl.dtsi file in
      * your board directory, or a devicetree overlay in your application.
      */

     /* include pre-defined combinations for the SoC variant used by the board */
     #include <dt-bindings/pinctrl/rpi-pico-rp2040-pinctrl.h>

     &pinctrl {
       /* configuration for the usart0 "default" state */
       uart0_default: uart0_default {
         /* group 1 */
         group1 {
           /* configure P0 as UART0 TX */
           pinmux = <UART0_TX_P0>;
         };
         /* group 2 */
         group2 {
           /* configure P1 as UART0 RX */
           pinmux = <UART0_RX_P1>;
           /* enable input on pin 1 */
           input-enable;
         };
       };
     };

   The 'uart0_default' child node encodes the pin configurations for a
   particular state of a device; in this case, the default (that is, active)
   state.

   As shown, pin configurations are organized in groups within each child node.
   Each group can specify a list of pin function selections in the 'pinmux'
   property.

   A group can also specify shared pin properties common to all the specified
   pins, such as the 'input-enable' property in group 2. Here is a list of
   supported standard pin properties:

   - bias-disable: Disable pull-up/down (default, not required).
   - bias-pull-up: Enable pull-up resistor.
   - bias-pull-down: Enable pull-down resistor.
   - input-enable: Enable input from the pin.
   - input-schmitt-enable: Enable input hysteresys.
   - drive-strength: Set the drive strength of the pin, in milliamps. Possible
     values are: 2, 4, 8, 12 (default: 4mA)
   - slew-rate: If set to 0, slew rate is set to slow. If set to 1, it is set
     to fast.

   To link pin configurations with a device, use a pinctrl-N property for some
   number N, like this example you could place in your board's DTS file:

      #include "board-pinctrl.dtsi"

      &uart0 {
            pinctrl-0 = <&uart0_default>;
            pinctrl-1 = <&uart0_sleep>;
            pinctrl-names = "default", "sleep";
      };

Properties
**********

Top level properties
====================


These property descriptions apply to "raspberrypi,pico-pinctrl"
nodes themselves. This page also describes child node
properties in the following sections.

.. tabs::

   .. group-tab:: Node specific properties

      Properties not inherited from the base binding file.

      (None)

   .. group-tab:: Deprecated node specific properties

      Deprecated properties not inherited from the base binding file.

      (None)

   .. group-tab:: Base properties

      Properties inherited from the base binding file, which defines
      common properties that may be set on many nodes. Not all of these
      may apply to the "raspberrypi,pico-pinctrl" compatible.

      .. list-table::
         :widths: 1 1 4
         :header-rows: 1

         * - Name
           - Type
           - Details

         * - ``status``
           - ``string``
           - .. code-block:: none

                indicates the operational status of a device


             Legal values: ``'ok'``, ``'okay'``, ``'disabled'``, ``'reserved'``, ``'fail'``, ``'fail-sss'``

             See :ref:`dt-important-props` for more information.

         * - ``compatible``
           - ``string-array``
           - .. code-block:: none

                compatible strings


             This property is **required**.

             See :ref:`dt-important-props` for more information.

         * - ``reg``
           - ``array``
           - .. code-block:: none

                register space


             See :ref:`dt-important-props` for more information.

         * - ``reg-names``
           - ``string-array``
           - .. code-block:: none

                name of each register space


         * - ``interrupts``
           - ``array``
           - .. code-block:: none

                interrupts for device


             See :ref:`dt-important-props` for more information.

         * - ``interrupts-extended``
           - ``compound``
           - .. code-block:: none

                extended interrupt specifier for device


         * - ``interrupt-names``
           - ``string-array``
           - .. code-block:: none

                name of each interrupt


         * - ``interrupt-parent``
           - ``phandle``
           - .. code-block:: none

                phandle to interrupt controller node


         * - ``label``
           - ``string``
           - .. code-block:: none

                Human readable string describing the device (used as device_get_binding() argument)


             See :ref:`dt-important-props` for more information.

         * - ``clocks``
           - ``phandle-array``
           - .. code-block:: none

                Clock gate information


         * - ``clock-names``
           - ``string-array``
           - .. code-block:: none

                name of each clock


         * - ``#address-cells``
           - ``int``
           - .. code-block:: none

                number of address cells in reg property


         * - ``#size-cells``
           - ``int``
           - .. code-block:: none

                number of size cells in reg property


         * - ``dmas``
           - ``phandle-array``
           - .. code-block:: none

                DMA channels specifiers


         * - ``dma-names``
           - ``string-array``
           - .. code-block:: none

                Provided names of DMA channel specifiers


         * - ``io-channels``
           - ``phandle-array``
           - .. code-block:: none

                IO channels specifiers


         * - ``io-channel-names``
           - ``string-array``
           - .. code-block:: none

                Provided names of IO channel specifiers


         * - ``mboxes``
           - ``phandle-array``
           - .. code-block:: none

                mailbox / IPM channels specifiers


         * - ``mbox-names``
           - ``string-array``
           - .. code-block:: none

                Provided names of mailbox / IPM channel specifiers


         * - ``wakeup-source``
           - ``boolean``
           - .. code-block:: none

                Property to identify that a device can be used as wake up source.

                When this property is provided a specific flag is set into the
                device that tells the system that the device is capable of
                wake up the system.

                Wake up capable devices are disabled (interruptions will not wake up
                the system) by default but they can be enabled at runtime if necessary.



         * - ``power-domain``
           - ``phandle``
           - .. code-block:: none


                Power domain the device belongs to.

                The device will be notified when the power domain it belongs to is either
                suspended or resumed.






Grandchild node properties
==========================

.. list-table::
   :widths: 1 1 4
   :header-rows: 1

   * - Name
     - Type
     - Details

   * - ``pinmux``
     - ``array``
     - .. code-block:: none

          An array of pins sharing the same group properties. Each
          element of the array is an integer constructed from the
          pin number and the alternative function of the pin.



       This property is **required**.

   * - ``drive-strength``
     - ``int``
     - .. code-block:: none

          The drive strength of a pin, in mA. The default value is 4mA, as this
          is the power on reset value.



       Default value: ``4``

       Legal values: ``2``, ``4``, ``8``, ``12``

   * - ``slew-rate``
     - ``int``
     - .. code-block:: none

          The slew rate of a pin. 0 corresponds to slow, and 1 corresponds to fast.
          The default value is 0 (slow), as this is the power on reset value.



       Legal values: ``0``, ``1``

   * - ``bias-disable``
     - ``boolean``
     - .. code-block:: none

          disable any pin bias


   * - ``bias-pull-up``
     - ``boolean``
     - .. code-block:: none

          enable pull-up resistor


   * - ``bias-pull-down``
     - ``boolean``
     - .. code-block:: none

          enable pull-down resistor


   * - ``input-enable``
     - ``boolean``
     - .. code-block:: none

          enable input on pin (no effect on output, such as enabling an input
          buffer)



   * - ``input-schmitt-enable``
     - ``boolean``
     - .. code-block:: none

          enable schmitt-trigger mode
```
