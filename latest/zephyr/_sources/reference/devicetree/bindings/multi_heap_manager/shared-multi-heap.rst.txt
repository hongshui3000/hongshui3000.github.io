## latest/zephyr/_sources/reference/devicetree/bindings/pinctrl/st,stm32-pinctrl.rst.txt
```
:orphan:

.. raw:: html

    <!--
    FIXME: do not limit page width until content uses another representation
    format other than tables
    -->
    <style>.wy-nav-content { max-width: none; !important }</style>

.. dtcompatible:: st,stm32-pinctrl
.. _dtbinding_st_stm32_pinctrl:

st,stm32-pinctrl
################

Vendor: :ref:`STMicroelectronics <dt_vendor_st>`

Description
***********



.. code-block:: none

   STM32 Pin controller Node
   Based on pincfg-node.yaml binding.

   Note: `bias-disable` and `drive-push-pull` are default pin configurations.
          They will be applied in case no `bias-foo` or `driver-bar` properties
          are set.

Properties
**********

Top level properties
====================


These property descriptions apply to "st,stm32-pinctrl"
nodes themselves. This page also describes child node
properties in the following sections.

.. tabs::

   .. group-tab:: Node specific properties

      Properties not inherited from the base binding file.

      .. list-table::
         :widths: 1 1 4
         :header-rows: 1

         * - Name
           - Type
           - Details

         * - ``remap-pa11``
           - ``boolean``
           - .. code-block:: none

                Remaps the PA11 pin to operate as PA9 pin. Use of this property is restricted to STM32G0 SoCs.


         * - ``remap-pa12``
           - ``boolean``
           - .. code-block:: none

                Remaps the PA12 pin to operate as PA10 pin. Use of this property is restricted to STM32G0 SoCs.


         * - ``remap-pa11-pa12``
           - ``boolean``
           - .. code-block:: none

                Remaps the PA11/PA12 pin to operate as PA9/PA10 pin. Use of this property is restricted to STM32F070x SoCs.




   .. group-tab:: Deprecated node specific properties

      Deprecated properties not inherited from the base binding file.

      (None)

   .. group-tab:: Base properties

      Properties inherited from the base binding file, which defines
      common properties that may be set on many nodes. Not all of these
      may apply to the "st,stm32-pinctrl" compatible.

      .. list-table::
         :widths: 1 1 4
         :header-rows: 1

         * - Name
           - Type
           - Details

         * - ``reg``
           - ``array``
           - .. code-block:: none

                register space


             This property is **required**.

             See :ref:`dt-important-props` for more information.

         * - ``status``
           - ``string``
           - .. code-block:: none

                indicates the operational status of a device


             Legal values: ``'ok'``, ``'okay'``, ``'disabled'``, ``'reserved'``, ``'fail'``, ``'fail-sss'``

             See :ref:`dt-important-props` for more information.

         * - ``compatible``
           - ``string-array``
           - .. code-block:: none

                compatible strings


             This property is **required**.

             See :ref:`dt-important-props` for more information.

         * - ``reg-names``
           - ``string-array``
           - .. code-block:: none

                name of each register space


         * - ``interrupts``
           - ``array``
           - .. code-block:: none

                interrupts for device


             See :ref:`dt-important-props` for more information.

         * - ``interrupts-extended``
           - ``compound``
           - .. code-block:: none

                extended interrupt specifier for device


         * - ``interrupt-names``
           - ``string-array``
           - .. code-block:: none

                name of each interrupt


         * - ``interrupt-parent``
           - ``phandle``
           - .. code-block:: none

                phandle to interrupt controller node


         * - ``label``
           - ``string``
           - .. code-block:: none

                Human readable string describing the device (used as device_get_binding() argument)


             See :ref:`dt-important-props` for more information.

         * - ``clocks``
           - ``phandle-array``
           - .. code-block:: none

                Clock gate information


         * - ``clock-names``
           - ``string-array``
           - .. code-block:: none

                name of each clock


         * - ``#address-cells``
           - ``int``
           - .. code-block:: none

                number of address cells in reg property


         * - ``#size-cells``
           - ``int``
           - .. code-block:: none

                number of size cells in reg property


         * - ``dmas``
           - ``phandle-array``
           - .. code-block:: none

                DMA channels specifiers


         * - ``dma-names``
           - ``string-array``
           - .. code-block:: none

                Provided names of DMA channel specifiers


         * - ``io-channels``
           - ``phandle-array``
           - .. code-block:: none

                IO channels specifiers


         * - ``io-channel-names``
           - ``string-array``
           - .. code-block:: none

                Provided names of IO channel specifiers


         * - ``mboxes``
           - ``phandle-array``
           - .. code-block:: none

                mailbox / IPM channels specifiers


         * - ``mbox-names``
           - ``string-array``
           - .. code-block:: none

                Provided names of mailbox / IPM channel specifiers


         * - ``wakeup-source``
           - ``boolean``
           - .. code-block:: none

                Property to identify that a device can be used as wake up source.

                When this property is provided a specific flag is set into the
                device that tells the system that the device is capable of
                wake up the system.

                Wake up capable devices are disabled (interruptions will not wake up
                the system) by default but they can be enabled at runtime if necessary.



         * - ``power-domain``
           - ``phandle``
           - .. code-block:: none


                Power domain the device belongs to.

                The device will be notified when the power domain it belongs to is either
                suspended or resumed.






Child node properties
=====================

.. list-table::
   :widths: 1 1 4
   :header-rows: 1

   * - Name
     - Type
     - Details

   * - ``pinmux``
     - ``int``
     - .. code-block:: none

          Reused from https://github.com/torvalds/linux/blob/master/Documentation/devicetree/bindings/pinctrl/st,stm32-pinctrl.yaml
          Integer array, represents gpio pin number and mux setting.
          These defines are calculated as: ((port * 16 + line) << 8) | function
          With:
          - port: The gpio port index (PA = 0, PB = 1, ..., PK = 11)
          - line: The line offset within the port (PA0 = 0, PA1 = 1, ..., PA15 = 15)
          - function: The function number, can be:
          * 0 : Alternate Function 0
          * 1 : Alternate Function 1
          * 2 : Alternate Function 2
          * ...
          * 15 : Alternate Function 15
          * 16 : Analog
          To simplify the usage, macro is available to generate "pinmux" field.
          This macro is available here:
            -include/dt-bindings/pinctrl/stm32-pinctrl-common.h
          Some examples of macro usage:
             GPIO A9 set as alernate function 2
          ... {
                   pinmux = <STM32_PINMUX('A', 9, AF2)>;
          };
             GPIO A9 set as analog
          ... {
                   pinmux = <STM32_PINMUX('A', 9, ANALOG)>;
          };



       This property is **required**.

   * - ``slew-rate``
     - ``string``
     - .. code-block:: none

          Pin speed. Default to low-speed. For few pins (PA11 and
          PB3 depending on SoCs)hardware reset value could differ
          (very-high-speed). Carefully check reference manual for these pins.



       Default value: ``low-speed``

       Legal values: ``'low-speed'``, ``'medium-speed'``, ``'high-speed'``, ``'very-high-speed'``

   * - ``bias-disable``
     - ``boolean``
     - .. code-block:: none

          disable any pin bias


   * - ``bias-pull-up``
     - ``boolean``
     - .. code-block:: none

          enable pull-up resistor


   * - ``bias-pull-down``
     - ``boolean``
     - .. code-block:: none

          enable pull-down resistor


   * - ``drive-push-pull``
     - ``boolean``
     - .. code-block:: none

          drive actively high and low


   * - ``drive-open-drain``
     - ``boolean``
     - .. code-block:: none

          drive with open drain (hardware AND)
```
