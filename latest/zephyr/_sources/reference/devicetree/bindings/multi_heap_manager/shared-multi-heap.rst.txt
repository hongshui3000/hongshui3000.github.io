## latest/zephyr/_sources/reference/devicetree/bindings/qspi/st,stm32-qspi.rst.txt
```
:orphan:

.. raw:: html

    <!--
    FIXME: do not limit page width until content uses another representation
    format other than tables
    -->
    <style>.wy-nav-content { max-width: none; !important }</style>

.. dtcompatible:: st,stm32-qspi
.. _dtbinding_st_stm32_qspi:

st,stm32-qspi
#############

Vendor: :ref:`STMicroelectronics <dt_vendor_st>`

Description
***********

These nodes are "qspi" bus nodes.

.. code-block:: none

   STM32 QSPI device representation. A stm32 quadspi node would typically
   looks to this:

       &quadspi {
           pinctrl-0 = <&quadspi_clk_pe10 &quadspi_ncs_pe11
                        &quadspi_bk1_io0_pe12 &quadspi_bk1_io1_pe13
                        &quadspi_bk1_io2_pe14 &quadspi_bk1_io3_pe15>;

           dmas = <&dma1 5 5 0x0000 0x03>;
           dma-names = "tx_rx";

           status = "okay";
       };

Properties
**********

.. tabs::

   .. group-tab:: Node specific properties

      Properties not inherited from the base binding file.

      .. list-table::
         :widths: 1 1 4
         :header-rows: 1

         * - Name
           - Type
           - Details

         * - ``pinctrl-0``
           - ``phandles``
           - .. code-block:: none

                Pin configuration/s for the first state. Content is specific to the
                selected pin controller driver implementation.



             This property is **required**.

         * - ``pinctrl-names``
           - ``string-array``
           - .. code-block:: none

                Names for the provided states. The number of names needs to match the
                number of states.



             This property is **required**.

         * - ``flash-id``
           - ``int``
           - .. code-block:: none

                FLash ID number. This number, if defined, helps to select the right
                QSPI GPIO banks (defined as 'quadspi_bk[12]' in pinctrl property)
                to communicate with flash memory.

                For example
                   flash-id = <2>;



         * - ``pinctrl-1``
           - ``phandles``
           - .. code-block:: none

                Pin configuration/s for the second state. See pinctrl-0.



         * - ``pinctrl-2``
           - ``phandles``
           - .. code-block:: none

                Pin configuration/s for the third state. See pinctrl-0.



         * - ``pinctrl-3``
           - ``phandles``
           - .. code-block:: none

                Pin configuration/s for the fourth state. See pinctrl-0.



         * - ``pinctrl-4``
           - ``phandles``
           - .. code-block:: none

                Pin configuration/s for the fifth state. See pinctrl-0.





   .. group-tab:: Deprecated node specific properties

      Deprecated properties not inherited from the base binding file.

      (None)

   .. group-tab:: Base properties

      Properties inherited from the base binding file, which defines
      common properties that may be set on many nodes. Not all of these
      may apply to the "st,stm32-qspi" compatible.

      .. list-table::
         :widths: 1 1 4
         :header-rows: 1

         * - Name
           - Type
           - Details

         * - ``reg``
           - ``array``
           - .. code-block:: none

                register space


             This property is **required**.

             See :ref:`dt-important-props` for more information.

         * - ``interrupts``
           - ``array``
           - .. code-block:: none

                interrupts for device


             This property is **required**.

             See :ref:`dt-important-props` for more information.

         * - ``dmas``
           - ``phandle-array``
           - .. code-block:: none

                Optional DMA channel specifier. If DMA should be used, specifier should
                hold a phandle reference to the dma controller, the channel number,
                the slot number, channel configuration and finally features.

                For example dmas for TX/RX on QSPI
                   dmas = <&dma1 5 5 0x0000 0x03>;



         * - ``dma-names``
           - ``string-array``
           - .. code-block:: none

                DMA channel name. If DMA should be used, expected value is "tx_rx".

                For example
                   dma-names = "tx_rx";



         * - ``status``
           - ``string``
           - .. code-block:: none

                indicates the operational status of a device


             Legal values: ``'ok'``, ``'okay'``, ``'disabled'``, ``'reserved'``, ``'fail'``, ``'fail-sss'``

             See :ref:`dt-important-props` for more information.

         * - ``compatible``
           - ``string-array``
           - .. code-block:: none

                compatible strings


             This property is **required**.

             See :ref:`dt-important-props` for more information.

         * - ``reg-names``
           - ``string-array``
           - .. code-block:: none

                name of each register space


         * - ``interrupts-extended``
           - ``compound``
           - .. code-block:: none

                extended interrupt specifier for device


         * - ``interrupt-names``
           - ``string-array``
           - .. code-block:: none

                name of each interrupt


         * - ``interrupt-parent``
           - ``phandle``
           - .. code-block:: none

                phandle to interrupt controller node


         * - ``label``
           - ``string``
           - .. code-block:: none

                Human readable string describing the device (used as device_get_binding() argument)


             See :ref:`dt-important-props` for more information.

         * - ``clocks``
           - ``phandle-array``
           - .. code-block:: none

                Clock gate information


         * - ``clock-names``
           - ``string-array``
           - .. code-block:: none

                name of each clock


         * - ``#address-cells``
           - ``int``
           - .. code-block:: none

                number of address cells in reg property


         * - ``#size-cells``
           - ``int``
           - .. code-block:: none

                number of size cells in reg property


         * - ``io-channels``
           - ``phandle-array``
           - .. code-block:: none

                IO channels specifiers


         * - ``io-channel-names``
           - ``string-array``
           - .. code-block:: none

                Provided names of IO channel specifiers


         * - ``mboxes``
           - ``phandle-array``
           - .. code-block:: none

                mailbox / IPM channels specifiers


         * - ``mbox-names``
           - ``string-array``
           - .. code-block:: none

                Provided names of mailbox / IPM channel specifiers


         * - ``wakeup-source``
           - ``boolean``
           - .. code-block:: none

                Property to identify that a device can be used as wake up source.

                When this property is provided a specific flag is set into the
                device that tells the system that the device is capable of
                wake up the system.

                Wake up capable devices are disabled (interruptions will not wake up
                the system) by default but they can be enabled at runtime if necessary.



         * - ``power-domain``
           - ``phandle``
           - .. code-block:: none


                Power domain the device belongs to.

                The device will be notified when the power domain it belongs to is either
                suspended or resumed.
```

## latest/zephyr/_sources/reference/devicetree/bindings/regulator/regulator-fixed.rst.txt
```
:orphan:

.. raw:: html

    <!--
    FIXME: do not limit page width until content uses another representation
    format other than tables
    -->
    <style>.wy-nav-content { max-width: none; !important }</style>

.. dtcompatible:: regulator-fixed
.. _dtbinding_regulator_fixed:

regulator-fixed
###############

Vendor: :ref:`Generic or vendor-independent <dt_no_vendor>`

Description
***********



.. code-block:: none

   GPIO-controlled regulators

Properties
**********

.. tabs::

   .. group-tab:: Node specific properties

      Properties not inherited from the base binding file.

      .. list-table::
         :widths: 1 1 4
         :header-rows: 1

         * - Name
           - Type
           - Details

         * - ``regulator-name``
           - ``string``
           - .. code-block:: none

                Descriptive name for regulator outputs.


             This property is **required**.

         * - ``enable-gpios``
           - ``phandle-array``
           - .. code-block:: none

                GPIO to use to enable/disable the regulator.

                Unlike the gpio property in the Linux bindings this array must
                provide the GPIO polarity and open-drain status in the phandle
                selector.  The Linux enable-active-high and gpio-open-drain
                properties are not valid for Zephyr devicetree files.



             This property is **required**.

         * - ``startup-delay-us``
           - ``int``
           - .. code-block:: none

                Startup time, in microseconds


         * - ``off-on-delay-us``
           - ``int``
           - .. code-block:: none

                Off delay time, in microseconds


         * - ``regulator-always-on``
           - ``boolean``
           - .. code-block:: none

                regulator should always be on


         * - ``regulator-boot-on``
           - ``boolean``
           - .. code-block:: none

                regulator should be turned on at startup


         * - ``supply-gpios``
           - ``phandle-array``
           - .. code-block:: none

                GPIO specifier that controls power to the device.

                This property should be provided when the device has a dedicated
                switch that controls power to the device.  The supply state is
                entirely the responsibility of the device driver.

                Contrast with vin-supply.



         * - ``vin-supply``
           - ``phandle``
           - .. code-block:: none

                Reference to the regulator that controls power to the device.
                The referenced devicetree node must have a regulator compatible.

                This property should be provided when device power is supplied
                by a shared regulator.  The supply state is dependent on the
                request status of all devices fed by the regulator.

                Contrast with supply-gpios.  If both properties are provided
                then the regulator must be requested before the supply GPIOS is
                set to an active state, and the supply GPIOS must be set to an
                inactive state before releasing the regulator.





   .. group-tab:: Deprecated node specific properties

      Deprecated properties not inherited from the base binding file.

      (None)

   .. group-tab:: Base properties

      Properties inherited from the base binding file, which defines
      common properties that may be set on many nodes. Not all of these
      may apply to the "regulator-fixed" compatible.

      .. list-table::
         :widths: 1 1 4
         :header-rows: 1

         * - Name
           - Type
           - Details

         * - ``label``
           - ``string``
           - .. code-block:: none

                Human readable string describing the device (used as device_get_binding() argument)


             This property is **required**.

             See :ref:`dt-important-props` for more information.

         * - ``status``
           - ``string``
           - .. code-block:: none

                indicates the operational status of a device


             Legal values: ``'ok'``, ``'okay'``, ``'disabled'``, ``'reserved'``, ``'fail'``, ``'fail-sss'``

             See :ref:`dt-important-props` for more information.

         * - ``compatible``
           - ``string-array``
           - .. code-block:: none

                compatible strings


             This property is **required**.

             See :ref:`dt-important-props` for more information.

         * - ``reg``
           - ``array``
           - .. code-block:: none

                register space


             See :ref:`dt-important-props` for more information.

         * - ``reg-names``
           - ``string-array``
           - .. code-block:: none

                name of each register space


         * - ``interrupts``
           - ``array``
           - .. code-block:: none

                interrupts for device


             See :ref:`dt-important-props` for more information.

         * - ``interrupts-extended``
           - ``compound``
           - .. code-block:: none

                extended interrupt specifier for device


         * - ``interrupt-names``
           - ``string-array``
           - .. code-block:: none

                name of each interrupt


         * - ``interrupt-parent``
           - ``phandle``
           - .. code-block:: none

                phandle to interrupt controller node


         * - ``clocks``
           - ``phandle-array``
           - .. code-block:: none

                Clock gate information


         * - ``clock-names``
           - ``string-array``
           - .. code-block:: none

                name of each clock


         * - ``#address-cells``
           - ``int``
           - .. code-block:: none

                number of address cells in reg property


         * - ``#size-cells``
           - ``int``
           - .. code-block:: none

                number of size cells in reg property


         * - ``dmas``
           - ``phandle-array``
           - .. code-block:: none

                DMA channels specifiers


         * - ``dma-names``
           - ``string-array``
           - .. code-block:: none

                Provided names of DMA channel specifiers


         * - ``io-channels``
           - ``phandle-array``
           - .. code-block:: none

                IO channels specifiers


         * - ``io-channel-names``
           - ``string-array``
           - .. code-block:: none

                Provided names of IO channel specifiers


         * - ``mboxes``
           - ``phandle-array``
           - .. code-block:: none

                mailbox / IPM channels specifiers


         * - ``mbox-names``
           - ``string-array``
           - .. code-block:: none

                Provided names of mailbox / IPM channel specifiers


         * - ``wakeup-source``
           - ``boolean``
           - .. code-block:: none

                Property to identify that a device can be used as wake up source.

                When this property is provided a specific flag is set into the
                device that tells the system that the device is capable of
                wake up the system.

                Wake up capable devices are disabled (interruptions will not wake up
                the system) by default but they can be enabled at runtime if necessary.



         * - ``power-domain``
           - ``phandle``
           - .. code-block:: none


                Power domain the device belongs to.

                The device will be notified when the power domain it belongs to is either
                suspended or resumed.
```
