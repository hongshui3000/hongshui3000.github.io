## latest/zephyr/_sources/reference/devicetree/bindings/multi_heap_manager/shared-multi-heap.rst.txt
```
:orphan:

.. raw:: html

    <!--
    FIXME: do not limit page width until content uses another representation
    format other than tables
    -->
    <style>.wy-nav-content { max-width: none; !important }</style>

.. dtcompatible:: shared-multi-heap
.. _dtbinding_shared_multi_heap:

shared-multi-heap
#################

Vendor: :ref:`Generic or vendor-independent <dt_no_vendor>`

Description
***********



.. code-block:: none

   Shared multi-heap memory pool manager

Properties
**********

.. tabs::

   .. group-tab:: Node specific properties

      Properties not inherited from the base binding file.

      .. list-table::
         :widths: 1 1 4
         :header-rows: 1

         * - Name
           - Type
           - Details

         * - ``capability``
           - ``string``
           - .. code-block:: none

                memory region capability


             Legal values: ``'cacheable'``, ``'non-cacheable'``



   .. group-tab:: Deprecated node specific properties

      Deprecated properties not inherited from the base binding file.

      (None)

   .. group-tab:: Base properties

      Properties inherited from the base binding file, which defines
      common properties that may be set on many nodes. Not all of these
      may apply to the "shared-multi-heap" compatible.

      .. list-table::
         :widths: 1 1 4
         :header-rows: 1

         * - Name
           - Type
           - Details

         * - ``label``
           - ``string``
           - .. code-block:: none

                Human readable string describing the device (used as device_get_binding() argument)


             This property is **required**.

             See :ref:`dt-important-props` for more information.

         * - ``reg``
           - ``array``
           - .. code-block:: none

                register space


             See :ref:`dt-important-props` for more information.
```

## latest/zephyr/_sources/reference/devicetree/bindings/net/wireless/generic-fem-two-ctrl-pins.rst.txt
```
:orphan:

.. raw:: html

    <!--
    FIXME: do not limit page width until content uses another representation
    format other than tables
    -->
    <style>.wy-nav-content { max-width: none; !important }</style>

.. dtcompatible:: generic-fem-two-ctrl-pins
.. _dtbinding_generic_fem_two_ctrl_pins:

generic-fem-two-ctrl-pins
#########################

Vendor: :ref:`Generic or vendor-independent <dt_no_vendor>`

Description
***********



.. code-block:: none

   This is a representation of generic radio Front-End Module (FEM)
   that has a two-pin control interface (CTX, CRX).

   The CTX control pin is used to enable the Power Amplifier (PA) in
   the transmit path. This is therefore sometimes referred to as
   the "PA pin" in other contexts.

   The CRX control pin is used to enable the Low Noise Amplifier
   (LNA) in the receive path, and is sometimes referred to as
   the "LNA pin" in other contexts.

   Each of these pins is optional, and may be omitted if not present.
   (Though if you do specify a pin, you must also specify its
   corresponding settle-time-us property.)

Properties
**********

.. tabs::

   .. group-tab:: Node specific properties

      Properties not inherited from the base binding file.

      .. list-table::
         :widths: 1 1 4
         :header-rows: 1

         * - Name
           - Type
           - Details

         * - ``ctx-gpios``
           - ``phandle-array``
           - .. code-block:: none

                SoC GPIO connected to the CTX input pin on the FEM device.



         * - ``crx-gpios``
           - ``phandle-array``
           - .. code-block:: none

                SoC GPIO connected to the CRX input pin on the FEM device.



         * - ``ctx-settle-time-us``
           - ``int``
           - .. code-block:: none

                Desired minimum settling time, in microseconds, from
                assertion of the CTX pin to beginning of transmission.



         * - ``crx-settle-time-us``
           - ``int``
           - .. code-block:: none

                Desired minimum settling time, in microseconds, from
                assertion of the CRX pin to beginning of reception.



         * - ``tx-gain-db``
           - ``int``
           - .. code-block:: none

                TX gain of the PA of the FEM device, in dB.



         * - ``rx-gain-db``
           - ``int``
           - .. code-block:: none

                RX gain of the LNA of the FEM device, in dB.





   .. group-tab:: Deprecated node specific properties

      Deprecated properties not inherited from the base binding file.

      (None)

   .. group-tab:: Base properties

      Properties inherited from the base binding file, which defines
      common properties that may be set on many nodes. Not all of these
      may apply to the "generic-fem-two-ctrl-pins" compatible.

      .. list-table::
         :widths: 1 1 4
         :header-rows: 1

         * - Name
           - Type
           - Details

         * - ``status``
           - ``string``
           - .. code-block:: none

                indicates the operational status of a device


             Legal values: ``'ok'``, ``'okay'``, ``'disabled'``, ``'reserved'``, ``'fail'``, ``'fail-sss'``

             See :ref:`dt-important-props` for more information.

         * - ``compatible``
           - ``string-array``
           - .. code-block:: none

                compatible strings


             This property is **required**.

             See :ref:`dt-important-props` for more information.

         * - ``reg``
           - ``array``
           - .. code-block:: none

                register space


             See :ref:`dt-important-props` for more information.

         * - ``reg-names``
           - ``string-array``
           - .. code-block:: none

                name of each register space


         * - ``interrupts``
           - ``array``
           - .. code-block:: none

                interrupts for device


             See :ref:`dt-important-props` for more information.

         * - ``interrupts-extended``
           - ``compound``
           - .. code-block:: none

                extended interrupt specifier for device


         * - ``interrupt-names``
           - ``string-array``
           - .. code-block:: none

                name of each interrupt


         * - ``interrupt-parent``
           - ``phandle``
           - .. code-block:: none

                phandle to interrupt controller node


         * - ``label``
           - ``string``
           - .. code-block:: none

                Human readable string describing the device (used as device_get_binding() argument)


             See :ref:`dt-important-props` for more information.

         * - ``clocks``
           - ``phandle-array``
           - .. code-block:: none

                Clock gate information


         * - ``clock-names``
           - ``string-array``
           - .. code-block:: none

                name of each clock


         * - ``#address-cells``
           - ``int``
           - .. code-block:: none

                number of address cells in reg property


         * - ``#size-cells``
           - ``int``
           - .. code-block:: none

                number of size cells in reg property


         * - ``dmas``
           - ``phandle-array``
           - .. code-block:: none

                DMA channels specifiers


         * - ``dma-names``
           - ``string-array``
           - .. code-block:: none

                Provided names of DMA channel specifiers


         * - ``io-channels``
           - ``phandle-array``
           - .. code-block:: none

                IO channels specifiers


         * - ``io-channel-names``
           - ``string-array``
           - .. code-block:: none

                Provided names of IO channel specifiers


         * - ``mboxes``
           - ``phandle-array``
           - .. code-block:: none

                mailbox / IPM channels specifiers


         * - ``mbox-names``
           - ``string-array``
           - .. code-block:: none

                Provided names of mailbox / IPM channel specifiers


         * - ``wakeup-source``
           - ``boolean``
           - .. code-block:: none

                Property to identify that a device can be used as wake up source.

                When this property is provided a specific flag is set into the
                device that tells the system that the device is capable of
                wake up the system.

                Wake up capable devices are disabled (interruptions will not wake up
                the system) by default but they can be enabled at runtime if necessary.



         * - ``power-domain``
           - ``phandle``
           - .. code-block:: none


                Power domain the device belongs to.

                The device will be notified when the power domain it belongs to is either
                suspended or resumed.
```
