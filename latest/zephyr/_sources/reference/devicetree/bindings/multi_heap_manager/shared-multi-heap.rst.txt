## latest/zephyr/_sources/reference/devicetree/bindings/pwm/ite,it8xxx2-pwm.rst.txt
```
:orphan:

.. raw:: html

    <!--
    FIXME: do not limit page width until content uses another representation
    format other than tables
    -->
    <style>.wy-nav-content { max-width: none; !important }</style>

.. dtcompatible:: ite,it8xxx2-pwm
.. _dtbinding_ite_it8xxx2_pwm:

ite,it8xxx2-pwm
###############

Vendor: :ref:`ITE Tech. Inc. <dt_vendor_ite>`

Description
***********



.. code-block:: none

   ITE, it8xxx2 Pulse Width Modulator (PWM) node

Properties
**********

.. tabs::

   .. group-tab:: Node specific properties

      Properties not inherited from the base binding file.

      .. list-table::
         :widths: 1 1 4
         :header-rows: 1

         * - Name
           - Type
           - Details

         * - ``channel``
           - ``int``
           - .. code-block:: none

                0 = PWM_CHANNEL_0, 1 = PWM_CHANNEL_1, 2 = PWM_CHANNEL_2,
                3 = PWM_CHANNEL_3, 4 = PWM_CHANNEL_4, 5 = PWM_CHANNEL_5,
                6 = PWM_CHANNEL_6, 7 = PWM_CHANNEL_7



             This property is **required**.

             Legal values: ``0``, ``1``, ``2``, ``3``, ``4``, ``5``, ``6``, ``7``

         * - ``pwmctrl``
           - ``phandle``
           - .. code-block:: none

                PWM prescaler controller


             This property is **required**.

         * - ``pinctrl-0``
           - ``phandle``
           - .. code-block:: none

                configuration of PWM pinmux controller


             This property is **required**.

         * - ``prescaler-cx``
           - ``int``
           - .. code-block:: none

                1 = PWM_PRESCALER_C4, 2 = PWM_PRESCALER_C6, 3 = PWM_PRESCALER_C7


             This property is **required**.

             Legal values: ``1``, ``2``, ``3``

         * - ``pwm-output-frequency``
           - ``int``
           - .. code-block:: none

                PWM output frequency for operation


         * - ``#pwm-cells``
           - ``int``
           - .. code-block:: none

                Number of items to expect in a pwm specifier


             This property is **required**.



   .. group-tab:: Deprecated node specific properties

      Deprecated properties not inherited from the base binding file.

      (None)

   .. group-tab:: Base properties

      Properties inherited from the base binding file, which defines
      common properties that may be set on many nodes. Not all of these
      may apply to the "ite,it8xxx2-pwm" compatible.

      .. list-table::
         :widths: 1 1 4
         :header-rows: 1

         * - Name
           - Type
           - Details

         * - ``reg``
           - ``array``
           - .. code-block:: none

                register space


             This property is **required**.

             See :ref:`dt-important-props` for more information.

         * - ``label``
           - ``string``
           - .. code-block:: none

                Human readable string describing the device (used as device_get_binding() argument)


             This property is **required**.

             See :ref:`dt-important-props` for more information.

         * - ``interrupts``
           - ``array``
           - .. code-block:: none

                interrupts for device


             See :ref:`dt-important-props` for more information.

         * - ``status``
           - ``string``
           - .. code-block:: none

                indicates the operational status of a device


             Legal values: ``'ok'``, ``'okay'``, ``'disabled'``, ``'reserved'``, ``'fail'``, ``'fail-sss'``

             See :ref:`dt-important-props` for more information.

         * - ``compatible``
           - ``string-array``
           - .. code-block:: none

                compatible strings


             This property is **required**.

             See :ref:`dt-important-props` for more information.

         * - ``reg-names``
           - ``string-array``
           - .. code-block:: none

                name of each register space


         * - ``interrupts-extended``
           - ``compound``
           - .. code-block:: none

                extended interrupt specifier for device


         * - ``interrupt-names``
           - ``string-array``
           - .. code-block:: none

                name of each interrupt


         * - ``interrupt-parent``
           - ``phandle``
           - .. code-block:: none

                phandle to interrupt controller node


         * - ``clocks``
           - ``phandle-array``
           - .. code-block:: none

                Clock gate information


         * - ``clock-names``
           - ``string-array``
           - .. code-block:: none

                name of each clock


         * - ``#address-cells``
           - ``int``
           - .. code-block:: none

                number of address cells in reg property


         * - ``#size-cells``
           - ``int``
           - .. code-block:: none

                number of size cells in reg property


         * - ``dmas``
           - ``phandle-array``
           - .. code-block:: none

                DMA channels specifiers


         * - ``dma-names``
           - ``string-array``
           - .. code-block:: none

                Provided names of DMA channel specifiers


         * - ``io-channels``
           - ``phandle-array``
           - .. code-block:: none

                IO channels specifiers


         * - ``io-channel-names``
           - ``string-array``
           - .. code-block:: none

                Provided names of IO channel specifiers


         * - ``mboxes``
           - ``phandle-array``
           - .. code-block:: none

                mailbox / IPM channels specifiers


         * - ``mbox-names``
           - ``string-array``
           - .. code-block:: none

                Provided names of mailbox / IPM channel specifiers


         * - ``wakeup-source``
           - ``boolean``
           - .. code-block:: none

                Property to identify that a device can be used as wake up source.

                When this property is provided a specific flag is set into the
                device that tells the system that the device is capable of
                wake up the system.

                Wake up capable devices are disabled (interruptions will not wake up
                the system) by default but they can be enabled at runtime if necessary.



         * - ``power-domain``
           - ``phandle``
           - .. code-block:: none


                Power domain the device belongs to.

                The device will be notified when the power domain it belongs to is either
                suspended or resumed.






Specifier cell names
********************

- pwm cells: channel, flags
```

## latest/zephyr/_sources/reference/devicetree/bindings/pwm/nordic,nrf-pwm.rst.txt
```
:orphan:

.. raw:: html

    <!--
    FIXME: do not limit page width until content uses another representation
    format other than tables
    -->
    <style>.wy-nav-content { max-width: none; !important }</style>

.. dtcompatible:: nordic,nrf-pwm
.. _dtbinding_nordic_nrf_pwm:

nordic,nrf-pwm
##############

Vendor: :ref:`Nordic Semiconductor <dt_vendor_nordic>`

Description
***********



.. code-block:: none

   nRF PWM

Properties
**********

.. tabs::

   .. group-tab:: Node specific properties

      Properties not inherited from the base binding file.

      .. list-table::
         :widths: 1 1 4
         :header-rows: 1

         * - Name
           - Type
           - Details

         * - ``center-aligned``
           - ``boolean``
           - .. code-block:: none

                Set this to use center-aligned (up and down) counter mode.


         * - ``ch0-pin``
           - ``int``
           - .. code-block:: none

                The channel 0 pin to use.

                For pins P0.0 through P0.31, use the pin number. For example,
                to use P0.16 for channel 0, set:

                    ch0-pin = <16>;

                For pins P1.0 through P1.31, add 32 to the pin number. For
                example, to use P1.2 for channel 0, set:

                    ch0-pin = <34>;  /* 32 + 2 */



         * - ``ch0-inverted``
           - ``boolean``
           - .. code-block:: none

                Set this to invert channel 0.


         * - ``ch1-pin``
           - ``int``
           - .. code-block:: none

                The channel 1 pin to use. The pin numbering scheme is the same
                as the ch0-pin property's.



         * - ``ch1-inverted``
           - ``boolean``
           - .. code-block:: none

                Set this to invert channel 1.


         * - ``ch2-pin``
           - ``int``
           - .. code-block:: none

                The channel 2 pin to use. The pin numbering scheme is the same
                as the ch0-pin property's.



         * - ``ch2-inverted``
           - ``boolean``
           - .. code-block:: none

                Set this to invert channel 2.


         * - ``ch3-pin``
           - ``int``
           - .. code-block:: none

                The channel 3 pin to use. The pin numbering scheme is the same
                as the ch0-pin property's.



         * - ``ch3-inverted``
           - ``boolean``
           - .. code-block:: none

                Set this to invert channel 3.


         * - ``#pwm-cells``
           - ``int``
           - .. code-block:: none

                Number of items to expect in a pwm specifier


             This property is **required**.

             Constant value: ``1``



   .. group-tab:: Deprecated node specific properties

      Deprecated properties not inherited from the base binding file.

      (None)

   .. group-tab:: Base properties

      Properties inherited from the base binding file, which defines
      common properties that may be set on many nodes. Not all of these
      may apply to the "nordic,nrf-pwm" compatible.

      .. list-table::
         :widths: 1 1 4
         :header-rows: 1

         * - Name
           - Type
           - Details

         * - ``reg``
           - ``array``
           - .. code-block:: none

                register space


             This property is **required**.

             See :ref:`dt-important-props` for more information.

         * - ``label``
           - ``string``
           - .. code-block:: none

                Human readable string describing the device (used as device_get_binding() argument)


             This property is **required**.

             See :ref:`dt-important-props` for more information.

         * - ``status``
           - ``string``
           - .. code-block:: none

                indicates the operational status of a device


             Legal values: ``'ok'``, ``'okay'``, ``'disabled'``, ``'reserved'``, ``'fail'``, ``'fail-sss'``

             See :ref:`dt-important-props` for more information.

         * - ``compatible``
           - ``string-array``
           - .. code-block:: none

                compatible strings


             This property is **required**.

             See :ref:`dt-important-props` for more information.

         * - ``reg-names``
           - ``string-array``
           - .. code-block:: none

                name of each register space


         * - ``interrupts``
           - ``array``
           - .. code-block:: none

                interrupts for device


             See :ref:`dt-important-props` for more information.

         * - ``interrupts-extended``
           - ``compound``
           - .. code-block:: none

                extended interrupt specifier for device


         * - ``interrupt-names``
           - ``string-array``
           - .. code-block:: none

                name of each interrupt


         * - ``interrupt-parent``
           - ``phandle``
           - .. code-block:: none

                phandle to interrupt controller node


         * - ``clocks``
           - ``phandle-array``
           - .. code-block:: none

                Clock gate information


         * - ``clock-names``
           - ``string-array``
           - .. code-block:: none

                name of each clock


         * - ``#address-cells``
           - ``int``
           - .. code-block:: none

                number of address cells in reg property


         * - ``#size-cells``
           - ``int``
           - .. code-block:: none

                number of size cells in reg property


         * - ``dmas``
           - ``phandle-array``
           - .. code-block:: none

                DMA channels specifiers


         * - ``dma-names``
           - ``string-array``
           - .. code-block:: none

                Provided names of DMA channel specifiers


         * - ``io-channels``
           - ``phandle-array``
           - .. code-block:: none

                IO channels specifiers


         * - ``io-channel-names``
           - ``string-array``
           - .. code-block:: none

                Provided names of IO channel specifiers


         * - ``mboxes``
           - ``phandle-array``
           - .. code-block:: none

                mailbox / IPM channels specifiers


         * - ``mbox-names``
           - ``string-array``
           - .. code-block:: none

                Provided names of mailbox / IPM channel specifiers


         * - ``wakeup-source``
           - ``boolean``
           - .. code-block:: none

                Property to identify that a device can be used as wake up source.

                When this property is provided a specific flag is set into the
                device that tells the system that the device is capable of
                wake up the system.

                Wake up capable devices are disabled (interruptions will not wake up
                the system) by default but they can be enabled at runtime if necessary.



         * - ``power-domain``
           - ``phandle``
           - .. code-block:: none


                Power domain the device belongs to.

                The device will be notified when the power domain it belongs to is either
                suspended or resumed.






Specifier cell names
********************

- pwm cells: channel
```
