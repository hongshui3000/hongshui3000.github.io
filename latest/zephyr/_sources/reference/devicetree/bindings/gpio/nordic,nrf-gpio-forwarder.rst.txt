## latest/zephyr/_sources/reference/devicetree/bindings/lora/st,stm32wl-subghz-radio.rst.txt
```
:orphan:

.. raw:: html

    <!--
    FIXME: do not limit page width until content uses another representation
    format other than tables
    -->
    <style>.wy-nav-content { max-width: none; !important }</style>

.. dtcompatible:: st,stm32wl-subghz-radio
.. _dtbinding_st_stm32wl_subghz_radio:

st,stm32wl-subghz-radio (on spi bus)
####################################

Vendor: :ref:`STMicroelectronics <dt_vendor_st>`

Description
***********



.. code-block:: none

   STM32WL SUBGHZ Radio

Properties
**********

.. tabs::

   .. group-tab:: Node specific properties

      Properties not inherited from the base binding file.

      .. list-table::
         :widths: 1 1 4
         :header-rows: 1

         * - Name
           - Type
           - Details

         * - ``reset-gpios``
           - ``phandle-array``
           - .. code-block:: none

                GPIO connected to the modem's NRESET signal.

                This signal is open-drain, active-low as interpreted by the
                modem.



         * - ``busy-gpios``
           - ``phandle-array``
           - .. code-block:: none

                GPIO connected to the modem's BUSY signal.



         * - ``antenna-enable-gpios``
           - ``phandle-array``
           - .. code-block:: none

                Antenna power enable pin.



         * - ``tx-enable-gpios``
           - ``phandle-array``
           - .. code-block:: none

                Antenna switch TX enable GPIO. If set, the driver tracks the
                state of the radio and controls the RF switch.



         * - ``rx-enable-gpios``
           - ``phandle-array``
           - .. code-block:: none

                Antenna switch RX enable GPIO. If set, the driver tracks the
                state of the radio and controls the RF switch.



         * - ``dio1-gpios``
           - ``phandle-array``
           - .. code-block:: none

                GPIO connected to DIO1. This GPIO will be used as a generic
                IRQ line from the chip.



         * - ``dio2-tx-enable``
           - ``boolean``
           - .. code-block:: none

                Use DIO2 to drive an RF switch selecting between the TX and RX
                paths. When enabled, DIO2 goes high when the chip is
                transmitting.



         * - ``dio3-tcxo-voltage``
           - ``int``
           - .. code-block:: none

                TCXO supply voltage controlled by DIO3 if present.

                See constants in dt-bindings/lora/sx126x.h.



         * - ``tcxo-power-startup-delay-ms``
           - ``int``
           - .. code-block:: none

                Startup delay to let the TCXO stabilize after TCXO power on.



         * - ``spi-max-frequency``
           - ``int``
           - .. code-block:: none

                Maximum clock frequency of device's SPI interface in Hz


             This property is **required**.

         * - ``duplex``
           - ``int``
           - .. code-block:: none

                Duplex mode, full or half. By default it's always full duplex thus 0
                as this is, by far, the most common mode.
                Use the macros not the actual enum value, here is the concordance
                list (see dt-bindings/spi/spi.h)
                  0    SPI_FULL_DUPLEX
                  2048 SPI_HALF_DUPLEX



             Legal values: ``0``, ``2048``

         * - ``frame-format``
           - ``int``
           - .. code-block:: none

                Motorola or TI frame format. By default it's always Motorola's,
                thus 0 as this is, by far, the most common format.
                Use the macros not the actual enum value, here is the concordance
                list (see dt-bindings/spi/spi.h)
                  0     SPI_FRAME_FORMAT_MOTOROLA
                  32768 SPI_FRAME_FORMAT_TI



             Legal values: ``0``, ``32768``

         * - ``supply-gpios``
           - ``phandle-array``
           - .. code-block:: none

                GPIO specifier that controls power to the device.

                This property should be provided when the device has a dedicated
                switch that controls power to the device.  The supply state is
                entirely the responsibility of the device driver.

                Contrast with vin-supply.



         * - ``vin-supply``
           - ``phandle``
           - .. code-block:: none

                Reference to the regulator that controls power to the device.
                The referenced devicetree node must have a regulator compatible.

                This property should be provided when device power is supplied
                by a shared regulator.  The supply state is dependent on the
                request status of all devices fed by the regulator.

                Contrast with supply-gpios.  If both properties are provided
                then the regulator must be requested before the supply GPIOS is
                set to an active state, and the supply GPIOS must be set to an
                inactive state before releasing the regulator.





   .. group-tab:: Deprecated node specific properties

      Deprecated properties not inherited from the base binding file.

      (None)

   .. group-tab:: Base properties

      Properties inherited from the base binding file, which defines
      common properties that may be set on many nodes. Not all of these
      may apply to the "st,stm32wl-subghz-radio" compatible.

      .. list-table::
         :widths: 1 1 4
         :header-rows: 1

         * - Name
           - Type
           - Details

         * - ``interrupts``
           - ``array``
           - .. code-block:: none

                Position of the "Radio IRQ, Busy" interrupt line.



             This property is **required**.

             See :ref:`dt-important-props` for more information.

         * - ``reg``
           - ``array``
           - .. code-block:: none

                register space


             This property is **required**.

             See :ref:`dt-important-props` for more information.

         * - ``label``
           - ``string``
           - .. code-block:: none

                Human readable string describing the device (used as device_get_binding() argument)


             This property is **required**.

             See :ref:`dt-important-props` for more information.

         * - ``status``
           - ``string``
           - .. code-block:: none

                indicates the operational status of a device


             Legal values: ``'ok'``, ``'okay'``, ``'disabled'``, ``'reserved'``, ``'fail'``, ``'fail-sss'``

             See :ref:`dt-important-props` for more information.

         * - ``compatible``
           - ``string-array``
           - .. code-block:: none

                compatible strings


             This property is **required**.

             See :ref:`dt-important-props` for more information.

         * - ``reg-names``
           - ``string-array``
           - .. code-block:: none

                name of each register space


         * - ``interrupts-extended``
           - ``compound``
           - .. code-block:: none

                extended interrupt specifier for device


         * - ``interrupt-names``
           - ``string-array``
           - .. code-block:: none

                name of each interrupt


         * - ``interrupt-parent``
           - ``phandle``
           - .. code-block:: none

                phandle to interrupt controller node


         * - ``clocks``
           - ``phandle-array``
           - .. code-block:: none

                Clock gate information


         * - ``clock-names``
           - ``string-array``
           - .. code-block:: none

                name of each clock


         * - ``#address-cells``
           - ``int``
           - .. code-block:: none

                number of address cells in reg property


         * - ``#size-cells``
           - ``int``
           - .. code-block:: none

                number of size cells in reg property


         * - ``dmas``
           - ``phandle-array``
           - .. code-block:: none

                DMA channels specifiers


         * - ``dma-names``
           - ``string-array``
           - .. code-block:: none

                Provided names of DMA channel specifiers


         * - ``io-channels``
           - ``phandle-array``
           - .. code-block:: none

                IO channels specifiers


         * - ``io-channel-names``
           - ``string-array``
           - .. code-block:: none

                Provided names of IO channel specifiers


         * - ``mboxes``
           - ``phandle-array``
           - .. code-block:: none

                mailbox / IPM channels specifiers


         * - ``mbox-names``
           - ``string-array``
           - .. code-block:: none

                Provided names of mailbox / IPM channel specifiers


         * - ``wakeup-source``
           - ``boolean``
           - .. code-block:: none

                Property to identify that a device can be used as wake up source.

                When this property is provided a specific flag is set into the
                device that tells the system that the device is capable of
                wake up the system.

                Wake up capable devices are disabled (interruptions will not wake up
                the system) by default but they can be enabled at runtime if necessary.



         * - ``power-domain``
           - ``phandle``
           - .. code-block:: none


                Power domain the device belongs to.

                The device will be notified when the power domain it belongs to is either
                suspended or resumed.
```
