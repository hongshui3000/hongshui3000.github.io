## latest/zephyr/_sources/reference/devicetree/bindings/led/ti,lp503x.rst.txt
```
:orphan:

.. raw:: html

    <!--
    FIXME: do not limit page width until content uses another representation
    format other than tables
    -->
    <style>.wy-nav-content { max-width: none; !important }</style>

.. dtcompatible:: ti,lp503x
.. _dtbinding_ti_lp503x:

ti,lp503x (on i2c bus)
######################

Vendor: :ref:`Texas Instruments <dt_vendor_ti>`

Description
***********



.. code-block:: none

   TI LP503x LED controller node

Properties
**********

Top level properties
====================


These property descriptions apply to "ti,lp503x"
nodes themselves. This page also describes child node
properties in the following sections.

.. tabs::

   .. group-tab:: Node specific properties

      Properties not inherited from the base binding file.

      .. list-table::
         :widths: 1 1 4
         :header-rows: 1

         * - Name
           - Type
           - Details

         * - ``max_curr_opt``
           - ``boolean``
           - .. code-block:: none

                If enabled the maximum current output is set to 35 mA (25.5 mA else).



         * - ``log_scale_en``
           - ``boolean``
           - .. code-block:: none

                If enabled a logarithmic dimming scale curve is used for LED brightness
                control. A linear dimming scale curve is used else.



         * - ``supply-gpios``
           - ``phandle-array``
           - .. code-block:: none

                GPIO specifier that controls power to the device.

                This property should be provided when the device has a dedicated
                switch that controls power to the device.  The supply state is
                entirely the responsibility of the device driver.

                Contrast with vin-supply.



         * - ``vin-supply``
           - ``phandle``
           - .. code-block:: none

                Reference to the regulator that controls power to the device.
                The referenced devicetree node must have a regulator compatible.

                This property should be provided when device power is supplied
                by a shared regulator.  The supply state is dependent on the
                request status of all devices fed by the regulator.

                Contrast with supply-gpios.  If both properties are provided
                then the regulator must be requested before the supply GPIOS is
                set to an active state, and the supply GPIOS must be set to an
                inactive state before releasing the regulator.





   .. group-tab:: Deprecated node specific properties

      Deprecated properties not inherited from the base binding file.

      (None)

   .. group-tab:: Base properties

      Properties inherited from the base binding file, which defines
      common properties that may be set on many nodes. Not all of these
      may apply to the "ti,lp503x" compatible.

      .. list-table::
         :widths: 1 1 4
         :header-rows: 1

         * - Name
           - Type
           - Details

         * - ``reg``
           - ``array``
           - .. code-block:: none

                device address on i2c bus


             This property is **required**.

             See :ref:`dt-important-props` for more information.

         * - ``label``
           - ``string``
           - .. code-block:: none

                Human readable string describing the device (used as device_get_binding() argument)


             This property is **required**.

             See :ref:`dt-important-props` for more information.

         * - ``status``
           - ``string``
           - .. code-block:: none

                indicates the operational status of a device


             Legal values: ``'ok'``, ``'okay'``, ``'disabled'``, ``'reserved'``, ``'fail'``, ``'fail-sss'``

             See :ref:`dt-important-props` for more information.

         * - ``compatible``
           - ``string-array``
           - .. code-block:: none

                compatible strings


             This property is **required**.

             See :ref:`dt-important-props` for more information.

         * - ``reg-names``
           - ``string-array``
           - .. code-block:: none

                name of each register space


         * - ``interrupts``
           - ``array``
           - .. code-block:: none

                interrupts for device


             See :ref:`dt-important-props` for more information.

         * - ``interrupts-extended``
           - ``compound``
           - .. code-block:: none

                extended interrupt specifier for device


         * - ``interrupt-names``
           - ``string-array``
           - .. code-block:: none

                name of each interrupt


         * - ``interrupt-parent``
           - ``phandle``
           - .. code-block:: none

                phandle to interrupt controller node


         * - ``clocks``
           - ``phandle-array``
           - .. code-block:: none

                Clock gate information


         * - ``clock-names``
           - ``string-array``
           - .. code-block:: none

                name of each clock


         * - ``#address-cells``
           - ``int``
           - .. code-block:: none

                number of address cells in reg property


         * - ``#size-cells``
           - ``int``
           - .. code-block:: none

                number of size cells in reg property


         * - ``dmas``
           - ``phandle-array``
           - .. code-block:: none

                DMA channels specifiers


         * - ``dma-names``
           - ``string-array``
           - .. code-block:: none

                Provided names of DMA channel specifiers


         * - ``io-channels``
           - ``phandle-array``
           - .. code-block:: none

                IO channels specifiers


         * - ``io-channel-names``
           - ``string-array``
           - .. code-block:: none

                Provided names of IO channel specifiers


         * - ``mboxes``
           - ``phandle-array``
           - .. code-block:: none

                mailbox / IPM channels specifiers


         * - ``mbox-names``
           - ``string-array``
           - .. code-block:: none

                Provided names of mailbox / IPM channel specifiers


         * - ``wakeup-source``
           - ``boolean``
           - .. code-block:: none

                Property to identify that a device can be used as wake up source.

                When this property is provided a specific flag is set into the
                device that tells the system that the device is capable of
                wake up the system.

                Wake up capable devices are disabled (interruptions will not wake up
                the system) by default but they can be enabled at runtime if necessary.



         * - ``power-domain``
           - ``phandle``
           - .. code-block:: none


                Power domain the device belongs to.

                The device will be notified when the power domain it belongs to is either
                suspended or resumed.






Child node properties
=====================

.. list-table::
   :widths: 1 1 4
   :header-rows: 1

   * - Name
     - Type
     - Details

   * - ``label``
     - ``string``
     - .. code-block:: none

          Human readable string describing the LED


       This property is **required**.

       See :ref:`dt-important-props` for more information.

   * - ``index``
     - ``int``
     - .. code-block:: none

          Index of the LED on a controller. It can be used by drivers or
          applications to map a logical LED to its real position on the
          controller. For example, this allows to handle boards where the
          LEDs in an array/strip are not wired following the LED order of
          the controller.



       This property is **required**.

   * - ``color-mapping``
     - ``array``
     - .. code-block:: none

          Channel to color mapping of a multicolor LED. If a LED supports
          several colors, then the color-mapping property can be used to
          describe how the hardware channels and the colors are mapped.

          For example the channel to color mapping of RGB LEDs would be

             color-mapping =
                  <LED_COLOR_ID_RED>,
                  <LED_COLOR_ID_GREEN>,
                  <LED_COLOR_ID_BLUE>;



       This property is **required**.
```
