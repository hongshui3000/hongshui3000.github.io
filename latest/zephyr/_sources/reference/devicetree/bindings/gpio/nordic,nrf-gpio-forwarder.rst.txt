## latest/zephyr/_sources/reference/devicetree/bindings/gpio/seeed-xiao-header.rst.txt
```
:orphan:

.. raw:: html

    <!--
    FIXME: do not limit page width until content uses another representation
    format other than tables
    -->
    <style>.wy-nav-content { max-width: none; !important }</style>

.. dtcompatible:: seeed,xiao-gpio
.. _dtbinding_seeed_xiao_header:

seeed,xiao-gpio
###############

Vendor: :ref:`Seeed Technology Co., Ltd <dt_vendor_seeed>`

Description
***********



.. code-block:: none

   GPIO pins exposed on Seeeduino Xiao (and compatible devices) headers.

   The Seeeeduino Xiao layout provides two headers, along opposite
   edges of the board.

   Proceeding counter-clockwise:
   * A 7-pin Digital/Analog Input header.  This has input signals
     labeled from 0 at the top through 6 at the bottom.
   * An 7-pin header Power and Digital/Analog Input header.  This
     has three power pins, followed by four inputs labeled 10 at the
     top through 7 at the bottom.

   This binding provides a nexus mapping for 10 pins where parent pins 0
   through 10 correspond to D0 through D10, as depicted below:

       0 D0                     5V   -
       1 D1                     GND  -
       2 D2                     3V3  -
       3 D3                     D10 10
       4 A4                     D9   9
       5 D5                     D8   8
       6 D6                     D7   7

Properties
**********

.. tabs::

   .. group-tab:: Node specific properties

      Properties not inherited from the base binding file.

      .. list-table::
         :widths: 1 1 4
         :header-rows: 1

         * - Name
           - Type
           - Details

         * - ``gpio-map``
           - ``compound``
           - This property is **required**.

         * - ``gpio-map-mask``
           - ``compound``
           - 

         * - ``gpio-map-pass-thru``
           - ``compound``
           - 

         * - ``#gpio-cells``
           - ``int``
           - .. code-block:: none

                Number of items to expect in a GPIO specifier


             This property is **required**.



   .. group-tab:: Deprecated node specific properties

      Deprecated properties not inherited from the base binding file.

      (None)

   .. group-tab:: Base properties

      Properties inherited from the base binding file, which defines
      common properties that may be set on many nodes. Not all of these
      may apply to the "seeed,xiao-gpio" compatible.

      .. list-table::
         :widths: 1 1 4
         :header-rows: 1

         * - Name
           - Type
           - Details

         * - ``status``
           - ``string``
           - .. code-block:: none

                indicates the operational status of a device


             Legal values: ``'ok'``, ``'okay'``, ``'disabled'``, ``'reserved'``, ``'fail'``, ``'fail-sss'``

             See :ref:`dt-important-props` for more information.

         * - ``compatible``
           - ``string-array``
           - .. code-block:: none

                compatible strings


             This property is **required**.

             See :ref:`dt-important-props` for more information.

         * - ``reg``
           - ``array``
           - .. code-block:: none

                register space


             See :ref:`dt-important-props` for more information.

         * - ``reg-names``
           - ``string-array``
           - .. code-block:: none

                name of each register space


         * - ``interrupts``
           - ``array``
           - .. code-block:: none

                interrupts for device


             See :ref:`dt-important-props` for more information.

         * - ``interrupts-extended``
           - ``compound``
           - .. code-block:: none

                extended interrupt specifier for device


         * - ``interrupt-names``
           - ``string-array``
           - .. code-block:: none

                name of each interrupt


         * - ``interrupt-parent``
           - ``phandle``
           - .. code-block:: none

                phandle to interrupt controller node


         * - ``label``
           - ``string``
           - .. code-block:: none

                Human readable string describing the device (used as device_get_binding() argument)


             See :ref:`dt-important-props` for more information.

         * - ``clocks``
           - ``phandle-array``
           - .. code-block:: none

                Clock gate information


         * - ``clock-names``
           - ``string-array``
           - .. code-block:: none

                name of each clock


         * - ``#address-cells``
           - ``int``
           - .. code-block:: none

                number of address cells in reg property


         * - ``#size-cells``
           - ``int``
           - .. code-block:: none

                number of size cells in reg property


         * - ``dmas``
           - ``phandle-array``
           - .. code-block:: none

                DMA channels specifiers


         * - ``dma-names``
           - ``string-array``
           - .. code-block:: none

                Provided names of DMA channel specifiers


         * - ``io-channels``
           - ``phandle-array``
           - .. code-block:: none

                IO channels specifiers


         * - ``io-channel-names``
           - ``string-array``
           - .. code-block:: none

                Provided names of IO channel specifiers


         * - ``mboxes``
           - ``phandle-array``
           - .. code-block:: none

                mailbox / IPM channels specifiers


         * - ``mbox-names``
           - ``string-array``
           - .. code-block:: none

                Provided names of mailbox / IPM channel specifiers


         * - ``wakeup-source``
           - ``boolean``
           - .. code-block:: none

                Property to identify that a device can be used as wake up source.

                When this property is provided a specific flag is set into the
                device that tells the system that the device is capable of
                wake up the system.

                Wake up capable devices are disabled (interruptions will not wake up
                the system) by default but they can be enabled at runtime if necessary.



         * - ``power-domain``
           - ``phandle``
           - .. code-block:: none


                Power domain the device belongs to.

                The device will be notified when the power domain it belongs to is either
                suspended or resumed.
```

## latest/zephyr/_sources/reference/devicetree/bindings/gpio/ti,boosterpack-header.rst.txt
```
:orphan:

.. raw:: html

    <!--
    FIXME: do not limit page width until content uses another representation
    format other than tables
    -->
    <style>.wy-nav-content { max-width: none; !important }</style>

.. dtcompatible:: ti,boosterpack-header
.. _dtbinding_ti_boosterpack_header:

ti,boosterpack-header
#####################

Vendor: :ref:`Texas Instruments <dt_vendor_ti>`

Description
***********



.. code-block:: none

   TI BoosterPack GPIO header

   GPIO pins exposed as BoosterPack headers on TI LaunchPads.

   BoosterPack plug-in modules are available in 20 and 40 pin variants. The
   20 pin variant has two 10 x 1 pin headers and the 40 pin variant has two
   10 x 2 pin headers. Both variants are compatible and stackable.

   The pins of the 20 pin variant and the outer row of the 40 pin variant are
   numbered 1 through 20. The inner rows of the 40 pin variant are numbered 21
   through 40. The BoosterPack pinout is depicted below:

   1  3.3V     21 5V                    40 GPIO 20 GND
   2  Analog   22 GND                   39 GPIO 19 GPIO / SPI CS
   3  UART RXD 23 Analog                38 GPIO 18 GPIO
   4  UART TXD 24 Analog                37 GPIO 17 GPIO
   5  GPIO     25 Analog                36 GPIO 16 RESET
   6  Analog   26 Analog                35 GPIO 15 SPI MOSI
   7  SPI CLK  27 Analog                34 GPIO 14 SPI MISO
   8  GPIO     28 Analog                33 GPIO 13 GPIO / SPI CS
   9  I2C SCL  29                       32 GPIO 12 GPIO / SPI CS
   10 I2C SDA  30                       31 GPIO 11 GPIO

   Additional information about the BoosterPack pinout can be found at
   http://processors.wiki.ti.com/index.php/BYOB or in the documentation for
   a TI LaunchPad development kit,

Properties
**********

.. tabs::

   .. group-tab:: Node specific properties

      Properties not inherited from the base binding file.

      .. list-table::
         :widths: 1 1 4
         :header-rows: 1

         * - Name
           - Type
           - Details

         * - ``gpio-map``
           - ``compound``
           - This property is **required**.

         * - ``gpio-map-mask``
           - ``compound``
           - 

         * - ``gpio-map-pass-thru``
           - ``compound``
           - 

         * - ``#gpio-cells``
           - ``int``
           - .. code-block:: none

                Number of items to expect in a GPIO specifier


             This property is **required**.



   .. group-tab:: Deprecated node specific properties

      Deprecated properties not inherited from the base binding file.

      (None)

   .. group-tab:: Base properties

      Properties inherited from the base binding file, which defines
      common properties that may be set on many nodes. Not all of these
      may apply to the "ti,boosterpack-header" compatible.

      .. list-table::
         :widths: 1 1 4
         :header-rows: 1

         * - Name
           - Type
           - Details

         * - ``status``
           - ``string``
           - .. code-block:: none

                indicates the operational status of a device


             Legal values: ``'ok'``, ``'okay'``, ``'disabled'``, ``'reserved'``, ``'fail'``, ``'fail-sss'``

             See :ref:`dt-important-props` for more information.

         * - ``compatible``
           - ``string-array``
           - .. code-block:: none

                compatible strings


             This property is **required**.

             See :ref:`dt-important-props` for more information.

         * - ``reg``
           - ``array``
           - .. code-block:: none

                register space


             See :ref:`dt-important-props` for more information.

         * - ``reg-names``
           - ``string-array``
           - .. code-block:: none

                name of each register space


         * - ``interrupts``
           - ``array``
           - .. code-block:: none

                interrupts for device


             See :ref:`dt-important-props` for more information.

         * - ``interrupts-extended``
           - ``compound``
           - .. code-block:: none

                extended interrupt specifier for device


         * - ``interrupt-names``
           - ``string-array``
           - .. code-block:: none

                name of each interrupt


         * - ``interrupt-parent``
           - ``phandle``
           - .. code-block:: none

                phandle to interrupt controller node


         * - ``label``
           - ``string``
           - .. code-block:: none

                Human readable string describing the device (used as device_get_binding() argument)


             See :ref:`dt-important-props` for more information.

         * - ``clocks``
           - ``phandle-array``
           - .. code-block:: none

                Clock gate information


         * - ``clock-names``
           - ``string-array``
           - .. code-block:: none

                name of each clock


         * - ``#address-cells``
           - ``int``
           - .. code-block:: none

                number of address cells in reg property


         * - ``#size-cells``
           - ``int``
           - .. code-block:: none

                number of size cells in reg property


         * - ``dmas``
           - ``phandle-array``
           - .. code-block:: none

                DMA channels specifiers


         * - ``dma-names``
           - ``string-array``
           - .. code-block:: none

                Provided names of DMA channel specifiers


         * - ``io-channels``
           - ``phandle-array``
           - .. code-block:: none

                IO channels specifiers


         * - ``io-channel-names``
           - ``string-array``
           - .. code-block:: none

                Provided names of IO channel specifiers


         * - ``mboxes``
           - ``phandle-array``
           - .. code-block:: none

                mailbox / IPM channels specifiers


         * - ``mbox-names``
           - ``string-array``
           - .. code-block:: none

                Provided names of mailbox / IPM channel specifiers


         * - ``wakeup-source``
           - ``boolean``
           - .. code-block:: none

                Property to identify that a device can be used as wake up source.

                When this property is provided a specific flag is set into the
                device that tells the system that the device is capable of
                wake up the system.

                Wake up capable devices are disabled (interruptions will not wake up
                the system) by default but they can be enabled at runtime if necessary.



         * - ``power-domain``
           - ``phandle``
           - .. code-block:: none


                Power domain the device belongs to.

                The device will be notified when the power domain it belongs to is either
                suspended or resumed.
```
