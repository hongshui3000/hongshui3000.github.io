## latest/zephyr/_sources/reference/devicetree/bindings/gpio/nordic,nrf-gpio-forwarder.rst.txt
```
:orphan:

.. raw:: html

    <!--
    FIXME: do not limit page width until content uses another representation
    format other than tables
    -->
    <style>.wy-nav-content { max-width: none; !important }</style>

.. dtcompatible:: nordic,nrf-gpio-forwarder
.. _dtbinding_nordic_nrf_gpio_forwarder:

nordic,nrf-gpio-forwarder
#########################

Vendor: :ref:`Nordic Semiconductor <dt_vendor_nordic>`

Description
***********



.. code-block:: none

   This is an abstract device responsible for forwarding pins between cores.

   In nRF53 family of SoCs, GPIO pins must be explicitly forwarded by
   the application core to the network core if the latter should drive them.
   The purpose of this abstract device is to represent all GPIO pins that the
   nRF53 application core should forward to the nRF53 network core.

   Once the control over selected GPIO pins is forwarded to it, the network
   core is responsible for configuring the pins and driving them as needed.

   Here is an example of how a nrf-gpio-forwarder can be used with a nRF5340
   combined with a nRF21540 Front-End module. Consider the following node
   present in DTS file targeted for the nRF5340 network core, which defines
   the details of the nRF21540 Front-End module's interface:

   nrf_radio_fem: nrf21540 {
     compatible = "nordic,nrf21540-fem";
     tx-en-gpios = <&gpio0 30 GPIO_ACTIVE_HIGH>;
     rx-en-gpios = <&gpio1 11 GPIO_ACTIVE_HIGH>;
     pdn-gpios   = <&gpio1 10 GPIO_ACTIVE_HIGH>;
     mode-gpios  = <&gpio1 12 GPIO_ACTIVE_HIGH>;
   };

   Since the nRF21540 Front-End module should be controlled by the nRF5340
   network core, all the GPIO pins used to control it must be forwarded by
   the nRF5340 application core to the network core. Consider the following
   nrf-gpio-forwarder node defined in DTS file targeted for the nRF5340
   application core:

   gpio_fwd: nrf-gpio-forwarder {
     compatible = "nordic,nrf-gpio-forwarder";
     nrf21540-gpio-if {
       gpios = <&gpio0 30 0>, <&gpio1 11 0>, <&gpio1 10 0>, <&gpio1 12 0>;
     };
   };

   In the above example, the nrf-gpio-forwarder node is configured to forward
   control over the following GPIO pins to the network core:

     - P0.30 (matching `tx-en-gpios`)
     - P1.11 (matching `rx-en-gpios`)
     - P1.10 (matching `pdn-gpios`)
     - P1.12 (matching `mode-gpios`)

   Please note that the GPIO flags provided for child nodes of the forwarder
   are ignored. In order to configure the GPIOs passed to the forwarder, their
   GPIO flags must be set in the matching node that these GPIOs are forwarded
   to. In the above example, the GPIO flags must be set in the nrf21540 node.
   They are set to 0 in the nrf-gpio-forwarder node as they are ignored anyway.

   Child nodes for the forwarder can be defined independently by multiple DTS
   files. They are merged into a single node with multiple child nodes when
   processing devicetree for an application build. However, in order for that
   to happen, names of the child nodes must be unique in the scope of a single
   nrf-gpio-forwarder instance.

Properties
**********

Top level properties
====================


These property descriptions apply to "nordic,nrf-gpio-forwarder"
nodes themselves. This page also describes child node
properties in the following sections.

.. tabs::

   .. group-tab:: Node specific properties

      Properties not inherited from the base binding file.

      (None)

   .. group-tab:: Deprecated node specific properties

      Deprecated properties not inherited from the base binding file.

      (None)

   .. group-tab:: Base properties

      Properties inherited from the base binding file, which defines
      common properties that may be set on many nodes. Not all of these
      may apply to the "nordic,nrf-gpio-forwarder" compatible.

      .. list-table::
         :widths: 1 1 4
         :header-rows: 1

         * - Name
           - Type
           - Details

         * - ``status``
           - ``string``
           - .. code-block:: none

                indicates the operational status of a device


             Legal values: ``'ok'``, ``'okay'``, ``'disabled'``, ``'reserved'``, ``'fail'``, ``'fail-sss'``

             See :ref:`dt-important-props` for more information.

         * - ``compatible``
           - ``string-array``
           - .. code-block:: none

                compatible strings


             This property is **required**.

             See :ref:`dt-important-props` for more information.

         * - ``reg``
           - ``array``
           - .. code-block:: none

                register space


             See :ref:`dt-important-props` for more information.

         * - ``reg-names``
           - ``string-array``
           - .. code-block:: none

                name of each register space


         * - ``interrupts``
           - ``array``
           - .. code-block:: none

                interrupts for device


             See :ref:`dt-important-props` for more information.

         * - ``interrupts-extended``
           - ``compound``
           - .. code-block:: none

                extended interrupt specifier for device


         * - ``interrupt-names``
           - ``string-array``
           - .. code-block:: none

                name of each interrupt


         * - ``interrupt-parent``
           - ``phandle``
           - .. code-block:: none

                phandle to interrupt controller node


         * - ``label``
           - ``string``
           - .. code-block:: none

                Human readable string describing the device (used as device_get_binding() argument)


             See :ref:`dt-important-props` for more information.

         * - ``clocks``
           - ``phandle-array``
           - .. code-block:: none

                Clock gate information


         * - ``clock-names``
           - ``string-array``
           - .. code-block:: none

                name of each clock


         * - ``#address-cells``
           - ``int``
           - .. code-block:: none

                number of address cells in reg property


         * - ``#size-cells``
           - ``int``
           - .. code-block:: none

                number of size cells in reg property


         * - ``dmas``
           - ``phandle-array``
           - .. code-block:: none

                DMA channels specifiers


         * - ``dma-names``
           - ``string-array``
           - .. code-block:: none

                Provided names of DMA channel specifiers


         * - ``io-channels``
           - ``phandle-array``
           - .. code-block:: none

                IO channels specifiers


         * - ``io-channel-names``
           - ``string-array``
           - .. code-block:: none

                Provided names of IO channel specifiers


         * - ``mboxes``
           - ``phandle-array``
           - .. code-block:: none

                mailbox / IPM channels specifiers


         * - ``mbox-names``
           - ``string-array``
           - .. code-block:: none

                Provided names of mailbox / IPM channel specifiers


         * - ``wakeup-source``
           - ``boolean``
           - .. code-block:: none

                Property to identify that a device can be used as wake up source.

                When this property is provided a specific flag is set into the
                device that tells the system that the device is capable of
                wake up the system.

                Wake up capable devices are disabled (interruptions will not wake up
                the system) by default but they can be enabled at runtime if necessary.



         * - ``power-domain``
           - ``phandle``
           - .. code-block:: none


                Power domain the device belongs to.

                The device will be notified when the power domain it belongs to is either
                suspended or resumed.






Child node properties
=====================

.. list-table::
   :widths: 1 1 4
   :header-rows: 1

   * - Name
     - Type
     - Details

   * - ``gpios``
     - ``phandle-array``
     - .. code-block:: none

          Array of GPIOs to be forwarded. Note that GPIO flags provided for
          elements of this array are ignored. In order to configure the GPIOs
          from this array, their GPIO flags must be set in the matching
          node that these GPIOs are forwarded to.



       This property is **required**.
```
