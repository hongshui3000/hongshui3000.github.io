## latest/zephyr/_sources/reference/devicetree/bindings/gpio/nuvoton,nct38xx-gpio.rst.txt
```
:orphan:

.. raw:: html

    <!--
    FIXME: do not limit page width until content uses another representation
    format other than tables
    -->
    <style>.wy-nav-content { max-width: none; !important }</style>

.. dtcompatible:: nuvoton,nct38xx-gpio
.. _dtbinding_nuvoton_nct38xx_gpio:

nuvoton,nct38xx-gpio (on i2c bus)
#################################

Vendor: :ref:`Nuvoton Technology Corporation <dt_vendor_nuvoton>`

Description
***********



.. code-block:: none

   Nuvoton NCT38XX series I2C-based GPIO expander

   Example:
     &i2c0_0 {
       nct3807@70 {
         #address-cells = <1>;
         #size-cells = <0>;
         compatible = "nuvoton,nct38xx-gpio";
         reg = <0x70>;
         label = "NCT3807_0";

         gpio@0 {
           compatible = "nuvoton,nct38xx-gpio-port";
           reg = <0x0>;
           label = "NCT3807_0_GPIO0";
           gpio-controller;
           #gpio-cells = <2>;
           ngpios = <8>;
           pin_mask = <0xff>;
           pinmux_mask = <0xf7>;
         };

         gpio@1 {
           compatible = "nuvoton,nct38xx-gpio-port";
           reg = <0x1>;
           label = "NCT3807_0_GPIO1";
           gpio-controller;
           #gpio-cells = <2>;
           ngpios = <8>;
           pin_mask = <0xff>;
         };
       };

       nct3808_0_P1@71 {
         #address-cells = <1>;
         #size-cells = <0>;
         compatible = "nuvoton,nct38xx-gpio";
         reg = <0x71>;
         label = "NCT3808_0_P1";

         gpio@0 {
           compatible = "nuvoton,nct38xx-gpio-port";
           reg = <0x0>;
           label = "NCT3808_0_P1_GPIO0";
           gpio-controller;
           #gpio-cells = <2>;
           ngpios = <8>;
           pin_mask = <0xdc>;
           pinmux_mask = <0xff>;
         };
       };

       nct3808_0_P2@75 {
         #address-cells = <1>;
         #size-cells = <0>;
         compatible = "nuvoton,nct38xx-gpio";
         reg = <0x75>;
         label = "NCT3808_0_P2";

         gpio@0 {
           compatible = "nuvoton,nct38xx-gpio-port";
           reg = <0x0>;
           label = "NCT3808_0_P2_GPIO0";
           gpio-controller;
           #gpio-cells = <2>;
           ngpios = <8>;
           pin_mask = <0xdc>;
           pinmux_mask = <0xff>;
         };
       };
     };

Properties
**********

.. tabs::

   .. group-tab:: Node specific properties

      Properties not inherited from the base binding file.

      .. list-table::
         :widths: 1 1 4
         :header-rows: 1

         * - Name
           - Type
           - Details

         * - ``supply-gpios``
           - ``phandle-array``
           - .. code-block:: none

                GPIO specifier that controls power to the device.

                This property should be provided when the device has a dedicated
                switch that controls power to the device.  The supply state is
                entirely the responsibility of the device driver.

                Contrast with vin-supply.



         * - ``vin-supply``
           - ``phandle``
           - .. code-block:: none

                Reference to the regulator that controls power to the device.
                The referenced devicetree node must have a regulator compatible.

                This property should be provided when device power is supplied
                by a shared regulator.  The supply state is dependent on the
                request status of all devices fed by the regulator.

                Contrast with supply-gpios.  If both properties are provided
                then the regulator must be requested before the supply GPIOS is
                set to an active state, and the supply GPIOS must be set to an
                inactive state before releasing the regulator.





   .. group-tab:: Deprecated node specific properties

      Deprecated properties not inherited from the base binding file.

      (None)

   .. group-tab:: Base properties

      Properties inherited from the base binding file, which defines
      common properties that may be set on many nodes. Not all of these
      may apply to the "nuvoton,nct38xx-gpio" compatible.

      .. list-table::
         :widths: 1 1 4
         :header-rows: 1

         * - Name
           - Type
           - Details

         * - ``label``
           - ``string``
           - .. code-block:: none

                Human readable string describing the device (used as device_get_binding() argument)


             This property is **required**.

             See :ref:`dt-important-props` for more information.

         * - ``reg``
           - ``array``
           - .. code-block:: none

                device address on i2c bus


             This property is **required**.

             See :ref:`dt-important-props` for more information.

         * - ``status``
           - ``string``
           - .. code-block:: none

                indicates the operational status of a device


             Legal values: ``'ok'``, ``'okay'``, ``'disabled'``, ``'reserved'``, ``'fail'``, ``'fail-sss'``

             See :ref:`dt-important-props` for more information.

         * - ``compatible``
           - ``string-array``
           - .. code-block:: none

                compatible strings


             This property is **required**.

             See :ref:`dt-important-props` for more information.

         * - ``reg-names``
           - ``string-array``
           - .. code-block:: none

                name of each register space


         * - ``interrupts``
           - ``array``
           - .. code-block:: none

                interrupts for device


             See :ref:`dt-important-props` for more information.

         * - ``interrupts-extended``
           - ``compound``
           - .. code-block:: none

                extended interrupt specifier for device


         * - ``interrupt-names``
           - ``string-array``
           - .. code-block:: none

                name of each interrupt


         * - ``interrupt-parent``
           - ``phandle``
           - .. code-block:: none

                phandle to interrupt controller node


         * - ``clocks``
           - ``phandle-array``
           - .. code-block:: none

                Clock gate information


         * - ``clock-names``
           - ``string-array``
           - .. code-block:: none

                name of each clock


         * - ``#address-cells``
           - ``int``
           - .. code-block:: none

                number of address cells in reg property


         * - ``#size-cells``
           - ``int``
           - .. code-block:: none

                number of size cells in reg property


         * - ``dmas``
           - ``phandle-array``
           - .. code-block:: none

                DMA channels specifiers


         * - ``dma-names``
           - ``string-array``
           - .. code-block:: none

                Provided names of DMA channel specifiers


         * - ``io-channels``
           - ``phandle-array``
           - .. code-block:: none

                IO channels specifiers


         * - ``io-channel-names``
           - ``string-array``
           - .. code-block:: none

                Provided names of IO channel specifiers


         * - ``mboxes``
           - ``phandle-array``
           - .. code-block:: none

                mailbox / IPM channels specifiers


         * - ``mbox-names``
           - ``string-array``
           - .. code-block:: none

                Provided names of mailbox / IPM channel specifiers


         * - ``wakeup-source``
           - ``boolean``
           - .. code-block:: none

                Property to identify that a device can be used as wake up source.

                When this property is provided a specific flag is set into the
                device that tells the system that the device is capable of
                wake up the system.

                Wake up capable devices are disabled (interruptions will not wake up
                the system) by default but they can be enabled at runtime if necessary.



         * - ``power-domain``
           - ``phandle``
           - .. code-block:: none


                Power domain the device belongs to.

                The device will be notified when the power domain it belongs to is either
                suspended or resumed.
```

## latest/zephyr/_sources/reference/devicetree/bindings/gpio/particle-gen3-header.rst.txt
```
:orphan:

.. raw:: html

    <!--
    FIXME: do not limit page width until content uses another representation
    format other than tables
    -->
    <style>.wy-nav-content { max-width: none; !important }</style>

.. dtcompatible:: particle-gen3-header
.. _dtbinding_particle_gen3_header:

particle-gen3-header
####################

Vendor: :ref:`Generic or vendor-independent <dt_no_vendor>`

Description
***********



.. code-block:: none

   GPIO pins exposed on Particle Gen3 (Feather) headers.

   The Particle Gen3 boards are compatible with the Adafruit Feather
   "shields" but use a different orientation and pin numbering scheme.

   With the board oriented with the micro USB at the top:
   * A 12-pin header on the right.  9 pins on this header are exposed
     by this binding
   * A 16-pin header.  13 pins on this header are exposed by this
     binding.

   This binding provides a nexus mapping for 22 pins where parent pins
   0 through 8 correspond to the pins on the 12-pin header, starting
   from the bottom; and pins 9 through 21 correspond to pins on the
   16-pin header, skipping the bottom pin then assigning 9 through 19,
   skipping over GND, and replacing the lower 3V3 with pin 20.  The
   physical layout is depicted below.

       21 RESETn
       -  3V3
       20 MODEn
       -  GND
       19 ADC0                  LiPo+   -
       18 ADC1                  ENABLE  -
       17 ADC2                  VBUS    -
       16 ADC3                  PWM1    8
       15 ADC4                  PWM0    7
       14 SS                    PWM1    6
       13 SCK                   PWM1    5
       12 MOSI                  PWM1    4
       11 MISO                  PWM3    3
       10 RX                    PWM3    2
        9 TX                    SCL     1
       -  n/c                   SDA     0

Properties
**********

.. tabs::

   .. group-tab:: Node specific properties

      Properties not inherited from the base binding file.

      .. list-table::
         :widths: 1 1 4
         :header-rows: 1

         * - Name
           - Type
           - Details

         * - ``gpio-map``
           - ``compound``
           - This property is **required**.

         * - ``gpio-map-mask``
           - ``compound``
           - 

         * - ``gpio-map-pass-thru``
           - ``compound``
           - 

         * - ``#gpio-cells``
           - ``int``
           - .. code-block:: none

                Number of items to expect in a GPIO specifier


             This property is **required**.



   .. group-tab:: Deprecated node specific properties

      Deprecated properties not inherited from the base binding file.

      (None)

   .. group-tab:: Base properties

      Properties inherited from the base binding file, which defines
      common properties that may be set on many nodes. Not all of these
      may apply to the "particle-gen3-header" compatible.

      .. list-table::
         :widths: 1 1 4
         :header-rows: 1

         * - Name
           - Type
           - Details

         * - ``status``
           - ``string``
           - .. code-block:: none

                indicates the operational status of a device


             Legal values: ``'ok'``, ``'okay'``, ``'disabled'``, ``'reserved'``, ``'fail'``, ``'fail-sss'``

             See :ref:`dt-important-props` for more information.

         * - ``compatible``
           - ``string-array``
           - .. code-block:: none

                compatible strings


             This property is **required**.

             See :ref:`dt-important-props` for more information.

         * - ``reg``
           - ``array``
           - .. code-block:: none

                register space


             See :ref:`dt-important-props` for more information.

         * - ``reg-names``
           - ``string-array``
           - .. code-block:: none

                name of each register space


         * - ``interrupts``
           - ``array``
           - .. code-block:: none

                interrupts for device


             See :ref:`dt-important-props` for more information.

         * - ``interrupts-extended``
           - ``compound``
           - .. code-block:: none

                extended interrupt specifier for device


         * - ``interrupt-names``
           - ``string-array``
           - .. code-block:: none

                name of each interrupt


         * - ``interrupt-parent``
           - ``phandle``
           - .. code-block:: none

                phandle to interrupt controller node


         * - ``label``
           - ``string``
           - .. code-block:: none

                Human readable string describing the device (used as device_get_binding() argument)


             See :ref:`dt-important-props` for more information.

         * - ``clocks``
           - ``phandle-array``
           - .. code-block:: none

                Clock gate information


         * - ``clock-names``
           - ``string-array``
           - .. code-block:: none

                name of each clock


         * - ``#address-cells``
           - ``int``
           - .. code-block:: none

                number of address cells in reg property


         * - ``#size-cells``
           - ``int``
           - .. code-block:: none

                number of size cells in reg property


         * - ``dmas``
           - ``phandle-array``
           - .. code-block:: none

                DMA channels specifiers


         * - ``dma-names``
           - ``string-array``
           - .. code-block:: none

                Provided names of DMA channel specifiers


         * - ``io-channels``
           - ``phandle-array``
           - .. code-block:: none

                IO channels specifiers


         * - ``io-channel-names``
           - ``string-array``
           - .. code-block:: none

                Provided names of IO channel specifiers


         * - ``mboxes``
           - ``phandle-array``
           - .. code-block:: none

                mailbox / IPM channels specifiers


         * - ``mbox-names``
           - ``string-array``
           - .. code-block:: none

                Provided names of mailbox / IPM channel specifiers


         * - ``wakeup-source``
           - ``boolean``
           - .. code-block:: none

                Property to identify that a device can be used as wake up source.

                When this property is provided a specific flag is set into the
                device that tells the system that the device is capable of
                wake up the system.

                Wake up capable devices are disabled (interruptions will not wake up
                the system) by default but they can be enabled at runtime if necessary.



         * - ``power-domain``
           - ``phandle``
           - .. code-block:: none


                Power domain the device belongs to.

                The device will be notified when the power domain it belongs to is either
                suspended or resumed.
```
