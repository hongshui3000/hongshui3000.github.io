## latest/zephyr/_sources/reference/devicetree/bindings/i2c/nordic,nrf-twi.rst.txt
```
:orphan:

.. raw:: html

    <!--
    FIXME: do not limit page width until content uses another representation
    format other than tables
    -->
    <style>.wy-nav-content { max-width: none; !important }</style>

.. dtcompatible:: nordic,nrf-twi
.. _dtbinding_nordic_nrf_twi:

nordic,nrf-twi
##############

Vendor: :ref:`Nordic Semiconductor <dt_vendor_nordic>`

Description
***********

These nodes are "i2c" bus nodes.

.. code-block:: none

   Nordic nRF family TWI (TWI master).

   This binding can be used for nodes which can represent TWI
   peripherals. When a single SoC peripheral ID corresponds to multiple
   I2C peripherals (like TWI or TWIM), the corresponding devicetree
   nodes must be set up to select TWI before use.

   To select TWI, set the node's "compatible" to "nordic,nrf-twi" and
   its "status" to "okay", e.g. using an overlay file like this:

       /* This is for TWI0 -- change to "i2c1" for TWI1. */
       &i2c0 {
               compatible = "nordic,nrf-twi";
               status = "okay";
               /* other property settings can go here */
       };

   You can use either of these options to check TWI availability on
   your SoC:

       1. Check the peripheral Instantiation table in the Memory
          section of your SoC's Product Specification document.
          A "TWI0" instance in the table means "i2c0" in the devicetree
          can be used with this binding, and similarly for "TWI1".

       2. Open your SoC's .dtsi file and look for a node definition that
          documents TWI support, like this:

              i2c0: i2c@40003000 {
                      /*
                       * This i2c node can be TWI, [...].
                       */
                      ...
              };

    If your SoC only has TWIM and TWIS I2C peripherals, you cannot use
    this binding. See the "nordic,nrf-twim" binding instead.

Properties
**********

.. tabs::

   .. group-tab:: Node specific properties

      Properties not inherited from the base binding file.

      .. list-table::
         :widths: 1 1 4
         :header-rows: 1

         * - Name
           - Type
           - Details

         * - ``sda-pin``
           - ``int``
           - .. code-block:: none

                IMPORTANT: This option will only be used if the new pin control driver
                is not enabled. It will be deprecated in the future.

                The SDA pin to use.

                For pins P0.0 through P0.31, use the pin number. For example,
                to use P0.16 for SDA, set:

                    sda-pin = <16>;

                For pins P1.0 through P1.31, add 32 to the pin number. For
                example, to use P1.2 for SDA, set:

                    sda-pin = <34>;  /* 32 + 2 */



         * - ``scl-pin``
           - ``int``
           - .. code-block:: none

                IMPORTANT: This option will only be used if the new pin control driver
                is not enabled. It will be deprecated in the future.

                The SCL pin to use. The pin numbering scheme is the same as
                the sda-pin property's.



         * - ``clock-frequency``
           - ``int``
           - .. code-block:: none

                Initial clock frequency in Hz


         * - ``pinctrl-0``
           - ``phandles``
           - .. code-block:: none

                Pin configuration/s for the first state. Content is specific to the
                selected pin controller driver implementation.



         * - ``pinctrl-1``
           - ``phandles``
           - .. code-block:: none

                Pin configuration/s for the second state. See pinctrl-0.



         * - ``pinctrl-2``
           - ``phandles``
           - .. code-block:: none

                Pin configuration/s for the third state. See pinctrl-0.



         * - ``pinctrl-3``
           - ``phandles``
           - .. code-block:: none

                Pin configuration/s for the fourth state. See pinctrl-0.



         * - ``pinctrl-4``
           - ``phandles``
           - .. code-block:: none

                Pin configuration/s for the fifth state. See pinctrl-0.



         * - ``pinctrl-names``
           - ``string-array``
           - .. code-block:: none

                Names for the provided states. The number of names needs to match the
                number of states.





   .. group-tab:: Deprecated node specific properties

      Deprecated properties not inherited from the base binding file.

      (None)

   .. group-tab:: Base properties

      Properties inherited from the base binding file, which defines
      common properties that may be set on many nodes. Not all of these
      may apply to the "nordic,nrf-twi" compatible.

      .. list-table::
         :widths: 1 1 4
         :header-rows: 1

         * - Name
           - Type
           - Details

         * - ``reg``
           - ``array``
           - .. code-block:: none

                register space


             This property is **required**.

             See :ref:`dt-important-props` for more information.

         * - ``interrupts``
           - ``array``
           - .. code-block:: none

                interrupts for device


             This property is **required**.

             See :ref:`dt-important-props` for more information.

         * - ``#address-cells``
           - ``int``
           - .. code-block:: none

                number of address cells in reg property


             This property is **required**.

             Constant value: ``1``

         * - ``#size-cells``
           - ``int``
           - .. code-block:: none

                number of size cells in reg property


             This property is **required**.

         * - ``label``
           - ``string``
           - .. code-block:: none

                Human readable string describing the device (used as device_get_binding() argument)


             This property is **required**.

             See :ref:`dt-important-props` for more information.

         * - ``status``
           - ``string``
           - .. code-block:: none

                indicates the operational status of a device


             Legal values: ``'ok'``, ``'okay'``, ``'disabled'``, ``'reserved'``, ``'fail'``, ``'fail-sss'``

             See :ref:`dt-important-props` for more information.

         * - ``compatible``
           - ``string-array``
           - .. code-block:: none

                compatible strings


             This property is **required**.

             See :ref:`dt-important-props` for more information.

         * - ``reg-names``
           - ``string-array``
           - .. code-block:: none

                name of each register space


         * - ``interrupts-extended``
           - ``compound``
           - .. code-block:: none

                extended interrupt specifier for device


         * - ``interrupt-names``
           - ``string-array``
           - .. code-block:: none

                name of each interrupt


         * - ``interrupt-parent``
           - ``phandle``
           - .. code-block:: none

                phandle to interrupt controller node


         * - ``clocks``
           - ``phandle-array``
           - .. code-block:: none

                Clock gate information


         * - ``clock-names``
           - ``string-array``
           - .. code-block:: none

                name of each clock


         * - ``dmas``
           - ``phandle-array``
           - .. code-block:: none

                DMA channels specifiers


         * - ``dma-names``
           - ``string-array``
           - .. code-block:: none

                Provided names of DMA channel specifiers


         * - ``io-channels``
           - ``phandle-array``
           - .. code-block:: none

                IO channels specifiers


         * - ``io-channel-names``
           - ``string-array``
           - .. code-block:: none

                Provided names of IO channel specifiers


         * - ``mboxes``
           - ``phandle-array``
           - .. code-block:: none

                mailbox / IPM channels specifiers


         * - ``mbox-names``
           - ``string-array``
           - .. code-block:: none

                Provided names of mailbox / IPM channel specifiers


         * - ``wakeup-source``
           - ``boolean``
           - .. code-block:: none

                Property to identify that a device can be used as wake up source.

                When this property is provided a specific flag is set into the
                device that tells the system that the device is capable of
                wake up the system.

                Wake up capable devices are disabled (interruptions will not wake up
                the system) by default but they can be enabled at runtime if necessary.



         * - ``power-domain``
           - ``phandle``
           - .. code-block:: none


                Power domain the device belongs to.

                The device will be notified when the power domain it belongs to is either
                suspended or resumed.
```
