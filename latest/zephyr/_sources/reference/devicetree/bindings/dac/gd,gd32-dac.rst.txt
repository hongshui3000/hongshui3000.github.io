## latest/zephyr/_sources/reference/devicetree/bindings/display/ftdi,ft800.rst.txt
```
:orphan:

.. raw:: html

    <!--
    FIXME: do not limit page width until content uses another representation
    format other than tables
    -->
    <style>.wy-nav-content { max-width: none; !important }</style>

.. dtcompatible:: ftdi,ft800
.. _dtbinding_ftdi_ft800:

ftdi,ft800 (on spi bus)
#######################

Vendor: :ref:`Future Technology Devices International Ltd. <dt_vendor_ftdi>`

Description
***********



.. code-block:: none

   FTDI FT800 graphic controller

Properties
**********

.. tabs::

   .. group-tab:: Node specific properties

      Properties not inherited from the base binding file.

      .. list-table::
         :widths: 1 1 4
         :header-rows: 1

         * - Name
           - Type
           - Details

         * - ``irq-gpios``
           - ``phandle-array``
           - .. code-block:: none

                Optional IRQ line of FT800 controller


         * - ``pclk``
           - ``int``
           - .. code-block:: none

                The value to divide the main clock by for PCLK. If the
                typical main clock was 48MHz and this value is 5, the PCLK
                will be 9.6 MHz. Must be positive value to enable the screen



             This property is **required**.

         * - ``pclk_pol``
           - ``int``
           - .. code-block:: none

                Polarity of PCLK. If it is set to zero, PCLK polarity is on
                the rising edge. If it is set to one, PCLK polarity is on
                the falling edge.



             This property is **required**.

         * - ``cspread``
           - ``int``
           - .. code-block:: none

                Controls the transition of RGB signals with PCLK active clock
                edge. When set to 0, R[7:2],G[7:2] and B[7:2] signals change
                following the active edge of PCLK. When set to 1, R[7:2]
                changes a PCLK clock early and B[7:2] a PCLK clock later,
                which helps reduce the system noise.



             This property is **required**.

         * - ``swizzle``
           - ``int``
           - .. code-block:: none

                Controls the arrangement of output RGB pins, which may help
                support different LCD panel. Please check FT800 Programmers
                Guide for details.



             This property is **required**.

         * - ``vsize``
           - ``int``
           - .. code-block:: none

                Number of visible lines of pixels in one frame


             This property is **required**.

         * - ``voffset``
           - ``int``
           - .. code-block:: none

                Number of invisible lines at the beginning of a new frame


             This property is **required**.

         * - ``vcycle``
           - ``int``
           - .. code-block:: none

                Number of all lines in a frame. It includes all visible and
                invisible lines at the beginning and at the end of a frame.



             This property is **required**.

         * - ``vsync0``
           - ``int``
           - .. code-block:: none

                Number of lines for the high state of signal VSYNC at
                the start of new frame.



             This property is **required**.

         * - ``vsync1``
           - ``int``
           - .. code-block:: none

                Number of lines for signal VSYNC toggle takes at the start
                of new frame.



             This property is **required**.

         * - ``hsize``
           - ``int``
           - .. code-block:: none

                Number of PCLK cycles per visible part of horizontal line


             This property is **required**.

         * - ``hoffset``
           - ``int``
           - .. code-block:: none

                Number of PCLK cycles before pixels are scanned out for
                given line



             This property is **required**.

         * - ``hcycle``
           - ``int``
           - .. code-block:: none

                Number of total PCLK cycles per horizontal line scan.


             This property is **required**.

         * - ``hsync0``
           - ``int``
           - .. code-block:: none

                Number of PCLK cycles of HSYNC high state during start of line


             This property is **required**.

         * - ``hsync1``
           - ``int``
           - .. code-block:: none

                Number of PCLK cycles for HSYNC toggle during start of line.


             This property is **required**.

         * - ``spi-max-frequency``
           - ``int``
           - .. code-block:: none

                Maximum clock frequency of device's SPI interface in Hz


             This property is **required**.

         * - ``duplex``
           - ``int``
           - .. code-block:: none

                Duplex mode, full or half. By default it's always full duplex thus 0
                as this is, by far, the most common mode.
                Use the macros not the actual enum value, here is the concordance
                list (see dt-bindings/spi/spi.h)
                  0    SPI_FULL_DUPLEX
                  2048 SPI_HALF_DUPLEX



             Legal values: ``0``, ``2048``

         * - ``frame-format``
           - ``int``
           - .. code-block:: none

                Motorola or TI frame format. By default it's always Motorola's,
                thus 0 as this is, by far, the most common format.
                Use the macros not the actual enum value, here is the concordance
                list (see dt-bindings/spi/spi.h)
                  0     SPI_FRAME_FORMAT_MOTOROLA
                  32768 SPI_FRAME_FORMAT_TI



             Legal values: ``0``, ``32768``

         * - ``supply-gpios``
           - ``phandle-array``
           - .. code-block:: none

                GPIO specifier that controls power to the device.

                This property should be provided when the device has a dedicated
                switch that controls power to the device.  The supply state is
                entirely the responsibility of the device driver.

                Contrast with vin-supply.



         * - ``vin-supply``
           - ``phandle``
           - .. code-block:: none

                Reference to the regulator that controls power to the device.
                The referenced devicetree node must have a regulator compatible.

                This property should be provided when device power is supplied
                by a shared regulator.  The supply state is dependent on the
                request status of all devices fed by the regulator.

                Contrast with supply-gpios.  If both properties are provided
                then the regulator must be requested before the supply GPIOS is
                set to an active state, and the supply GPIOS must be set to an
                inactive state before releasing the regulator.





   .. group-tab:: Deprecated node specific properties

      Deprecated properties not inherited from the base binding file.

      (None)

   .. group-tab:: Base properties

      Properties inherited from the base binding file, which defines
      common properties that may be set on many nodes. Not all of these
      may apply to the "ftdi,ft800" compatible.

      .. list-table::
         :widths: 1 1 4
         :header-rows: 1

         * - Name
           - Type
           - Details

         * - ``reg``
           - ``array``
           - .. code-block:: none

                register space


             This property is **required**.

             See :ref:`dt-important-props` for more information.

         * - ``label``
           - ``string``
           - .. code-block:: none

                Human readable string describing the device (used as device_get_binding() argument)


             This property is **required**.

             See :ref:`dt-important-props` for more information.

         * - ``status``
           - ``string``
           - .. code-block:: none

                indicates the operational status of a device


             Legal values: ``'ok'``, ``'okay'``, ``'disabled'``, ``'reserved'``, ``'fail'``, ``'fail-sss'``

             See :ref:`dt-important-props` for more information.

         * - ``compatible``
           - ``string-array``
           - .. code-block:: none

                compatible strings


             This property is **required**.

             See :ref:`dt-important-props` for more information.

         * - ``reg-names``
           - ``string-array``
           - .. code-block:: none

                name of each register space


         * - ``interrupts``
           - ``array``
           - .. code-block:: none

                interrupts for device


             See :ref:`dt-important-props` for more information.

         * - ``interrupts-extended``
           - ``compound``
           - .. code-block:: none

                extended interrupt specifier for device


         * - ``interrupt-names``
           - ``string-array``
           - .. code-block:: none

                name of each interrupt


         * - ``interrupt-parent``
           - ``phandle``
           - .. code-block:: none

                phandle to interrupt controller node


         * - ``clocks``
           - ``phandle-array``
           - .. code-block:: none

                Clock gate information


         * - ``clock-names``
           - ``string-array``
           - .. code-block:: none

                name of each clock


         * - ``#address-cells``
           - ``int``
           - .. code-block:: none

                number of address cells in reg property


         * - ``#size-cells``
           - ``int``
           - .. code-block:: none

                number of size cells in reg property


         * - ``dmas``
           - ``phandle-array``
           - .. code-block:: none

                DMA channels specifiers


         * - ``dma-names``
           - ``string-array``
           - .. code-block:: none

                Provided names of DMA channel specifiers


         * - ``io-channels``
           - ``phandle-array``
           - .. code-block:: none

                IO channels specifiers


         * - ``io-channel-names``
           - ``string-array``
           - .. code-block:: none

                Provided names of IO channel specifiers


         * - ``mboxes``
           - ``phandle-array``
           - .. code-block:: none

                mailbox / IPM channels specifiers


         * - ``mbox-names``
           - ``string-array``
           - .. code-block:: none

                Provided names of mailbox / IPM channel specifiers


         * - ``wakeup-source``
           - ``boolean``
           - .. code-block:: none

                Property to identify that a device can be used as wake up source.

                When this property is provided a specific flag is set into the
                device that tells the system that the device is capable of
                wake up the system.

                Wake up capable devices are disabled (interruptions will not wake up
                the system) by default but they can be enabled at runtime if necessary.



         * - ``power-domain``
           - ``phandle``
           - .. code-block:: none


                Power domain the device belongs to.

                The device will be notified when the power domain it belongs to is either
                suspended or resumed.
```
