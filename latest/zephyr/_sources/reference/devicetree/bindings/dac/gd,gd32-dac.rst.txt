## latest/zephyr/_sources/reference/devicetree/bindings/flash_controller/st,stm32-qspi-nor.rst.txt
```
:orphan:

.. raw:: html

    <!--
    FIXME: do not limit page width until content uses another representation
    format other than tables
    -->
    <style>.wy-nav-content { max-width: none; !important }</style>

.. dtcompatible:: st,stm32-qspi-nor
.. _dtbinding_st_stm32_qspi_nor:

st,stm32-qspi-nor (on qspi bus)
###############################

Vendor: :ref:`STMicroelectronics <dt_vendor_st>`

Description
***********



.. code-block:: none

   STM32 QSPI Flash controller supporting the JEDEC CFI interface

   Representation of a serial flash on a quadspi bus:

       mx25r6435f: qspi-nor-flash@0 {
               compatible = "st,stm32-qspi-nor";
               label = "MX25R6435F";
               reg = <0>;
               qspi-max-frequency = <80000000>;
               size = <0x4000000>;
               reset-gpios = <&gpiod 3 GPIO_ACTIVE_LOW>;
               reset-gpios-duration = <1>;
               spi-bus-width = <4>;
               status = "okay";
       };

Properties
**********

.. tabs::

   .. group-tab:: Node specific properties

      Properties not inherited from the base binding file.

      .. list-table::
         :widths: 1 1 4
         :header-rows: 1

         * - Name
           - Type
           - Details

         * - ``qspi-max-frequency``
           - ``int``
           - .. code-block:: none

                Maximum clock frequency of device's QSPI interface in Hz


             This property is **required**.

         * - ``size``
           - ``int``
           - .. code-block:: none

                Flash Memory size in bits


             This property is **required**.

         * - ``reset-gpios``
           - ``phandle-array``
           - .. code-block:: none

                RESETn pin


         * - ``reset-gpios-duration``
           - ``int``
           - .. code-block:: none

                The duration (in ms) for the flash memory reset pulse


         * - ``spi-bus-width``
           - ``int``
           - .. code-block:: none

                The width of (Q)SPI bus to which flash memory is connected. Now only value of 4 (when using SIO[0123]) is supported.


         * - ``jedec-id``
           - ``uint8-array``
           - .. code-block:: none

                JEDEC ID as manufacturer ID, memory type, memory density


         * - ``sfdp-bfp``
           - ``uint8-array``
           - .. code-block:: none

                Contains the 32-bit words in little-endian byte order from the
                JESD216 Serial Flash Discoverable Parameters Basic Flash
                Parameters table.  This provides flash-specific configuration
                information in cases were runtime retrieval of SFDP data
                is not desired.



         * - ``quad-enable-requirements``
           - ``string``
           - .. code-block:: none

                Quad Enable Requirements value from JESD216 BFP DW15.

                Use NONE if the device detects 1-1-4 and 1-4-4 modes by the
                instruction.  Use S1B6 if QE is bit 6 of the first status register
                byte, and can be configured by reading then writing one byte with
                RDSR and WRSR.  For other fields see the specification.



             Legal values: ``'NONE'``, ``'S2B1v1'``, ``'S1B6'``, ``'S2B7'``, ``'S2B1v4'``, ``'S2B1v5'``, ``'S2B1v6'``

         * - ``enter-4byte-addr``
           - ``int``
           - .. code-block:: none

                Enter 4-Byte Addressing value from JESD216 BFP DW16

                This property is ignored if the device is configured to use SFDP data
                from the sfdp-bfp property (CONFIG_SPI_NOR_SFDP_DEVICETREE) or to read
                SFDP properties at runtime (CONFIG_SPI_NOR_SFDP_RUNTIME).

                For CONFIG_SPI_NOR_SFDP_MINIMAL this is the 8-bit value from bits 31:24
                of DW16 identifying ways a device can be placed into 4-byte addressing
                mode.  If provided as a non-zero value the driver assumes that 4-byte
                addressing is require to access the full address range, and
                automatically puts the device into 4-byte address mode when the device
                is initialized.





   .. group-tab:: Deprecated node specific properties

      Deprecated properties not inherited from the base binding file.

      (None)

   .. group-tab:: Base properties

      Properties inherited from the base binding file, which defines
      common properties that may be set on many nodes. Not all of these
      may apply to the "st,stm32-qspi-nor" compatible.

      .. list-table::
         :widths: 1 1 4
         :header-rows: 1

         * - Name
           - Type
           - Details

         * - ``reg``
           - ``array``
           - .. code-block:: none

                register space


             This property is **required**.

             See :ref:`dt-important-props` for more information.

         * - ``label``
           - ``string``
           - .. code-block:: none

                Human readable string describing the device (used as device_get_binding() argument)


             This property is **required**.

             See :ref:`dt-important-props` for more information.

         * - ``status``
           - ``string``
           - .. code-block:: none

                indicates the operational status of a device


             Legal values: ``'ok'``, ``'okay'``, ``'disabled'``, ``'reserved'``, ``'fail'``, ``'fail-sss'``

             See :ref:`dt-important-props` for more information.

         * - ``compatible``
           - ``string-array``
           - .. code-block:: none

                compatible strings


             This property is **required**.

             See :ref:`dt-important-props` for more information.

         * - ``reg-names``
           - ``string-array``
           - .. code-block:: none

                name of each register space


         * - ``interrupts``
           - ``array``
           - .. code-block:: none

                interrupts for device


             See :ref:`dt-important-props` for more information.

         * - ``interrupts-extended``
           - ``compound``
           - .. code-block:: none

                extended interrupt specifier for device


         * - ``interrupt-names``
           - ``string-array``
           - .. code-block:: none

                name of each interrupt


         * - ``interrupt-parent``
           - ``phandle``
           - .. code-block:: none

                phandle to interrupt controller node


         * - ``clocks``
           - ``phandle-array``
           - .. code-block:: none

                Clock gate information


         * - ``clock-names``
           - ``string-array``
           - .. code-block:: none

                name of each clock


         * - ``#address-cells``
           - ``int``
           - .. code-block:: none

                number of address cells in reg property


         * - ``#size-cells``
           - ``int``
           - .. code-block:: none

                number of size cells in reg property


         * - ``dmas``
           - ``phandle-array``
           - .. code-block:: none

                DMA channels specifiers


         * - ``dma-names``
           - ``string-array``
           - .. code-block:: none

                Provided names of DMA channel specifiers


         * - ``io-channels``
           - ``phandle-array``
           - .. code-block:: none

                IO channels specifiers


         * - ``io-channel-names``
           - ``string-array``
           - .. code-block:: none

                Provided names of IO channel specifiers


         * - ``mboxes``
           - ``phandle-array``
           - .. code-block:: none

                mailbox / IPM channels specifiers


         * - ``mbox-names``
           - ``string-array``
           - .. code-block:: none

                Provided names of mailbox / IPM channel specifiers


         * - ``wakeup-source``
           - ``boolean``
           - .. code-block:: none

                Property to identify that a device can be used as wake up source.

                When this property is provided a specific flag is set into the
                device that tells the system that the device is capable of
                wake up the system.

                Wake up capable devices are disabled (interruptions will not wake up
                the system) by default but they can be enabled at runtime if necessary.



         * - ``power-domain``
           - ``phandle``
           - .. code-block:: none


                Power domain the device belongs to.

                The device will be notified when the power domain it belongs to is either
                suspended or resumed.
```

## latest/zephyr/_sources/reference/devicetree/bindings/gpio/adafruit-feather-header.rst.txt
```
:orphan:

.. raw:: html

    <!--
    FIXME: do not limit page width until content uses another representation
    format other than tables
    -->
    <style>.wy-nav-content { max-width: none; !important }</style>

.. dtcompatible:: adafruit-feather-header
.. _dtbinding_adafruit_feather_header:

adafruit-feather-header
#######################

Vendor: :ref:`Generic or vendor-independent <dt_no_vendor>`

Description
***********



.. code-block:: none

   GPIO pins exposed on Adafruit Feather headers.

   The Feather layout provides two headers, one each along
   opposite edges of the board.
   Proceeding counter-clockwise:
   * A 16-pin header.  12 pins on this header are exposed
     by this binding.
   * A 12-pin header.  9 pins on this header are exposed
     by this binding.

   This binding provides a nexus mapping for 21 pins where parent pins 0
   through 5 correspond to A0 through A5, and parent pins 6 through 20
   correspond as depicted below:

       - RESET
       - 3V3
       - 3V3
       - GND
       0 A0                     - VBAT
       1 A1                     - EN
       2 A2                     - VBUS
       3 A3                     D13  20
       4 A4                     D12  19
       5 A5                     D11  18
       6 SCK                    D10  17
       7 MOSI                   D9   16
       8 MISO                   D6   15
       9 RX                     D5   14
      10 TX                     SCL  13
      11 D4                     SDA  12

Properties
**********

.. tabs::

   .. group-tab:: Node specific properties

      Properties not inherited from the base binding file.

      .. list-table::
         :widths: 1 1 4
         :header-rows: 1

         * - Name
           - Type
           - Details

         * - ``gpio-map``
           - ``compound``
           - This property is **required**.

         * - ``gpio-map-mask``
           - ``compound``
           - 

         * - ``gpio-map-pass-thru``
           - ``compound``
           - 

         * - ``#gpio-cells``
           - ``int``
           - .. code-block:: none

                Number of items to expect in a GPIO specifier


             This property is **required**.



   .. group-tab:: Deprecated node specific properties

      Deprecated properties not inherited from the base binding file.

      (None)

   .. group-tab:: Base properties

      Properties inherited from the base binding file, which defines
      common properties that may be set on many nodes. Not all of these
      may apply to the "adafruit-feather-header" compatible.

      .. list-table::
         :widths: 1 1 4
         :header-rows: 1

         * - Name
           - Type
           - Details

         * - ``status``
           - ``string``
           - .. code-block:: none

                indicates the operational status of a device


             Legal values: ``'ok'``, ``'okay'``, ``'disabled'``, ``'reserved'``, ``'fail'``, ``'fail-sss'``

             See :ref:`dt-important-props` for more information.

         * - ``compatible``
           - ``string-array``
           - .. code-block:: none

                compatible strings


             This property is **required**.

             See :ref:`dt-important-props` for more information.

         * - ``reg``
           - ``array``
           - .. code-block:: none

                register space


             See :ref:`dt-important-props` for more information.

         * - ``reg-names``
           - ``string-array``
           - .. code-block:: none

                name of each register space


         * - ``interrupts``
           - ``array``
           - .. code-block:: none

                interrupts for device


             See :ref:`dt-important-props` for more information.

         * - ``interrupts-extended``
           - ``compound``
           - .. code-block:: none

                extended interrupt specifier for device


         * - ``interrupt-names``
           - ``string-array``
           - .. code-block:: none

                name of each interrupt


         * - ``interrupt-parent``
           - ``phandle``
           - .. code-block:: none

                phandle to interrupt controller node


         * - ``label``
           - ``string``
           - .. code-block:: none

                Human readable string describing the device (used as device_get_binding() argument)


             See :ref:`dt-important-props` for more information.

         * - ``clocks``
           - ``phandle-array``
           - .. code-block:: none

                Clock gate information


         * - ``clock-names``
           - ``string-array``
           - .. code-block:: none

                name of each clock


         * - ``#address-cells``
           - ``int``
           - .. code-block:: none

                number of address cells in reg property


         * - ``#size-cells``
           - ``int``
           - .. code-block:: none

                number of size cells in reg property


         * - ``dmas``
           - ``phandle-array``
           - .. code-block:: none

                DMA channels specifiers


         * - ``dma-names``
           - ``string-array``
           - .. code-block:: none

                Provided names of DMA channel specifiers


         * - ``io-channels``
           - ``phandle-array``
           - .. code-block:: none

                IO channels specifiers


         * - ``io-channel-names``
           - ``string-array``
           - .. code-block:: none

                Provided names of IO channel specifiers


         * - ``mboxes``
           - ``phandle-array``
           - .. code-block:: none

                mailbox / IPM channels specifiers


         * - ``mbox-names``
           - ``string-array``
           - .. code-block:: none

                Provided names of mailbox / IPM channel specifiers


         * - ``wakeup-source``
           - ``boolean``
           - .. code-block:: none

                Property to identify that a device can be used as wake up source.

                When this property is provided a specific flag is set into the
                device that tells the system that the device is capable of
                wake up the system.

                Wake up capable devices are disabled (interruptions will not wake up
                the system) by default but they can be enabled at runtime if necessary.



         * - ``power-domain``
           - ``phandle``
           - .. code-block:: none


                Power domain the device belongs to.

                The device will be notified when the power domain it belongs to is either
                suspended or resumed.
```
