## latest/zephyr/_sources/reference/devicetree/bindings/display/nxp,imx-elcdif.rst.txt
```
:orphan:

.. raw:: html

    <!--
    FIXME: do not limit page width until content uses another representation
    format other than tables
    -->
    <style>.wy-nav-content { max-width: none; !important }</style>

.. dtcompatible:: nxp,imx-elcdif
.. _dtbinding_nxp_imx_elcdif:

nxp,imx-elcdif
##############

Vendor: :ref:`NXP Semiconductors <dt_vendor_nxp>`

Description
***********



.. code-block:: none

   NXP i.MX eLCDIF (Enhanced LCD Interface) controller

Properties
**********

.. tabs::

   .. group-tab:: Node specific properties

      Properties not inherited from the base binding file.

      .. list-table::
         :widths: 1 1 4
         :header-rows: 1

         * - Name
           - Type
           - Details

         * - ``hsync``
           - ``int``
           - .. code-block:: none

                HSYNC pulse width in display clock cycles


             This property is **required**.

         * - ``hfp``
           - ``int``
           - .. code-block:: none

                Horizontal front porch in display clock cycles


             This property is **required**.

         * - ``hbp``
           - ``int``
           - .. code-block:: none

                Horizontal back porch in display clock cycles


             This property is **required**.

         * - ``vsync``
           - ``int``
           - .. code-block:: none

                VSYNC pulse width in display clock cycles


             This property is **required**.

         * - ``vfp``
           - ``int``
           - .. code-block:: none

                Vertical front porch in display clock cycles


             This property is **required**.

         * - ``vbp``
           - ``int``
           - .. code-block:: none

                Vertical back porch in display clock cycles


             This property is **required**.

         * - ``polarity``
           - ``int``
           - .. code-block:: none

                OR'ed value of elcdif_polarity_flags, used to control the signal polarity. 0000 VSYNC active low, HSYNC active low, Drive data on falling edge, Data enable active low. 0001 VSYNC active low, HSYNC active low, Drive data on falling edge, Data enable active high. 0010 VSYNC active low, HSYNC active low, Drive data on rising edge, Data enable active low. 0011 VSYNC active low, HSYNC active low, Drive data on rising edge, Data enable active high. 0100 VSYNC active low, HSYNC active high, Drive data on falling edge, Data enable active low. 0101 VSYNC active low, HSYNC active high, Drive data on falling edge, Data enable active high. 0110 VSYNC active low, HSYNC active high, Drive data on rising edge, Data enable active low. 0111 VSYNC active low, HSYNC active high, Drive data on rising edge, Data enable active high. 1000 VSYNC active high, HSYNC active low, Drive data on falling edge, Data enable active low. 1001 VSYNC active high, HSYNC active low, Drive data on falling edge, Data enable active high. 1010 VSYNC active high, HSYNC active low, Drive data on rising edge, Data enable active low. 1011 VSYNC active high, HSYNC active low, Drive data on rising edge, Data enable active high. 1100 VSYNC active high, HSYNC active high, Drive data on falling edge, Data enable active low. 1101 VSYNC active high, HSYNC active high, Drive data on falling edge, Data enable active high. 1110 VSYNC active high, HSYNC active high, Drive data on rising edge, Data enable active low. 1111 VSYNC active high, HSYNC active high, Drive data on rising edge, Data enable active high.


             This property is **required**.

             Legal values: ``0``, ``1``, ``2``, ``3``, ``4``, ``5``, ``6``, ``7``, ``8``, ``9``, ``10``, ``11``, ``12``, ``13``, ``14``, ``15``

         * - ``pixel-format``
           - ``string``
           - .. code-block:: none

                Display pixel format.


             This property is **required**.

             Legal values: ``'rgb-888'``, ``'bgr-565'``

         * - ``data-buswidth``
           - ``string``
           - .. code-block:: none

                LCD data bus width. The default is set to the reset value of 16-bit


             Default value: ``16-bit``

             Legal values: ``'16-bit'``, ``'8-bit'``, ``'18-bit'``, ``'24-bit'``

         * - ``height``
           - ``int``
           - .. code-block:: none

                Height of the panel driven by the controller, with the units in pixels.



             This property is **required**.

         * - ``width``
           - ``int``
           - .. code-block:: none

                Width of the panel driven by the controller, with the units in pixels.



             This property is **required**.



   .. group-tab:: Deprecated node specific properties

      Deprecated properties not inherited from the base binding file.

      (None)

   .. group-tab:: Base properties

      Properties inherited from the base binding file, which defines
      common properties that may be set on many nodes. Not all of these
      may apply to the "nxp,imx-elcdif" compatible.

      .. list-table::
         :widths: 1 1 4
         :header-rows: 1

         * - Name
           - Type
           - Details

         * - ``reg``
           - ``array``
           - .. code-block:: none

                register space


             This property is **required**.

             See :ref:`dt-important-props` for more information.

         * - ``interrupts``
           - ``array``
           - .. code-block:: none

                interrupts for device


             This property is **required**.

             See :ref:`dt-important-props` for more information.

         * - ``label``
           - ``string``
           - .. code-block:: none

                Human readable string describing the device (used as device_get_binding() argument)


             This property is **required**.

             See :ref:`dt-important-props` for more information.

         * - ``status``
           - ``string``
           - .. code-block:: none

                indicates the operational status of a device


             Legal values: ``'ok'``, ``'okay'``, ``'disabled'``, ``'reserved'``, ``'fail'``, ``'fail-sss'``

             See :ref:`dt-important-props` for more information.

         * - ``compatible``
           - ``string-array``
           - .. code-block:: none

                compatible strings


             This property is **required**.

             See :ref:`dt-important-props` for more information.

         * - ``reg-names``
           - ``string-array``
           - .. code-block:: none

                name of each register space


         * - ``interrupts-extended``
           - ``compound``
           - .. code-block:: none

                extended interrupt specifier for device


         * - ``interrupt-names``
           - ``string-array``
           - .. code-block:: none

                name of each interrupt


         * - ``interrupt-parent``
           - ``phandle``
           - .. code-block:: none

                phandle to interrupt controller node


         * - ``clocks``
           - ``phandle-array``
           - .. code-block:: none

                Clock gate information


         * - ``clock-names``
           - ``string-array``
           - .. code-block:: none

                name of each clock


         * - ``#address-cells``
           - ``int``
           - .. code-block:: none

                number of address cells in reg property


         * - ``#size-cells``
           - ``int``
           - .. code-block:: none

                number of size cells in reg property


         * - ``dmas``
           - ``phandle-array``
           - .. code-block:: none

                DMA channels specifiers


         * - ``dma-names``
           - ``string-array``
           - .. code-block:: none

                Provided names of DMA channel specifiers


         * - ``io-channels``
           - ``phandle-array``
           - .. code-block:: none

                IO channels specifiers


         * - ``io-channel-names``
           - ``string-array``
           - .. code-block:: none

                Provided names of IO channel specifiers


         * - ``mboxes``
           - ``phandle-array``
           - .. code-block:: none

                mailbox / IPM channels specifiers


         * - ``mbox-names``
           - ``string-array``
           - .. code-block:: none

                Provided names of mailbox / IPM channel specifiers


         * - ``wakeup-source``
           - ``boolean``
           - .. code-block:: none

                Property to identify that a device can be used as wake up source.

                When this property is provided a specific flag is set into the
                device that tells the system that the device is capable of
                wake up the system.

                Wake up capable devices are disabled (interruptions will not wake up
                the system) by default but they can be enabled at runtime if necessary.



         * - ``power-domain``
           - ``phandle``
           - .. code-block:: none


                Power domain the device belongs to.

                The device will be notified when the power domain it belongs to is either
                suspended or resumed.
```
