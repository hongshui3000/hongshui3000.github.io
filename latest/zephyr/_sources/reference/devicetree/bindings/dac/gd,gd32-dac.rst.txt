## latest/zephyr/_sources/reference/devicetree/bindings/display/nordic,nrf-led-matrix.rst.txt
```
:orphan:

.. raw:: html

    <!--
    FIXME: do not limit page width until content uses another representation
    format other than tables
    -->
    <style>.wy-nav-content { max-width: none; !important }</style>

.. dtcompatible:: nordic,nrf-led-matrix
.. _dtbinding_nordic_nrf_led_matrix:

nordic,nrf-led-matrix
#####################

Vendor: :ref:`Nordic Semiconductor <dt_vendor_nordic>`

Description
***********



.. code-block:: none

   Generic LED matrix driven by nRF SoC GPIOs

Properties
**********

.. tabs::

   .. group-tab:: Node specific properties

      Properties not inherited from the base binding file.

      .. list-table::
         :widths: 1 1 4
         :header-rows: 1

         * - Name
           - Type
           - Details

         * - ``row-gpios``
           - ``phandle-array``
           - .. code-block:: none

                Array of GPIOs to be used as rows of the matrix.



             This property is **required**.

         * - ``col-gpios``
           - ``phandle-array``
           - .. code-block:: none

                Array of GPIOs to be used as columns of the matrix.



             This property is **required**.

         * - ``pixel-mapping``
           - ``uint8-array``
           - .. code-block:: none

                Array of bytes that specify which rows and columns of the matrix
                control its particular pixels, line by line. Each byte in this
                array corresponds to one pixel of the matrix and specifies the row
                index in the high nibble and the column index in the low nibble.

                For example, the following snippet (from the bbc_microbit board DTS):

                  width = <5>;
                  height = <5>;
                  pixel-mapping = [00 13 01 14 02
                                   23 24 25 26 27
                                   ...

                specifies that:
                - pixel (0,0) is controlled by row 0 and column 0
                - pixel (1,0) is controlled by row 1 and column 3
                - pixel (0,1) is controlled by row 2 and column 3
                - pixel (1,1) is controlled by row 2 and column 4
                and so on.



             This property is **required**.

         * - ``refresh-frequency``
           - ``int``
           - .. code-block:: none

                Frequency of refreshing the matrix, in Hz.



             This property is **required**.

         * - ``timer``
           - ``phandle``
           - .. code-block:: none

                Reference to a TIMER instance for controlling refreshing of the matrix.



             This property is **required**.

         * - ``pwm``
           - ``phandle``
           - .. code-block:: none

                Reference to a PWM instance for generating pulse signals on column
                GPIOs. If not provided, GPIOTE and PPI channels are allocated and
                used instead for generating those pulses.



         * - ``pixel-group-size``
           - ``int``
           - .. code-block:: none

                This value specifies the maximum number of LEDs in one row that can
                be lit simultaneously.
                If set to 1, only a single LED is turned on in a particular time slot.
                Bigger values increase the maximum achievable brightness of the LEDs
                and lower the CPU load by decreasing the frequency of execution of
                the timer interrupt handler.
                In case GPIOTE and PPI channels are used for generating the pixel pulse
                signals, the number of channels that need to be allocated is equal to
                this value.
                If GPIOTE and PPI channels are used, the upper limit for the value is
                defined by the number of CC channels in the used timer minus one.
                If PWM is used, the upper limit is the number of PWM channels.



             This property is **required**.

         * - ``height``
           - ``int``
           - .. code-block:: none

                Height of the panel driven by the controller, with the units in pixels.



             This property is **required**.

         * - ``width``
           - ``int``
           - .. code-block:: none

                Width of the panel driven by the controller, with the units in pixels.



             This property is **required**.



   .. group-tab:: Deprecated node specific properties

      Deprecated properties not inherited from the base binding file.

      (None)

   .. group-tab:: Base properties

      Properties inherited from the base binding file, which defines
      common properties that may be set on many nodes. Not all of these
      may apply to the "nordic,nrf-led-matrix" compatible.

      .. list-table::
         :widths: 1 1 4
         :header-rows: 1

         * - Name
           - Type
           - Details

         * - ``label``
           - ``string``
           - .. code-block:: none

                Human readable string describing the device (used as device_get_binding() argument)


             This property is **required**.

             See :ref:`dt-important-props` for more information.

         * - ``status``
           - ``string``
           - .. code-block:: none

                indicates the operational status of a device


             Legal values: ``'ok'``, ``'okay'``, ``'disabled'``, ``'reserved'``, ``'fail'``, ``'fail-sss'``

             See :ref:`dt-important-props` for more information.

         * - ``compatible``
           - ``string-array``
           - .. code-block:: none

                compatible strings


             This property is **required**.

             See :ref:`dt-important-props` for more information.

         * - ``reg``
           - ``array``
           - .. code-block:: none

                register space


             See :ref:`dt-important-props` for more information.

         * - ``reg-names``
           - ``string-array``
           - .. code-block:: none

                name of each register space


         * - ``interrupts``
           - ``array``
           - .. code-block:: none

                interrupts for device


             See :ref:`dt-important-props` for more information.

         * - ``interrupts-extended``
           - ``compound``
           - .. code-block:: none

                extended interrupt specifier for device


         * - ``interrupt-names``
           - ``string-array``
           - .. code-block:: none

                name of each interrupt


         * - ``interrupt-parent``
           - ``phandle``
           - .. code-block:: none

                phandle to interrupt controller node


         * - ``clocks``
           - ``phandle-array``
           - .. code-block:: none

                Clock gate information


         * - ``clock-names``
           - ``string-array``
           - .. code-block:: none

                name of each clock


         * - ``#address-cells``
           - ``int``
           - .. code-block:: none

                number of address cells in reg property


         * - ``#size-cells``
           - ``int``
           - .. code-block:: none

                number of size cells in reg property


         * - ``dmas``
           - ``phandle-array``
           - .. code-block:: none

                DMA channels specifiers


         * - ``dma-names``
           - ``string-array``
           - .. code-block:: none

                Provided names of DMA channel specifiers


         * - ``io-channels``
           - ``phandle-array``
           - .. code-block:: none

                IO channels specifiers


         * - ``io-channel-names``
           - ``string-array``
           - .. code-block:: none

                Provided names of IO channel specifiers


         * - ``mboxes``
           - ``phandle-array``
           - .. code-block:: none

                mailbox / IPM channels specifiers


         * - ``mbox-names``
           - ``string-array``
           - .. code-block:: none

                Provided names of mailbox / IPM channel specifiers


         * - ``wakeup-source``
           - ``boolean``
           - .. code-block:: none

                Property to identify that a device can be used as wake up source.

                When this property is provided a specific flag is set into the
                device that tells the system that the device is capable of
                wake up the system.

                Wake up capable devices are disabled (interruptions will not wake up
                the system) by default but they can be enabled at runtime if necessary.



         * - ``power-domain``
           - ``phandle``
           - .. code-block:: none


                Power domain the device belongs to.

                The device will be notified when the power domain it belongs to is either
                suspended or resumed.
```
