## latest/zephyr/_sources/reference/devicetree/bindings/ethernet/atmel,sam0-gmac.rst.txt
```
:orphan:

.. raw:: html

    <!--
    FIXME: do not limit page width until content uses another representation
    format other than tables
    -->
    <style>.wy-nav-content { max-width: none; !important }</style>

.. dtcompatible:: atmel,sam0-gmac
.. _dtbinding_atmel_sam0_gmac:

atmel,sam0-gmac
###############

Vendor: :ref:`Atmel Corporation <dt_vendor_atmel>`

Description
***********



.. code-block:: none

   Atmel SAM0-family GMAC Ethernet

Properties
**********

.. tabs::

   .. group-tab:: Node specific properties

      Properties not inherited from the base binding file.

      .. list-table::
         :widths: 1 1 4
         :header-rows: 1

         * - Name
           - Type
           - Details

         * - ``num-queues``
           - ``int``
           - .. code-block:: none

                Number of hardware TX and RX queues.



             This property is **required**.

         * - ``max-frame-size``
           - ``int``
           - .. code-block:: none

                Maximum ethernet frame size.  The current ethernet frame sizes
                supported by hardware are 1518, 1536 and 10240 (jumbo frames).  This
                means that normally gmac will reject any frame above max-frame-size
                value.  The default value is 1518, which represents an usual
                IEEE 802.3 ethernet frame:

                  Ethernet Frame [ 14 MAC HEADER | 1500 MTU | 4 FCS ] = 1518 bytes

                When using value 1536 it is possible extend ethernet MAC HEADER up
                to 32 bytes.  The hardware have support to jumbo frames and it can be
                enabled by selecting the value 10240.



             Default value: ``1518``

         * - ``max-speed``
           - ``int``
           - .. code-block:: none

                This specifies maximum speed in Mbit/s supported by the device.  The
                gmac driver supports 10Mbit/s and 100Mbit/s.  Using 100, as default
                value, enables driver to configure 10 and 100Mbit/s speeds.



             Default value: ``100``

         * - ``phy-connection-type``
           - ``string``
           - .. code-block:: none

                Phy connection type define the physical interface connection between
                PHY and MAC.  The default value uses gmac register reset value, which
                represents Reduced Media-Independent Interface (RMII) mode.

                This property must be used with pinctrl-0.



             Default value: ``rmii``

             Legal values: ``'rmii'``, ``'mii'``

         * - ``pinctrl-0``
           - ``phandles``
           - .. code-block:: none

                PIO pin configuration for the various GMAC signals that include GTXCK,
                GTXEN, GTX[3..0], GTXER, GRXCK, GRXDV, GRX[3..0], GRXER, GCRS, GCOL,
                GMDC, and GMDIO.  Which signals are used vary based on if the PHY
                connection is MII or RMII (see datasheet for more details).  We expect
                that the phandles will reference pinctrl nodes.  These nodes will have
                a nodelabel that matches the Atmel SoC HAL defines and be of the form
                p<port><pin><periph>_<inst>_<signal>.

                For example the GMAC on SAME7x would be for RMII
                  pinctrl-0 = <&pd0a_gmac_gtxck &pd1a_gmac_gtxen
                               &pd2a_gmac_gtx0 &pd3a_gmac_gtx1
                               &pd4a_gmac_grxdv &pd5a_gmac_grx0
                               &pd6a_gmac_grx1 &pd7a_gmac_grxer
                               &pd8a_gmac_gmdc &pd9a_gmac_gmdio>;

                This property must be used with phy-connection-type.



         * - ``local-mac-address``
           - ``uint8-array``
           - .. code-block:: none

                Specifies the MAC address that was assigned to the network device


         * - ``zephyr,random-mac-address``
           - ``boolean``
           - .. code-block:: none

                Use a random MAC address generated when the driver is initialized.
                Note that using this choice and rebooting a board may leave stale
                MAC address in peers' ARP caches and lead to issues and delays in
                communication.  (Use "ip neigh flush all" on Linux peers to clear
                ARP cache.)

                It is driver specific how the OUI octets are handled.

                If set we ignore any setting of the local-mac-address property.





   .. group-tab:: Deprecated node specific properties

      Deprecated properties not inherited from the base binding file.

      (None)

   .. group-tab:: Base properties

      Properties inherited from the base binding file, which defines
      common properties that may be set on many nodes. Not all of these
      may apply to the "atmel,sam0-gmac" compatible.

      .. list-table::
         :widths: 1 1 4
         :header-rows: 1

         * - Name
           - Type
           - Details

         * - ``reg``
           - ``array``
           - .. code-block:: none

                register space


             This property is **required**.

             See :ref:`dt-important-props` for more information.

         * - ``label``
           - ``string``
           - .. code-block:: none

                Human readable string describing the device (used as device_get_binding() argument)


             This property is **required**.

             See :ref:`dt-important-props` for more information.

         * - ``status``
           - ``string``
           - .. code-block:: none

                indicates the operational status of a device


             Legal values: ``'ok'``, ``'okay'``, ``'disabled'``, ``'reserved'``, ``'fail'``, ``'fail-sss'``

             See :ref:`dt-important-props` for more information.

         * - ``compatible``
           - ``string-array``
           - .. code-block:: none

                compatible strings


             This property is **required**.

             See :ref:`dt-important-props` for more information.

         * - ``reg-names``
           - ``string-array``
           - .. code-block:: none

                name of each register space


         * - ``interrupts``
           - ``array``
           - .. code-block:: none

                interrupts for device


             See :ref:`dt-important-props` for more information.

         * - ``interrupts-extended``
           - ``compound``
           - .. code-block:: none

                extended interrupt specifier for device


         * - ``interrupt-names``
           - ``string-array``
           - .. code-block:: none

                name of each interrupt


         * - ``interrupt-parent``
           - ``phandle``
           - .. code-block:: none

                phandle to interrupt controller node


         * - ``clocks``
           - ``phandle-array``
           - .. code-block:: none

                Clock gate information


         * - ``clock-names``
           - ``string-array``
           - .. code-block:: none

                name of each clock


         * - ``#address-cells``
           - ``int``
           - .. code-block:: none

                number of address cells in reg property


         * - ``#size-cells``
           - ``int``
           - .. code-block:: none

                number of size cells in reg property


         * - ``dmas``
           - ``phandle-array``
           - .. code-block:: none

                DMA channels specifiers


         * - ``dma-names``
           - ``string-array``
           - .. code-block:: none

                Provided names of DMA channel specifiers


         * - ``io-channels``
           - ``phandle-array``
           - .. code-block:: none

                IO channels specifiers


         * - ``io-channel-names``
           - ``string-array``
           - .. code-block:: none

                Provided names of IO channel specifiers


         * - ``mboxes``
           - ``phandle-array``
           - .. code-block:: none

                mailbox / IPM channels specifiers


         * - ``mbox-names``
           - ``string-array``
           - .. code-block:: none

                Provided names of mailbox / IPM channel specifiers


         * - ``wakeup-source``
           - ``boolean``
           - .. code-block:: none

                Property to identify that a device can be used as wake up source.

                When this property is provided a specific flag is set into the
                device that tells the system that the device is capable of
                wake up the system.

                Wake up capable devices are disabled (interruptions will not wake up
                the system) by default but they can be enabled at runtime if necessary.



         * - ``power-domain``
           - ``phandle``
           - .. code-block:: none


                Power domain the device belongs to.

                The device will be notified when the power domain it belongs to is either
                suspended or resumed.
```
