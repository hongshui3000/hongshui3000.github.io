## latest/zephyr/_sources/reference/devicetree/bindings/display/sitronix,st7735r.rst.txt
```
:orphan:

.. raw:: html

    <!--
    FIXME: do not limit page width until content uses another representation
    format other than tables
    -->
    <style>.wy-nav-content { max-width: none; !important }</style>

.. dtcompatible:: sitronix,st7735r
.. _dtbinding_sitronix_st7735r:

sitronix,st7735r (on spi bus)
#############################

Vendor: :ref:`Sitronix Technology Corporation <dt_vendor_sitronix>`

Description
***********



.. code-block:: none

   ST7735R 160x128 display controller

Properties
**********

.. tabs::

   .. group-tab:: Node specific properties

      Properties not inherited from the base binding file.

      .. list-table::
         :widths: 1 1 4
         :header-rows: 1

         * - Name
           - Type
           - Details

         * - ``reset-gpios``
           - ``phandle-array``
           - .. code-block:: none

                RESET pin.
                The RESET pin of ST7735R is active low. If connected directly the MCU pin should be configured as active low.


             This property is **required**.

         * - ``cmd-data-gpios``
           - ``phandle-array``
           - .. code-block:: none

                D/CX pin.
                The D/CX pin of ST7735R is active low (transmission command byte). If connected directly the MCU pin should be configured as active low.


             This property is **required**.

         * - ``x-offset``
           - ``int``
           - .. code-block:: none

                The column offset in pixels of the LCD to the controller memory


             This property is **required**.

         * - ``y-offset``
           - ``int``
           - .. code-block:: none

                The row offset in pixels of the LCD to the controller memory


             This property is **required**.

         * - ``madctl``
           - ``int``
           - .. code-block:: none

                Memory Data Access Control


         * - ``colmod``
           - ``int``
           - .. code-block:: none

                Interface Pixel Format


             Default value: ``6``

         * - ``pwctr1``
           - ``uint8-array``
           - .. code-block:: none

                Power Control 1 Parameter


             Default value: ``[180, 20, 4]``

         * - ``pwctr2``
           - ``uint8-array``
           - .. code-block:: none

                Power Control 2 Parameter


             Default value: ``[192]``

         * - ``pwctr3``
           - ``uint8-array``
           - .. code-block:: none

                Power Control 3 Parameter


             Default value: ``[10, 0]``

         * - ``pwctr4``
           - ``uint8-array``
           - .. code-block:: none

                Power Control 4 Parameter


             Default value: ``[138, 38]``

         * - ``pwctr5``
           - ``uint8-array``
           - .. code-block:: none

                Power Control 5 Parameter


             Default value: ``[138, 238]``

         * - ``gamctrp1``
           - ``uint8-array``
           - .. code-block:: none

                Positive Voltage Gamma Control Parameter


             This property is **required**.

         * - ``gamctrn1``
           - ``uint8-array``
           - .. code-block:: none

                Negative Voltage Gamma Control Parameter


             This property is **required**.

         * - ``frmctr1``
           - ``uint8-array``
           - .. code-block:: none

                Frame rate control (normal mode / full colors)


             Default value: ``[5, 58, 58]``

         * - ``frmctr2``
           - ``uint8-array``
           - .. code-block:: none

                Frame rate control (idle mode / 8 colors)


             Default value: ``[5, 58, 58]``

         * - ``frmctr3``
           - ``uint8-array``
           - .. code-block:: none

                Frame rate control (partial mode / full colors)


             Default value: ``[5, 58, 58, 5, 58, 58]``

         * - ``caset``
           - ``uint8-array``
           - .. code-block:: none

                Column Address Set


             Default value: ``[0, 0, 0, 127]``

         * - ``raset``
           - ``uint8-array``
           - .. code-block:: none

                Row Address Set


             Default value: ``[0, 0, 0, 159]``

         * - ``vmctr1``
           - ``int``
           - .. code-block:: none

                VCOM Control 1


             Default value: ``10``

         * - ``invctr``
           - ``int``
           - .. code-block:: none

                Display Inversion Control


             Default value: ``7``

         * - ``spi-max-frequency``
           - ``int``
           - .. code-block:: none

                Maximum clock frequency of device's SPI interface in Hz


             This property is **required**.

         * - ``duplex``
           - ``int``
           - .. code-block:: none

                Duplex mode, full or half. By default it's always full duplex thus 0
                as this is, by far, the most common mode.
                Use the macros not the actual enum value, here is the concordance
                list (see dt-bindings/spi/spi.h)
                  0    SPI_FULL_DUPLEX
                  2048 SPI_HALF_DUPLEX



             Legal values: ``0``, ``2048``

         * - ``frame-format``
           - ``int``
           - .. code-block:: none

                Motorola or TI frame format. By default it's always Motorola's,
                thus 0 as this is, by far, the most common format.
                Use the macros not the actual enum value, here is the concordance
                list (see dt-bindings/spi/spi.h)
                  0     SPI_FRAME_FORMAT_MOTOROLA
                  32768 SPI_FRAME_FORMAT_TI



             Legal values: ``0``, ``32768``

         * - ``supply-gpios``
           - ``phandle-array``
           - .. code-block:: none

                GPIO specifier that controls power to the device.

                This property should be provided when the device has a dedicated
                switch that controls power to the device.  The supply state is
                entirely the responsibility of the device driver.

                Contrast with vin-supply.



         * - ``vin-supply``
           - ``phandle``
           - .. code-block:: none

                Reference to the regulator that controls power to the device.
                The referenced devicetree node must have a regulator compatible.

                This property should be provided when device power is supplied
                by a shared regulator.  The supply state is dependent on the
                request status of all devices fed by the regulator.

                Contrast with supply-gpios.  If both properties are provided
                then the regulator must be requested before the supply GPIOS is
                set to an active state, and the supply GPIOS must be set to an
                inactive state before releasing the regulator.



         * - ``height``
           - ``int``
           - .. code-block:: none

                Height of the panel driven by the controller, with the units in pixels.



             This property is **required**.

         * - ``width``
           - ``int``
           - .. code-block:: none

                Width of the panel driven by the controller, with the units in pixels.



             This property is **required**.



   .. group-tab:: Deprecated node specific properties

      Deprecated properties not inherited from the base binding file.

      (None)

   .. group-tab:: Base properties

      Properties inherited from the base binding file, which defines
      common properties that may be set on many nodes. Not all of these
      may apply to the "sitronix,st7735r" compatible.

      .. list-table::
         :widths: 1 1 4
         :header-rows: 1

         * - Name
           - Type
           - Details

         * - ``reg``
           - ``array``
           - .. code-block:: none

                register space


             This property is **required**.

             See :ref:`dt-important-props` for more information.

         * - ``label``
           - ``string``
           - .. code-block:: none

                Human readable string describing the device (used as device_get_binding() argument)


             This property is **required**.

             See :ref:`dt-important-props` for more information.

         * - ``status``
           - ``string``
           - .. code-block:: none

                indicates the operational status of a device


             Legal values: ``'ok'``, ``'okay'``, ``'disabled'``, ``'reserved'``, ``'fail'``, ``'fail-sss'``

             See :ref:`dt-important-props` for more information.

         * - ``compatible``
           - ``string-array``
           - .. code-block:: none

                compatible strings


             This property is **required**.

             See :ref:`dt-important-props` for more information.

         * - ``reg-names``
           - ``string-array``
           - .. code-block:: none

                name of each register space


         * - ``interrupts``
           - ``array``
           - .. code-block:: none

                interrupts for device


             See :ref:`dt-important-props` for more information.

         * - ``interrupts-extended``
           - ``compound``
           - .. code-block:: none

                extended interrupt specifier for device


         * - ``interrupt-names``
           - ``string-array``
           - .. code-block:: none

                name of each interrupt


         * - ``interrupt-parent``
           - ``phandle``
           - .. code-block:: none

                phandle to interrupt controller node


         * - ``clocks``
           - ``phandle-array``
           - .. code-block:: none

                Clock gate information


         * - ``clock-names``
           - ``string-array``
           - .. code-block:: none

                name of each clock


         * - ``#address-cells``
           - ``int``
           - .. code-block:: none

                number of address cells in reg property


         * - ``#size-cells``
           - ``int``
           - .. code-block:: none

                number of size cells in reg property


         * - ``dmas``
           - ``phandle-array``
           - .. code-block:: none

                DMA channels specifiers


         * - ``dma-names``
           - ``string-array``
           - .. code-block:: none

                Provided names of DMA channel specifiers


         * - ``io-channels``
           - ``phandle-array``
           - .. code-block:: none

                IO channels specifiers


         * - ``io-channel-names``
           - ``string-array``
           - .. code-block:: none

                Provided names of IO channel specifiers


         * - ``mboxes``
           - ``phandle-array``
           - .. code-block:: none

                mailbox / IPM channels specifiers


         * - ``mbox-names``
           - ``string-array``
           - .. code-block:: none

                Provided names of mailbox / IPM channel specifiers


         * - ``wakeup-source``
           - ``boolean``
           - .. code-block:: none

                Property to identify that a device can be used as wake up source.

                When this property is provided a specific flag is set into the
                device that tells the system that the device is capable of
                wake up the system.

                Wake up capable devices are disabled (interruptions will not wake up
                the system) by default but they can be enabled at runtime if necessary.



         * - ``power-domain``
           - ``phandle``
           - .. code-block:: none


                Power domain the device belongs to.

                The device will be notified when the power domain it belongs to is either
                suspended or resumed.
```
