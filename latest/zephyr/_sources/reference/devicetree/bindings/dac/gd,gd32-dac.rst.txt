## latest/zephyr/_sources/reference/devicetree/bindings/ethernet/silabs,gecko-ethernet.rst.txt
```
:orphan:

.. raw:: html

    <!--
    FIXME: do not limit page width until content uses another representation
    format other than tables
    -->
    <style>.wy-nav-content { max-width: none; !important }</style>

.. dtcompatible:: silabs,gecko-ethernet
.. _dtbinding_silabs_gecko_ethernet:

silabs,gecko-ethernet
#####################

Vendor: :ref:`Silicon Laboratories <dt_vendor_silabs>`

Description
***********



.. code-block:: none

   SiLabs Gecko Ethernet

Properties
**********

.. tabs::

   .. group-tab:: Node specific properties

      Properties not inherited from the base binding file.

      .. list-table::
         :widths: 1 1 4
         :header-rows: 1

         * - Name
           - Type
           - Details

         * - ``phy-address``
           - ``int``
           - .. code-block:: none

                address of the PHY on the MDIO bus


             This property is **required**.

         * - ``location-rmii``
           - ``int``
           - .. code-block:: none

                location of RMII pins, configuration defined as <location>


             This property is **required**.

         * - ``location-mdio``
           - ``int``
           - .. code-block:: none

                location of MDC and MDIO pins, configuration defined as <location>


             This property is **required**.

         * - ``location-phy_mdc``
           - ``array``
           - .. code-block:: none

                PHY MDC individual pin configuration defined as <location port pin>


             This property is **required**.

         * - ``location-phy_mdio``
           - ``array``
           - .. code-block:: none

                PHY MDIO individual pin configuration defined as <location port pin>


             This property is **required**.

         * - ``location-rmii_refclk``
           - ``array``
           - .. code-block:: none

                Reference clock individual pin configuration defined as <location port pin>


             This property is **required**.

         * - ``location-rmii_crs_dv``
           - ``array``
           - .. code-block:: none

                Receive data valid individual pin configuration defined as <location port pin>


             This property is **required**.

         * - ``location-rmii_txd0``
           - ``array``
           - .. code-block:: none

                Transmit data 0 individual pin configuration defined as <location port pin>


             This property is **required**.

         * - ``location-rmii_txd1``
           - ``array``
           - .. code-block:: none

                Transmit data 1 individual pin configuration defined as <location port pin>


             This property is **required**.

         * - ``location-rmii_tx_en``
           - ``array``
           - .. code-block:: none

                Transmit enable individual pin configuration defined as <location port pin>


             This property is **required**.

         * - ``location-rmii_rxd0``
           - ``array``
           - .. code-block:: none

                Receive data 0 individual pin configuration defined as <location port pin>


             This property is **required**.

         * - ``location-rmii_rxd1``
           - ``array``
           - .. code-block:: none

                Receive data 1 individual pin configuration defined as <location port pin>


             This property is **required**.

         * - ``location-rmii_rx_er``
           - ``array``
           - .. code-block:: none

                Receive error individual pin configuration defined as <location port pin>


             This property is **required**.

         * - ``location-phy_pwr_enable``
           - ``array``
           - .. code-block:: none

                PHY power enable individual pin configuration defined as <port pin>


         * - ``location-phy_reset``
           - ``array``
           - .. code-block:: none

                PHY reset individual pin configuration defined as <port pin>


         * - ``location-phy_interrupt``
           - ``array``
           - .. code-block:: none

                PHY interrupt individual pin configuration defined as <port pin>


         * - ``local-mac-address``
           - ``uint8-array``
           - .. code-block:: none

                Specifies the MAC address that was assigned to the network device


         * - ``zephyr,random-mac-address``
           - ``boolean``
           - .. code-block:: none

                Use a random MAC address generated when the driver is initialized.
                Note that using this choice and rebooting a board may leave stale
                MAC address in peers' ARP caches and lead to issues and delays in
                communication.  (Use "ip neigh flush all" on Linux peers to clear
                ARP cache.)

                It is driver specific how the OUI octets are handled.

                If set we ignore any setting of the local-mac-address property.





   .. group-tab:: Deprecated node specific properties

      Deprecated properties not inherited from the base binding file.

      (None)

   .. group-tab:: Base properties

      Properties inherited from the base binding file, which defines
      common properties that may be set on many nodes. Not all of these
      may apply to the "silabs,gecko-ethernet" compatible.

      .. list-table::
         :widths: 1 1 4
         :header-rows: 1

         * - Name
           - Type
           - Details

         * - ``reg``
           - ``array``
           - .. code-block:: none

                mmio register space


             This property is **required**.

             See :ref:`dt-important-props` for more information.

         * - ``interrupts``
           - ``array``
           - .. code-block:: none

                required interrupts


             This property is **required**.

             See :ref:`dt-important-props` for more information.

         * - ``label``
           - ``string``
           - .. code-block:: none

                Human readable string describing the device (used as device_get_binding() argument)


             This property is **required**.

             See :ref:`dt-important-props` for more information.

         * - ``status``
           - ``string``
           - .. code-block:: none

                indicates the operational status of a device


             Legal values: ``'ok'``, ``'okay'``, ``'disabled'``, ``'reserved'``, ``'fail'``, ``'fail-sss'``

             See :ref:`dt-important-props` for more information.

         * - ``compatible``
           - ``string-array``
           - .. code-block:: none

                compatible strings


             This property is **required**.

             See :ref:`dt-important-props` for more information.

         * - ``reg-names``
           - ``string-array``
           - .. code-block:: none

                name of each register space


         * - ``interrupts-extended``
           - ``compound``
           - .. code-block:: none

                extended interrupt specifier for device


         * - ``interrupt-names``
           - ``string-array``
           - .. code-block:: none

                name of each interrupt


         * - ``interrupt-parent``
           - ``phandle``
           - .. code-block:: none

                phandle to interrupt controller node


         * - ``clocks``
           - ``phandle-array``
           - .. code-block:: none

                Clock gate information


         * - ``clock-names``
           - ``string-array``
           - .. code-block:: none

                name of each clock


         * - ``#address-cells``
           - ``int``
           - .. code-block:: none

                number of address cells in reg property


         * - ``#size-cells``
           - ``int``
           - .. code-block:: none

                number of size cells in reg property


         * - ``dmas``
           - ``phandle-array``
           - .. code-block:: none

                DMA channels specifiers


         * - ``dma-names``
           - ``string-array``
           - .. code-block:: none

                Provided names of DMA channel specifiers


         * - ``io-channels``
           - ``phandle-array``
           - .. code-block:: none

                IO channels specifiers


         * - ``io-channel-names``
           - ``string-array``
           - .. code-block:: none

                Provided names of IO channel specifiers


         * - ``mboxes``
           - ``phandle-array``
           - .. code-block:: none

                mailbox / IPM channels specifiers


         * - ``mbox-names``
           - ``string-array``
           - .. code-block:: none

                Provided names of mailbox / IPM channel specifiers


         * - ``wakeup-source``
           - ``boolean``
           - .. code-block:: none

                Property to identify that a device can be used as wake up source.

                When this property is provided a specific flag is set into the
                device that tells the system that the device is capable of
                wake up the system.

                Wake up capable devices are disabled (interruptions will not wake up
                the system) by default but they can be enabled at runtime if necessary.



         * - ``power-domain``
           - ``phandle``
           - .. code-block:: none


                Power domain the device belongs to.

                The device will be notified when the power domain it belongs to is either
                suspended or resumed.
```

## latest/zephyr/_sources/reference/devicetree/bindings/flash_controller/atmel,sam0-nvmctrl.rst.txt
```
:orphan:

.. raw:: html

    <!--
    FIXME: do not limit page width until content uses another representation
    format other than tables
    -->
    <style>.wy-nav-content { max-width: none; !important }</style>

.. dtcompatible:: atmel,sam0-nvmctrl
.. _dtbinding_atmel_sam0_nvmctrl:

atmel,sam0-nvmctrl
##################

Vendor: :ref:`Atmel Corporation <dt_vendor_atmel>`

Description
***********



.. code-block:: none

   Atmel SAM0 NVMC (Non-Volatile Memory Controller)

Properties
**********

.. tabs::

   .. group-tab:: Node specific properties

      Properties not inherited from the base binding file.

      .. list-table::
         :widths: 1 1 4
         :header-rows: 1

         * - Name
           - Type
           - Details

         * - ``lock-regions``
           - ``int``
           - .. code-block:: none

                Number of lock regions


             This property is **required**.



   .. group-tab:: Deprecated node specific properties

      Deprecated properties not inherited from the base binding file.

      (None)

   .. group-tab:: Base properties

      Properties inherited from the base binding file, which defines
      common properties that may be set on many nodes. Not all of these
      may apply to the "atmel,sam0-nvmctrl" compatible.

      .. list-table::
         :widths: 1 1 4
         :header-rows: 1

         * - Name
           - Type
           - Details

         * - ``label``
           - ``string``
           - .. code-block:: none

                Human readable string describing the device (used as device_get_binding() argument)


             This property is **required**.

             See :ref:`dt-important-props` for more information.

         * - ``reg``
           - ``array``
           - .. code-block:: none

                register space


             This property is **required**.

             See :ref:`dt-important-props` for more information.

         * - ``status``
           - ``string``
           - .. code-block:: none

                indicates the operational status of a device


             Legal values: ``'ok'``, ``'okay'``, ``'disabled'``, ``'reserved'``, ``'fail'``, ``'fail-sss'``

             See :ref:`dt-important-props` for more information.

         * - ``compatible``
           - ``string-array``
           - .. code-block:: none

                compatible strings


             This property is **required**.

             See :ref:`dt-important-props` for more information.

         * - ``reg-names``
           - ``string-array``
           - .. code-block:: none

                name of each register space


         * - ``interrupts``
           - ``array``
           - .. code-block:: none

                interrupts for device


             See :ref:`dt-important-props` for more information.

         * - ``interrupts-extended``
           - ``compound``
           - .. code-block:: none

                extended interrupt specifier for device


         * - ``interrupt-names``
           - ``string-array``
           - .. code-block:: none

                name of each interrupt


         * - ``interrupt-parent``
           - ``phandle``
           - .. code-block:: none

                phandle to interrupt controller node


         * - ``clocks``
           - ``phandle-array``
           - .. code-block:: none

                Clock gate information


         * - ``clock-names``
           - ``string-array``
           - .. code-block:: none

                name of each clock


         * - ``#address-cells``
           - ``int``
           - .. code-block:: none

                number of address cells in reg property


         * - ``#size-cells``
           - ``int``
           - .. code-block:: none

                number of size cells in reg property


         * - ``dmas``
           - ``phandle-array``
           - .. code-block:: none

                DMA channels specifiers


         * - ``dma-names``
           - ``string-array``
           - .. code-block:: none

                Provided names of DMA channel specifiers


         * - ``io-channels``
           - ``phandle-array``
           - .. code-block:: none

                IO channels specifiers


         * - ``io-channel-names``
           - ``string-array``
           - .. code-block:: none

                Provided names of IO channel specifiers


         * - ``mboxes``
           - ``phandle-array``
           - .. code-block:: none

                mailbox / IPM channels specifiers


         * - ``mbox-names``
           - ``string-array``
           - .. code-block:: none

                Provided names of mailbox / IPM channel specifiers


         * - ``wakeup-source``
           - ``boolean``
           - .. code-block:: none

                Property to identify that a device can be used as wake up source.

                When this property is provided a specific flag is set into the
                device that tells the system that the device is capable of
                wake up the system.

                Wake up capable devices are disabled (interruptions will not wake up
                the system) by default but they can be enabled at runtime if necessary.



         * - ``power-domain``
           - ``phandle``
           - .. code-block:: none


                Power domain the device belongs to.

                The device will be notified when the power domain it belongs to is either
                suspended or resumed.
```
