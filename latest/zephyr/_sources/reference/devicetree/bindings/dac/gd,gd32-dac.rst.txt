## latest/zephyr/_sources/reference/devicetree/bindings/espi/microchip,xec-espi-host-dev.rst.txt
```
:orphan:

.. raw:: html

    <!--
    FIXME: do not limit page width until content uses another representation
    format other than tables
    -->
    <style>.wy-nav-content { max-width: none; !important }</style>

.. dtcompatible:: microchip,xec-espi-host-dev
.. _dtbinding_microchip_xec_espi_host_dev:

microchip,xec-espi-host-dev (on espi bus)
#########################################

Vendor: :ref:`Microchip Technology Inc. <dt_vendor_microchip>`

Description
***********



.. code-block:: none

   Microchip XEC eSPI Host devices

Properties
**********

.. tabs::

   .. group-tab:: Node specific properties

      Properties not inherited from the base binding file.

      .. list-table::
         :widths: 1 1 4
         :header-rows: 1

         * - Name
           - Type
           - Details

         * - ``ldn``
           - ``int``
           - .. code-block:: none

                logical device number


             This property is **required**.

         * - ``girqs``
           - ``array``
           - .. code-block:: none

                array of GIRQ and bit positions


         * - ``pcrs``
           - ``array``
           - .. code-block:: none

                PCR sleep register index and bit position


         * - ``host-io``
           - ``int``
           - .. code-block:: none

                Logical device Host I/O (x86) base. Refer to SoC documentation for the
                number of I/O decoders implemented by a device (1 or 2) and the fixed
                I/O masks.



         * - ``host-io-addr-mask``
           - ``int``
           - .. code-block:: none

                Host I/O address mask. This value is fixed for all HW and is only
                used by Port80 BIOS debug alias device to specify the byte lane the
                alias address is mapped to in the 80h to 83h I/O range.



         * - ``host-mem``
           - ``int``
           - .. code-block:: none

                Logical device Host memory (x86) base address. Refer to SoC
                documentation for which logical devices implement a memory decoder
                and the fixed memory address masking.



         * - ``emi-mems``
           - ``array``
           - .. code-block:: none

                Each EMI host device supports Host access to two SoC data memory
                regions. Each region requires three configuration parameters:
                Base address in the SoC data memory, read limit, and write limit.
                If bits[14:2] of the address written by the Host to the EC address
                register is less than the limit value the access is allowed. Bit[15]
                of the EC address selects which of the two memory regions is accessed.



         * - ``emi-mem-cells``
           - ``int``
           - Constant value: ``3``

         * - ``#girq-cells``
           - ``int``
           - Constant value: ``1``

         * - ``#pcr-cells``
           - ``int``
           - Constant value: ``2``



   .. group-tab:: Deprecated node specific properties

      Deprecated properties not inherited from the base binding file.

      (None)

   .. group-tab:: Base properties

      Properties inherited from the base binding file, which defines
      common properties that may be set on many nodes. Not all of these
      may apply to the "microchip,xec-espi-host-dev" compatible.

      .. list-table::
         :widths: 1 1 4
         :header-rows: 1

         * - Name
           - Type
           - Details

         * - ``reg``
           - ``array``
           - .. code-block:: none

                register space


             This property is **required**.

             See :ref:`dt-important-props` for more information.

         * - ``interrupts``
           - ``array``
           - .. code-block:: none

                interrupts for device


             See :ref:`dt-important-props` for more information.

         * - ``interrupt-names``
           - ``string-array``
           - .. code-block:: none

                name of each interrupt


         * - ``status``
           - ``string``
           - .. code-block:: none

                indicates the operational status of a device


             Legal values: ``'ok'``, ``'okay'``, ``'disabled'``, ``'reserved'``, ``'fail'``, ``'fail-sss'``

             See :ref:`dt-important-props` for more information.

         * - ``compatible``
           - ``string-array``
           - .. code-block:: none

                compatible strings


             This property is **required**.

             See :ref:`dt-important-props` for more information.

         * - ``reg-names``
           - ``string-array``
           - .. code-block:: none

                name of each register space


         * - ``interrupts-extended``
           - ``compound``
           - .. code-block:: none

                extended interrupt specifier for device


         * - ``interrupt-parent``
           - ``phandle``
           - .. code-block:: none

                phandle to interrupt controller node


         * - ``label``
           - ``string``
           - .. code-block:: none

                Human readable string describing the device (used as device_get_binding() argument)


             See :ref:`dt-important-props` for more information.

         * - ``clocks``
           - ``phandle-array``
           - .. code-block:: none

                Clock gate information


         * - ``clock-names``
           - ``string-array``
           - .. code-block:: none

                name of each clock


         * - ``#address-cells``
           - ``int``
           - .. code-block:: none

                number of address cells in reg property


         * - ``#size-cells``
           - ``int``
           - .. code-block:: none

                number of size cells in reg property


         * - ``dmas``
           - ``phandle-array``
           - .. code-block:: none

                DMA channels specifiers


         * - ``dma-names``
           - ``string-array``
           - .. code-block:: none

                Provided names of DMA channel specifiers


         * - ``io-channels``
           - ``phandle-array``
           - .. code-block:: none

                IO channels specifiers


         * - ``io-channel-names``
           - ``string-array``
           - .. code-block:: none

                Provided names of IO channel specifiers


         * - ``mboxes``
           - ``phandle-array``
           - .. code-block:: none

                mailbox / IPM channels specifiers


         * - ``mbox-names``
           - ``string-array``
           - .. code-block:: none

                Provided names of mailbox / IPM channel specifiers


         * - ``wakeup-source``
           - ``boolean``
           - .. code-block:: none

                Property to identify that a device can be used as wake up source.

                When this property is provided a specific flag is set into the
                device that tells the system that the device is capable of
                wake up the system.

                Wake up capable devices are disabled (interruptions will not wake up
                the system) by default but they can be enabled at runtime if necessary.



         * - ``power-domain``
           - ``phandle``
           - .. code-block:: none


                Power domain the device belongs to.

                The device will be notified when the power domain it belongs to is either
                suspended or resumed.






Specifier cell names
********************

- emi-mem cells: base, rdlimit, wrlimit
- girq cells: girqinfo
- pcr cells: reg_idx, bitpos
```

## latest/zephyr/_sources/reference/devicetree/bindings/espi/microchip,xec-espi-saf.rst.txt
```
:orphan:

.. raw:: html

    <!--
    FIXME: do not limit page width until content uses another representation
    format other than tables
    -->
    <style>.wy-nav-content { max-width: none; !important }</style>

.. dtcompatible:: microchip,xec-espi-saf
.. _dtbinding_microchip_xec_espi_saf:

microchip,xec-espi-saf
######################

Vendor: :ref:`Microchip Technology Inc. <dt_vendor_microchip>`

Description
***********

These nodes are "espi" bus nodes.

.. code-block:: none

   Microchip ESPI SAF controller

Properties
**********

.. tabs::

   .. group-tab:: Node specific properties

      Properties not inherited from the base binding file.

      .. list-table::
         :widths: 1 1 4
         :header-rows: 1

         * - Name
           - Type
           - Details

         * - ``io_girq``
           - ``int``
           - .. code-block:: none

                soc group irq index for eSPI I/O


         * - ``poll_timeout``
           - ``int``
           - .. code-block:: none

                poll flash busy timeout in 32KHz periods


         * - ``poll_interval``
           - ``int``
           - .. code-block:: none

                interval between flash busy poll in 20 ns units


         * - ``consec_rd_timeout``
           - ``int``
           - .. code-block:: none

                timeout after last read to resume supended operations in 20 ns units


         * - ``sus_chk_delay``
           - ``int``
           - .. code-block:: none

                hold off poll after suspend in 20 ns units


         * - ``sus_rsm_interval``
           - ``int``
           - .. code-block:: none

                force suspended erase or program to resume in 32KHz periods




   .. group-tab:: Deprecated node specific properties

      Deprecated properties not inherited from the base binding file.

      (None)

   .. group-tab:: Base properties

      Properties inherited from the base binding file, which defines
      common properties that may be set on many nodes. Not all of these
      may apply to the "microchip,xec-espi-saf" compatible.

      .. list-table::
         :widths: 1 1 4
         :header-rows: 1

         * - Name
           - Type
           - Details

         * - ``reg``
           - ``array``
           - .. code-block:: none

                mmio register space


             This property is **required**.

             See :ref:`dt-important-props` for more information.

         * - ``label``
           - ``string``
           - .. code-block:: none

                Human readable string describing the device (used as device_get_binding() argument)


             This property is **required**.

             See :ref:`dt-important-props` for more information.

         * - ``status``
           - ``string``
           - .. code-block:: none

                indicates the operational status of a device


             Legal values: ``'ok'``, ``'okay'``, ``'disabled'``, ``'reserved'``, ``'fail'``, ``'fail-sss'``

             See :ref:`dt-important-props` for more information.

         * - ``compatible``
           - ``string-array``
           - .. code-block:: none

                compatible strings


             This property is **required**.

             See :ref:`dt-important-props` for more information.

         * - ``reg-names``
           - ``string-array``
           - .. code-block:: none

                name of each register space


         * - ``interrupts``
           - ``array``
           - .. code-block:: none

                interrupts for device


             See :ref:`dt-important-props` for more information.

         * - ``interrupts-extended``
           - ``compound``
           - .. code-block:: none

                extended interrupt specifier for device


         * - ``interrupt-names``
           - ``string-array``
           - .. code-block:: none

                name of each interrupt


         * - ``interrupt-parent``
           - ``phandle``
           - .. code-block:: none

                phandle to interrupt controller node


         * - ``clocks``
           - ``phandle-array``
           - .. code-block:: none

                Clock gate information


         * - ``clock-names``
           - ``string-array``
           - .. code-block:: none

                name of each clock


         * - ``#address-cells``
           - ``int``
           - .. code-block:: none

                number of address cells in reg property


         * - ``#size-cells``
           - ``int``
           - .. code-block:: none

                number of size cells in reg property


         * - ``dmas``
           - ``phandle-array``
           - .. code-block:: none

                DMA channels specifiers


         * - ``dma-names``
           - ``string-array``
           - .. code-block:: none

                Provided names of DMA channel specifiers


         * - ``io-channels``
           - ``phandle-array``
           - .. code-block:: none

                IO channels specifiers


         * - ``io-channel-names``
           - ``string-array``
           - .. code-block:: none

                Provided names of IO channel specifiers


         * - ``mboxes``
           - ``phandle-array``
           - .. code-block:: none

                mailbox / IPM channels specifiers


         * - ``mbox-names``
           - ``string-array``
           - .. code-block:: none

                Provided names of mailbox / IPM channel specifiers


         * - ``wakeup-source``
           - ``boolean``
           - .. code-block:: none

                Property to identify that a device can be used as wake up source.

                When this property is provided a specific flag is set into the
                device that tells the system that the device is capable of
                wake up the system.

                Wake up capable devices are disabled (interruptions will not wake up
                the system) by default but they can be enabled at runtime if necessary.



         * - ``power-domain``
           - ``phandle``
           - .. code-block:: none


                Power domain the device belongs to.

                The device will be notified when the power domain it belongs to is either
                suspended or resumed.
```
