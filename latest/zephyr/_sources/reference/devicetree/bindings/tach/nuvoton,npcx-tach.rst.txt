## latest/zephyr/_sources/reference/devicetree/bindings/usb/usb-audio-hs.rst.txt
```
:orphan:

.. raw:: html

    <!--
    FIXME: do not limit page width until content uses another representation
    format other than tables
    -->
    <style>.wy-nav-content { max-width: none; !important }</style>

.. dtcompatible:: usb-audio-hs
.. _dtbinding_usb_audio_hs:

usb-audio-hs
############

Vendor: :ref:`Generic or vendor-independent <dt_no_vendor>`

Description
***********



.. code-block:: none

   USB Audio headset specific fields.

Properties
**********

.. tabs::

   .. group-tab:: Node specific properties

      Properties not inherited from the base binding file.

      .. list-table::
         :widths: 1 1 4
         :header-rows: 1

         * - Name
           - Type
           - Details

         * - ``mic-resolution``
           - ``int``
           - Default value: ``16``

             Legal values: ``8``, ``16``, ``24``, ``32``

         * - ``mic-sync-type``
           - ``string``
           - .. code-block:: none

                Type of endpoint synchronization for IN devices.
                Default value is Sychronous.
                Adaptive is not supported.



             Default value: ``Synchronous``

             Legal values: ``'No Synchronization'``, ``'Asynchronous'``, ``'Adaptive'``, ``'Synchronous'``

         * - ``hp-resolution``
           - ``int``
           - Default value: ``16``

             Legal values: ``8``, ``16``, ``24``, ``32``

         * - ``mic-channel-l``
           - ``boolean``
           - .. code-block:: none

                Enable (l) channel.


         * - ``mic-channel-r``
           - ``boolean``
           - .. code-block:: none

                Enable (r) channel.


         * - ``mic-channel-c``
           - ``boolean``
           - .. code-block:: none

                Enable (c) channel.


         * - ``mic-channel-lfe``
           - ``boolean``
           - .. code-block:: none

                Enable (lfe) channel.


         * - ``mic-channel-ls``
           - ``boolean``
           - .. code-block:: none

                Enable (ls) channel.


         * - ``mic-channel-rs``
           - ``boolean``
           - .. code-block:: none

                Enable (rs) channel.


         * - ``mic-channel-lc``
           - ``boolean``
           - .. code-block:: none

                Enable (lc) channel.


         * - ``mic-channel-rc``
           - ``boolean``
           - .. code-block:: none

                Enable (rc) channel.


         * - ``mic-channel-s``
           - ``boolean``
           - .. code-block:: none

                Enable (s) channel.


         * - ``mic-channel-sl``
           - ``boolean``
           - .. code-block:: none

                Enable (sl) channel.


         * - ``mic-channel-sr``
           - ``boolean``
           - .. code-block:: none

                Enable (sr) channel.


         * - ``mic-channel-t``
           - ``boolean``
           - .. code-block:: none

                Enable (t) channel.


         * - ``mic-channel-cfg``
           - ``boolean``
           - .. code-block:: none

                Enable (cfg) channel.


         * - ``mic-feature-mute``
           - ``boolean``
           - .. code-block:: none

                Enable Mute feature.


             This property is **required**.

         * - ``mic-feature-volume``
           - ``boolean``
           - .. code-block:: none

                Enable Volume feature.
                Currently not supported.



         * - ``mic-feature-tone-control``
           - ``boolean``
           - .. code-block:: none

                Enable Tone Control (Bass, Mid, Treble) feature.
                Currently not supported.



         * - ``mic-feature-graphic-equalizer``
           - ``boolean``
           - .. code-block:: none

                Enable  Graphic Equalizer feature.
                Currently not supported.



         * - ``mic-feature-automatic-gain-control``
           - ``boolean``
           - .. code-block:: none

                Enable Autoamtic Gain Control feature.
                Currently not supported.



         * - ``mic-feature-delay``
           - ``boolean``
           - .. code-block:: none

                Enable Delay feature.
                Currently not supported.



         * - ``mic-feature-bass-boost``
           - ``boolean``
           - .. code-block:: none

                Enable Bass Boost feature.
                Currently not supported.



         * - ``mic-feature-loudness``
           - ``boolean``
           - .. code-block:: none

                Enable Loudness feature.
                Currently not supported.



         * - ``hp-channel-l``
           - ``boolean``
           - .. code-block:: none

                Enable (l) channel.


         * - ``hp-channel-r``
           - ``boolean``
           - .. code-block:: none

                Enable (r) channel.


         * - ``hp-channel-c``
           - ``boolean``
           - .. code-block:: none

                Enable (c) channel.


         * - ``hp-channel-lfe``
           - ``boolean``
           - .. code-block:: none

                Enable (lfe) channel.


         * - ``hp-channel-ls``
           - ``boolean``
           - .. code-block:: none

                Enable (ls) channel.


         * - ``hp-channel-rs``
           - ``boolean``
           - .. code-block:: none

                Enable (rs) channel.


         * - ``hp-channel-lc``
           - ``boolean``
           - .. code-block:: none

                Enable (lc) channel.


         * - ``hp-channel-rc``
           - ``boolean``
           - .. code-block:: none

                Enable (rc) channel.


         * - ``hp-channel-s``
           - ``boolean``
           - .. code-block:: none

                Enable (s) channel.


         * - ``hp-channel-sl``
           - ``boolean``
           - .. code-block:: none

                Enable (sl) channel.


         * - ``hp-channel-sr``
           - ``boolean``
           - .. code-block:: none

                Enable (sr) channel.


         * - ``hp-channel-t``
           - ``boolean``
           - .. code-block:: none

                Enable (t) channel.


         * - ``hp-channel-cfg``
           - ``boolean``
           - .. code-block:: none

                Enable (cfg) channel.


         * - ``hp-feature-mute``
           - ``boolean``
           - .. code-block:: none

                Enable Mute feature.


             This property is **required**.

         * - ``hp-feature-volume``
           - ``boolean``
           - .. code-block:: none

                Enable Volume feature.
                Currently not supported.



         * - ``hp-feature-tone-control``
           - ``boolean``
           - .. code-block:: none

                Enable Tone Control (Bass, Mid, Treble) feature.
                Currently not supported.



         * - ``hp-feature-graphic-equalizer``
           - ``boolean``
           - .. code-block:: none

                Enable  Graphic Equalizer feature.
                Currently not supported.



         * - ``hp-feature-automatic-gain-control``
           - ``boolean``
           - .. code-block:: none

                Enable Autoamtic Gain Control feature.
                Currently not supported.



         * - ``hp-feature-delay``
           - ``boolean``
           - .. code-block:: none

                Enable Delay feature.
                Currently not supported.



         * - ``hp-feature-bass-boost``
           - ``boolean``
           - .. code-block:: none

                Enable Bass Boost feature.
                Currently not supported.



         * - ``hp-feature-loudness``
           - ``boolean``
           - .. code-block:: none

                Enable Loudness feature.
                Currently not supported.





   .. group-tab:: Deprecated node specific properties

      Deprecated properties not inherited from the base binding file.

      (None)

   .. group-tab:: Base properties

      Properties inherited from the base binding file, which defines
      common properties that may be set on many nodes. Not all of these
      may apply to the "usb-audio-hs" compatible.

      .. list-table::
         :widths: 1 1 4
         :header-rows: 1

         * - Name
           - Type
           - Details

         * - ``label``
           - ``string``
           - .. code-block:: none

                Human readable string describing the device (used as device_get_binding() argument)


             This property is **required**.

             See :ref:`dt-important-props` for more information.
```

## latest/zephyr/_sources/reference/devicetree/bindings/usb/usb-audio.rst.txt
```
:orphan:

.. raw:: html

    <!--
    FIXME: do not limit page width until content uses another representation
    format other than tables
    -->
    <style>.wy-nav-content { max-width: none; !important }</style>

.. dtcompatible:: usb-audio
.. _dtbinding_usb_audio:

usb-audio
#########

Vendor: :ref:`Generic or vendor-independent <dt_no_vendor>`

Description
***********



.. code-block:: none

   Common fields for USB audio devices

Properties
**********

.. tabs::

   .. group-tab:: Node specific properties

      Properties not inherited from the base binding file.

      (None)

   .. group-tab:: Deprecated node specific properties

      Deprecated properties not inherited from the base binding file.

      (None)

   .. group-tab:: Base properties

      Properties inherited from the base binding file, which defines
      common properties that may be set on many nodes. Not all of these
      may apply to the "usb-audio" compatible.

      .. list-table::
         :widths: 1 1 4
         :header-rows: 1

         * - Name
           - Type
           - Details

         * - ``label``
           - ``string``
           - .. code-block:: none

                Human readable string describing the device (used as device_get_binding() argument)


             This property is **required**.

             See :ref:`dt-important-props` for more information.
```
