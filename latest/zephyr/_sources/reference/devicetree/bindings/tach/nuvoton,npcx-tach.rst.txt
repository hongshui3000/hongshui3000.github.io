## latest/zephyr/_sources/reference/devicetree/bindings/timer/atmel,sam-tc.rst.txt
```
:orphan:

.. raw:: html

    <!--
    FIXME: do not limit page width until content uses another representation
    format other than tables
    -->
    <style>.wy-nav-content { max-width: none; !important }</style>

.. dtcompatible:: atmel,sam-tc
.. _dtbinding_atmel_sam_tc:

atmel,sam-tc
############

Vendor: :ref:`Atmel Corporation <dt_vendor_atmel>`

Description
***********



.. code-block:: none

   Atmel SAM Timer Counter (TC) node

Properties
**********

.. tabs::

   .. group-tab:: Node specific properties

      Properties not inherited from the base binding file.

      .. list-table::
         :widths: 1 1 4
         :header-rows: 1

         * - Name
           - Type
           - Details

         * - ``peripheral-id``
           - ``array``
           - .. code-block:: none

                peripheral ID


             This property is **required**.

         * - ``channel``
           - ``int``
           - .. code-block:: none

                Timer / Counter channel to use, channel 0 is the default.
                Valid range: 0 - 2



         * - ``clk``
           - ``int``
           - .. code-block:: none

                Clock source selection as defined by TCCLKS bit-field of TC_CMR
                register. Consult the datasheet for the details.



         * - ``nodivclk``
           - ``boolean``
           - .. code-block:: none

                If set to true the `clk` property is ignored. Instead the TC module is
                driven directly via MCLK. Only supported on sam4e, same70, same70b,
                samv71, samv71b SoC series.



         * - ``reg-cmr``
           - ``int``
           - .. code-block:: none

                Alternate value of the CMR (Channel Mode Register) register.
                If specified this value will be written to the register during driver
                instance initialization instead of the default. It can be used to
                configure the timer / counter in the custom mode. Together with other
                properties like channel-num, pinctrl-0 this allows e.g. to configure
                the driver to count events generated on the TIOA, TIOB signal connected
                to the external pin.



         * - ``reg-rc``
           - ``int``
           - .. code-block:: none

                Register C compare/match value. RC can be used as compare/match unit
                for an specific timer unit. Their use depends on how timer channel
                is configured,see reg-cmr. It can be used as trigger for both input
                capture or counter mode, or even as event source. The RC register
                behavior is SoC dependent. For more information and use cases,
                check SoC datasheet and application notes.



         * - ``pinctrl-0``
           - ``phandles``
           - .. code-block:: none

                PIO pin configuration for Timer Counter signals.  We expect that
                the phandles will reference pinctrl nodes.  These nodes will
                have a nodelabel that matches the Atmel SoC HAL defines and
                be of the form p<port><pin><periph>_<inst>_<signal>.

                For example the TC0 on SAME7x would be
                   pinctrl-0 = <&pa0b_tc0_tioa0 &pa1b_tc0_tiob0>;





   .. group-tab:: Deprecated node specific properties

      Deprecated properties not inherited from the base binding file.

      (None)

   .. group-tab:: Base properties

      Properties inherited from the base binding file, which defines
      common properties that may be set on many nodes. Not all of these
      may apply to the "atmel,sam-tc" compatible.

      .. list-table::
         :widths: 1 1 4
         :header-rows: 1

         * - Name
           - Type
           - Details

         * - ``reg``
           - ``array``
           - .. code-block:: none

                register space


             This property is **required**.

             See :ref:`dt-important-props` for more information.

         * - ``interrupts``
           - ``array``
           - .. code-block:: none

                interrupts for device


             This property is **required**.

             See :ref:`dt-important-props` for more information.

         * - ``label``
           - ``string``
           - .. code-block:: none

                Human readable string describing the device (used as device_get_binding() argument)


             This property is **required**.

             See :ref:`dt-important-props` for more information.

         * - ``status``
           - ``string``
           - .. code-block:: none

                indicates the operational status of a device


             Legal values: ``'ok'``, ``'okay'``, ``'disabled'``, ``'reserved'``, ``'fail'``, ``'fail-sss'``

             See :ref:`dt-important-props` for more information.

         * - ``compatible``
           - ``string-array``
           - .. code-block:: none

                compatible strings


             This property is **required**.

             See :ref:`dt-important-props` for more information.

         * - ``reg-names``
           - ``string-array``
           - .. code-block:: none

                name of each register space


         * - ``interrupts-extended``
           - ``compound``
           - .. code-block:: none

                extended interrupt specifier for device


         * - ``interrupt-names``
           - ``string-array``
           - .. code-block:: none

                name of each interrupt


         * - ``interrupt-parent``
           - ``phandle``
           - .. code-block:: none

                phandle to interrupt controller node


         * - ``clocks``
           - ``phandle-array``
           - .. code-block:: none

                Clock gate information


         * - ``clock-names``
           - ``string-array``
           - .. code-block:: none

                name of each clock


         * - ``#address-cells``
           - ``int``
           - .. code-block:: none

                number of address cells in reg property


         * - ``#size-cells``
           - ``int``
           - .. code-block:: none

                number of size cells in reg property


         * - ``dmas``
           - ``phandle-array``
           - .. code-block:: none

                DMA channels specifiers


         * - ``dma-names``
           - ``string-array``
           - .. code-block:: none

                Provided names of DMA channel specifiers


         * - ``io-channels``
           - ``phandle-array``
           - .. code-block:: none

                IO channels specifiers


         * - ``io-channel-names``
           - ``string-array``
           - .. code-block:: none

                Provided names of IO channel specifiers


         * - ``mboxes``
           - ``phandle-array``
           - .. code-block:: none

                mailbox / IPM channels specifiers


         * - ``mbox-names``
           - ``string-array``
           - .. code-block:: none

                Provided names of mailbox / IPM channel specifiers


         * - ``wakeup-source``
           - ``boolean``
           - .. code-block:: none

                Property to identify that a device can be used as wake up source.

                When this property is provided a specific flag is set into the
                device that tells the system that the device is capable of
                wake up the system.

                Wake up capable devices are disabled (interruptions will not wake up
                the system) by default but they can be enabled at runtime if necessary.



         * - ``power-domain``
           - ``phandle``
           - .. code-block:: none


                Power domain the device belongs to.

                The device will be notified when the power domain it belongs to is either
                suspended or resumed.
```

## latest/zephyr/_sources/reference/devicetree/bindings/timer/riscv,machine-timer.rst.txt
```
:orphan:

.. raw:: html

    <!--
    FIXME: do not limit page width until content uses another representation
    format other than tables
    -->
    <style>.wy-nav-content { max-width: none; !important }</style>

.. dtcompatible:: riscv,machine-timer
.. _dtbinding_riscv_machine_timer:

riscv,machine-timer
###################

Vendor: :ref:`RISC-V Foundation <dt_vendor_riscv>`

Description
***********



.. code-block:: none

   RISC-V Machine timer

Properties
**********

.. tabs::

   .. group-tab:: Node specific properties

      Properties not inherited from the base binding file.

      .. list-table::
         :widths: 1 1 4
         :header-rows: 1

         * - Name
           - Type
           - Details

         * - ``clk-divider``
           - ``int``
           - .. code-block:: none

                clk-divider specifies the division ratio to the CPU frequency that
                clock used by machine timer.
                This property supports the case that the machine timer and CPU use
                different clock sources.
                This configuration is used sometimes for such as low power consumption.

                For example, the CPU clock frequency is 108MHz, and the machine timer
                uses 27MHz, which is the CPU clock divided by 4.
                In this case, the CPU clock frequency is defined in the CPU node
                as follows

                   clock-frequency = <108000000>;

                This property takes exponent of the power of 2.
                The relationship with the frequency division ratio is as
                following equation.

                   division_ratio = 2^n
                   n = log_2(division_ratio)

                Setting clk-divider to 2 specifies the machine timer uses the clock
                that CPU clock frequency divided by (2^2=)4, or 27MHz.

                Devision ratio constants can be found in the
                dt-bindings/timer/nuclei-machine-timer.h header file.





   .. group-tab:: Deprecated node specific properties

      Deprecated properties not inherited from the base binding file.

      (None)

   .. group-tab:: Base properties

      Properties inherited from the base binding file, which defines
      common properties that may be set on many nodes. Not all of these
      may apply to the "riscv,machine-timer" compatible.

      .. list-table::
         :widths: 1 1 4
         :header-rows: 1

         * - Name
           - Type
           - Details

         * - ``status``
           - ``string``
           - .. code-block:: none

                indicates the operational status of a device


             Legal values: ``'ok'``, ``'okay'``, ``'disabled'``, ``'reserved'``, ``'fail'``, ``'fail-sss'``

             See :ref:`dt-important-props` for more information.

         * - ``compatible``
           - ``string-array``
           - .. code-block:: none

                compatible strings


             This property is **required**.

             See :ref:`dt-important-props` for more information.

         * - ``reg``
           - ``array``
           - .. code-block:: none

                register space


             See :ref:`dt-important-props` for more information.

         * - ``reg-names``
           - ``string-array``
           - .. code-block:: none

                name of each register space


         * - ``interrupts``
           - ``array``
           - .. code-block:: none

                interrupts for device


             See :ref:`dt-important-props` for more information.

         * - ``interrupts-extended``
           - ``compound``
           - .. code-block:: none

                extended interrupt specifier for device


         * - ``interrupt-names``
           - ``string-array``
           - .. code-block:: none

                name of each interrupt


         * - ``interrupt-parent``
           - ``phandle``
           - .. code-block:: none

                phandle to interrupt controller node


         * - ``label``
           - ``string``
           - .. code-block:: none

                Human readable string describing the device (used as device_get_binding() argument)


             See :ref:`dt-important-props` for more information.

         * - ``clocks``
           - ``phandle-array``
           - .. code-block:: none

                Clock gate information


         * - ``clock-names``
           - ``string-array``
           - .. code-block:: none

                name of each clock


         * - ``#address-cells``
           - ``int``
           - .. code-block:: none

                number of address cells in reg property


         * - ``#size-cells``
           - ``int``
           - .. code-block:: none

                number of size cells in reg property


         * - ``dmas``
           - ``phandle-array``
           - .. code-block:: none

                DMA channels specifiers


         * - ``dma-names``
           - ``string-array``
           - .. code-block:: none

                Provided names of DMA channel specifiers


         * - ``io-channels``
           - ``phandle-array``
           - .. code-block:: none

                IO channels specifiers


         * - ``io-channel-names``
           - ``string-array``
           - .. code-block:: none

                Provided names of IO channel specifiers


         * - ``mboxes``
           - ``phandle-array``
           - .. code-block:: none

                mailbox / IPM channels specifiers


         * - ``mbox-names``
           - ``string-array``
           - .. code-block:: none

                Provided names of mailbox / IPM channel specifiers


         * - ``wakeup-source``
           - ``boolean``
           - .. code-block:: none

                Property to identify that a device can be used as wake up source.

                When this property is provided a specific flag is set into the
                device that tells the system that the device is capable of
                wake up the system.

                Wake up capable devices are disabled (interruptions will not wake up
                the system) by default but they can be enabled at runtime if necessary.



         * - ``power-domain``
           - ``phandle``
           - .. code-block:: none


                Power domain the device belongs to.

                The device will be notified when the power domain it belongs to is either
                suspended or resumed.
```
