## latest/zephyr/_sources/reference/devicetree/bindings/clock/st,stm32wl-hse-clock.rst.txt
```
:orphan:

.. raw:: html

    <!--
    FIXME: do not limit page width until content uses another representation
    format other than tables
    -->
    <style>.wy-nav-content { max-width: none; !important }</style>

.. dtcompatible:: st,stm32wl-hse-clock
.. _dtbinding_st_stm32wl_hse_clock:

st,stm32wl-hse-clock
####################

Vendor: :ref:`STMicroelectronics <dt_vendor_st>`

Description
***********



.. code-block:: none

   STM32WL HSE Clock

Properties
**********

.. tabs::

   .. group-tab:: Node specific properties

      Properties not inherited from the base binding file.

      .. list-table::
         :widths: 1 1 4
         :header-rows: 1

         * - Name
           - Type
           - Details

         * - ``hse-tcxo``
           - ``boolean``
           - .. code-block:: none

                When set, TCXO is selected as external source clock for HSE.
                Otherwise, external cyrstal is selected as HSE source clock.



         * - ``hse-div2``
           - ``boolean``
           - .. code-block:: none

                When set HSE output clock is divided by 2.
                Otherwise, no prescaler is used.



         * - ``clock-frequency``
           - ``int``
           - .. code-block:: none

                output clock frequency (Hz)


             This property is **required**.

         * - ``#clock-cells``
           - ``int``
           - .. code-block:: none

                Number of items to expect in a Clock specifier


             This property is **required**.



   .. group-tab:: Deprecated node specific properties

      Deprecated properties not inherited from the base binding file.

      (None)

   .. group-tab:: Base properties

      Properties inherited from the base binding file, which defines
      common properties that may be set on many nodes. Not all of these
      may apply to the "st,stm32wl-hse-clock" compatible.

      .. list-table::
         :widths: 1 1 4
         :header-rows: 1

         * - Name
           - Type
           - Details

         * - ``label``
           - ``string``
           - .. code-block:: none

                Human readable string describing the device (used as device_get_binding() argument)


             See :ref:`dt-important-props` for more information.

         * - ``clocks``
           - ``array``
           - .. code-block:: none

                input clock source
```

## latest/zephyr/_sources/reference/devicetree/bindings/clock/st,stm32wl-rcc.rst.txt
```
:orphan:

.. raw:: html

    <!--
    FIXME: do not limit page width until content uses another representation
    format other than tables
    -->
    <style>.wy-nav-content { max-width: none; !important }</style>

.. dtcompatible:: st,stm32wl-rcc
.. _dtbinding_st_stm32wl_rcc:

st,stm32wl-rcc
##############

Vendor: :ref:`STMicroelectronics <dt_vendor_st>`

Description
***********



.. code-block:: none

   STM32WL Reset and Clock controller node.
   For more description confere st,stm32-rcc.yaml

Properties
**********

.. tabs::

   .. group-tab:: Node specific properties

      Properties not inherited from the base binding file.

      .. list-table::
         :widths: 1 1 4
         :header-rows: 1

         * - Name
           - Type
           - Details

         * - ``cpu2-prescaler``
           - ``int``
           - .. code-block:: none

                CPU2 prescaler. Sets HCLK2 frequency which clocks CPU2.
                (A.K.A C2HPRE)



             Legal values: ``1``, ``2``, ``4``, ``8``, ``16``, ``32``, ``64``, ``128``, ``256``, ``512``

         * - ``ahb3-prescaler``
           - ``int``
           - .. code-block:: none

                HCLK3 shared prescaler (AHB3, Flash memory, SRAM1 and SRAM2).
                (A.K.A SHDHPRE)



             This property is **required**.

             Legal values: ``1``, ``2``, ``4``, ``8``, ``16``, ``32``, ``64``, ``128``, ``256``, ``512``

         * - ``cpu1-prescaler``
           - ``int``
           - .. code-block:: none

                CPU1 prescaler. Sets a HCLK1 frequency (feeding Cortex-M Systick)
                lower than SYSCLK frequency (actual core frequency).
                The HCLK1 clocks CPU1, AHB1, AHB2, AHB3 and SRAM1.



             This property is **required**.

             Legal values: ``1``, ``2``, ``3``, ``4``, ``5``, ``6``, ``8``, ``10``, ``16``, ``32``, ``64``, ``128``, ``256``, ``512``

         * - ``#clock-cells``
           - ``int``
           - .. code-block:: none

                Number of items to expect in a Clock specifier


             This property is **required**.

             Constant value: ``2``

         * - ``clock-frequency``
           - ``int``
           - .. code-block:: none

                default frequency in Hz for clock output



             This property is **required**.

         * - ``apb1-prescaler``
           - ``int``
           - This property is **required**.

             Legal values: ``1``, ``2``, ``4``, ``8``, ``16``

         * - ``apb2-prescaler``
           - ``int``
           - This property is **required**.

             Legal values: ``1``, ``2``, ``4``, ``8``, ``16``



   .. group-tab:: Deprecated node specific properties

      Deprecated properties not inherited from the base binding file.

      (None)

   .. group-tab:: Base properties

      Properties inherited from the base binding file, which defines
      common properties that may be set on many nodes. Not all of these
      may apply to the "st,stm32wl-rcc" compatible.

      .. list-table::
         :widths: 1 1 4
         :header-rows: 1

         * - Name
           - Type
           - Details

         * - ``reg``
           - ``array``
           - .. code-block:: none

                register space


             This property is **required**.

             See :ref:`dt-important-props` for more information.

         * - ``status``
           - ``string``
           - .. code-block:: none

                indicates the operational status of a device


             Legal values: ``'ok'``, ``'okay'``, ``'disabled'``, ``'reserved'``, ``'fail'``, ``'fail-sss'``

             See :ref:`dt-important-props` for more information.

         * - ``compatible``
           - ``string-array``
           - .. code-block:: none

                compatible strings


             This property is **required**.

             See :ref:`dt-important-props` for more information.

         * - ``reg-names``
           - ``string-array``
           - .. code-block:: none

                name of each register space


         * - ``interrupts``
           - ``array``
           - .. code-block:: none

                interrupts for device


             See :ref:`dt-important-props` for more information.

         * - ``interrupts-extended``
           - ``compound``
           - .. code-block:: none

                extended interrupt specifier for device


         * - ``interrupt-names``
           - ``string-array``
           - .. code-block:: none

                name of each interrupt


         * - ``interrupt-parent``
           - ``phandle``
           - .. code-block:: none

                phandle to interrupt controller node


         * - ``label``
           - ``string``
           - .. code-block:: none

                Human readable string describing the device (used as device_get_binding() argument)


             See :ref:`dt-important-props` for more information.

         * - ``clocks``
           - ``phandle-array``
           - .. code-block:: none

                Clock gate information


         * - ``clock-names``
           - ``string-array``
           - .. code-block:: none

                name of each clock


         * - ``#address-cells``
           - ``int``
           - .. code-block:: none

                number of address cells in reg property


         * - ``#size-cells``
           - ``int``
           - .. code-block:: none

                number of size cells in reg property


         * - ``dmas``
           - ``phandle-array``
           - .. code-block:: none

                DMA channels specifiers


         * - ``dma-names``
           - ``string-array``
           - .. code-block:: none

                Provided names of DMA channel specifiers


         * - ``io-channels``
           - ``phandle-array``
           - .. code-block:: none

                IO channels specifiers


         * - ``io-channel-names``
           - ``string-array``
           - .. code-block:: none

                Provided names of IO channel specifiers


         * - ``mboxes``
           - ``phandle-array``
           - .. code-block:: none

                mailbox / IPM channels specifiers


         * - ``mbox-names``
           - ``string-array``
           - .. code-block:: none

                Provided names of mailbox / IPM channel specifiers


         * - ``wakeup-source``
           - ``boolean``
           - .. code-block:: none

                Property to identify that a device can be used as wake up source.

                When this property is provided a specific flag is set into the
                device that tells the system that the device is capable of
                wake up the system.

                Wake up capable devices are disabled (interruptions will not wake up
                the system) by default but they can be enabled at runtime if necessary.



         * - ``power-domain``
           - ``phandle``
           - .. code-block:: none


                Power domain the device belongs to.

                The device will be notified when the power domain it belongs to is either
                suspended or resumed.






Specifier cell names
********************

- clock cells: bus, bits
```
