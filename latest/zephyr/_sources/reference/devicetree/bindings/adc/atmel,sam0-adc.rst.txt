## latest/zephyr/_sources/reference/devicetree/bindings/bluetooth/zephyr,bt-hci-spi-slave.rst.txt
```
:orphan:

.. raw:: html

    <!--
    FIXME: do not limit page width until content uses another representation
    format other than tables
    -->
    <style>.wy-nav-content { max-width: none; !important }</style>

.. dtcompatible:: zephyr,bt-hci-spi-slave
.. _dtbinding_zephyr_bt_hci_spi_slave:

zephyr,bt-hci-spi-slave (on spi bus)
####################################

Vendor: :ref:`Zephyr-specific binding <dt_vendor_zephyr>`

Description
***********



.. code-block:: none

   Configures SPI slave settings for a Bluetooth controller that uses
   Zephyr's Bluetooth Host Controller Interface SPI (HCI SPI) driver.

   A node defined via devicetree overlay should look like this:

      &myspi {
           bt-hci@0 {
                   compatible = "zephyr,bt-hci-spi-slave";
                   reg = <0>;
                   irq-gpios = <&gpio1 2 (GPIO_ACTIVE_HIGH | GPIO_PULL_DOWN)>;
           };
      };

   The bt-hci@0 node configures an HCI SPI slave on SPI slave
   interface myspi.

   The host interrupt GPIO is set to gpio1 pin 2 via irq-gpios. The
   GPIO flags are just for example and may be different depending on
   hardware.

Properties
**********

.. tabs::

   .. group-tab:: Node specific properties

      Properties not inherited from the base binding file.

      .. list-table::
         :widths: 1 1 4
         :header-rows: 1

         * - Name
           - Type
           - Details

         * - ``irq-gpios``
           - ``phandle-array``
           - This property is **required**.



   .. group-tab:: Deprecated node specific properties

      Deprecated properties not inherited from the base binding file.

      (None)

   .. group-tab:: Base properties

      Properties inherited from the base binding file, which defines
      common properties that may be set on many nodes. Not all of these
      may apply to the "zephyr,bt-hci-spi-slave" compatible.

      .. list-table::
         :widths: 1 1 4
         :header-rows: 1

         * - Name
           - Type
           - Details

         * - ``status``
           - ``string``
           - .. code-block:: none

                indicates the operational status of a device


             Legal values: ``'ok'``, ``'okay'``, ``'disabled'``, ``'reserved'``, ``'fail'``, ``'fail-sss'``

             See :ref:`dt-important-props` for more information.

         * - ``compatible``
           - ``string-array``
           - .. code-block:: none

                compatible strings


             This property is **required**.

             See :ref:`dt-important-props` for more information.

         * - ``reg``
           - ``array``
           - .. code-block:: none

                register space


             See :ref:`dt-important-props` for more information.

         * - ``reg-names``
           - ``string-array``
           - .. code-block:: none

                name of each register space


         * - ``interrupts``
           - ``array``
           - .. code-block:: none

                interrupts for device


             See :ref:`dt-important-props` for more information.

         * - ``interrupts-extended``
           - ``compound``
           - .. code-block:: none

                extended interrupt specifier for device


         * - ``interrupt-names``
           - ``string-array``
           - .. code-block:: none

                name of each interrupt


         * - ``interrupt-parent``
           - ``phandle``
           - .. code-block:: none

                phandle to interrupt controller node


         * - ``label``
           - ``string``
           - .. code-block:: none

                Human readable string describing the device (used as device_get_binding() argument)


             See :ref:`dt-important-props` for more information.

         * - ``clocks``
           - ``phandle-array``
           - .. code-block:: none

                Clock gate information


         * - ``clock-names``
           - ``string-array``
           - .. code-block:: none

                name of each clock


         * - ``#address-cells``
           - ``int``
           - .. code-block:: none

                number of address cells in reg property


         * - ``#size-cells``
           - ``int``
           - .. code-block:: none

                number of size cells in reg property


         * - ``dmas``
           - ``phandle-array``
           - .. code-block:: none

                DMA channels specifiers


         * - ``dma-names``
           - ``string-array``
           - .. code-block:: none

                Provided names of DMA channel specifiers


         * - ``io-channels``
           - ``phandle-array``
           - .. code-block:: none

                IO channels specifiers


         * - ``io-channel-names``
           - ``string-array``
           - .. code-block:: none

                Provided names of IO channel specifiers


         * - ``mboxes``
           - ``phandle-array``
           - .. code-block:: none

                mailbox / IPM channels specifiers


         * - ``mbox-names``
           - ``string-array``
           - .. code-block:: none

                Provided names of mailbox / IPM channel specifiers


         * - ``wakeup-source``
           - ``boolean``
           - .. code-block:: none

                Property to identify that a device can be used as wake up source.

                When this property is provided a specific flag is set into the
                device that tells the system that the device is capable of
                wake up the system.

                Wake up capable devices are disabled (interruptions will not wake up
                the system) by default but they can be enabled at runtime if necessary.



         * - ``power-domain``
           - ``phandle``
           - .. code-block:: none


                Power domain the device belongs to.

                The device will be notified when the power domain it belongs to is either
                suspended or resumed.
```

## latest/zephyr/_sources/reference/devicetree/bindings/can/bosch,m-can-base.rst.txt
```
:orphan:

.. raw:: html

    <!--
    FIXME: do not limit page width until content uses another representation
    format other than tables
    -->
    <style>.wy-nav-content { max-width: none; !important }</style>

.. dtcompatible:: bosch,m-can-base
.. _dtbinding_bosch_m_can_base:

bosch,m-can-base
################

Vendor: :ref:`Bosch Sensortec GmbH <dt_vendor_bosch>`

Description
***********



.. code-block:: none

   Bosch m_can CAN-FD controller base

Properties
**********

.. tabs::

   .. group-tab:: Node specific properties

      Properties not inherited from the base binding file.

      .. list-table::
         :widths: 1 1 4
         :header-rows: 1

         * - Name
           - Type
           - Details

         * - ``std-filter-elements``
           - ``int``
           - This property is **required**.

         * - ``ext-filter-elements``
           - ``int``
           - This property is **required**.

         * - ``rx-fifo0-elements``
           - ``int``
           - This property is **required**.

         * - ``rx-fifo1-elements``
           - ``int``
           - This property is **required**.

         * - ``rx-buffer-elements``
           - ``int``
           - This property is **required**.

         * - ``tx-buffer-elements``
           - ``int``
           - This property is **required**.



   .. group-tab:: Deprecated node specific properties

      Deprecated properties not inherited from the base binding file.

      (None)

   .. group-tab:: Base properties

      Properties inherited from the base binding file, which defines
      common properties that may be set on many nodes. Not all of these
      may apply to the "bosch,m-can-base" compatible.

      (None)
```

## latest/zephyr/_sources/reference/devicetree/bindings/can/bosch,m-can.rst.txt
```
:orphan:

.. raw:: html

    <!--
    FIXME: do not limit page width until content uses another representation
    format other than tables
    -->
    <style>.wy-nav-content { max-width: none; !important }</style>

.. dtcompatible:: bosch,m-can
.. _dtbinding_bosch_m_can:

bosch,m-can
###########

Vendor: :ref:`Bosch Sensortec GmbH <dt_vendor_bosch>`

Description
***********



.. code-block:: none

   Bosch m_can CAN-FD controller

Properties
**********

.. tabs::

   .. group-tab:: Node specific properties

      Properties not inherited from the base binding file.

      .. list-table::
         :widths: 1 1 4
         :header-rows: 1

         * - Name
           - Type
           - Details

         * - ``bus-speed-data``
           - ``int``
           - .. code-block:: none

                data phase bus speed in Baud/s


             This property is **required**.

         * - ``sjw-data``
           - ``int``
           - .. code-block:: none

                Resynchronization jump width for the data phase. (ISO11898-1:2015)


             This property is **required**.

         * - ``prop-seg-data``
           - ``int``
           - .. code-block:: none

                Time quantums of propagation segment for the data phase. (ISO11898-1:2015)


         * - ``phase-seg1-data``
           - ``int``
           - .. code-block:: none

                Time quantums of phase buffer 1 segment for the data phase. (ISO11898-1:2015)


         * - ``phase-seg2-data``
           - ``int``
           - .. code-block:: none

                Time quantums of phase buffer 2 segment for the data phase. (ISO11898-1:2015)


         * - ``sample-point-data``
           - ``int``
           - .. code-block:: none

                Sample point in permille for the data phase. This param is required if segments are not given. If the sample point is given, the segments are ignored.



         * - ``tx-delay-comp-offset``
           - ``int``
           - 

         * - ``bus-speed``
           - ``int``
           - .. code-block:: none

                bus speed in Baud/s


             This property is **required**.

         * - ``sjw``
           - ``int``
           - .. code-block:: none

                Resynchronization jump width (ISO 11898-1)


             This property is **required**.

         * - ``prop-seg``
           - ``int``
           - .. code-block:: none

                Time quantums of propagation segment (ISO 11898-1)


         * - ``phase-seg1``
           - ``int``
           - .. code-block:: none

                Time quantums of phase buffer 1 segment (ISO 11898-1)


         * - ``phase-seg2``
           - ``int``
           - .. code-block:: none

                Time quantums of phase buffer 2 segment (ISO 11898-1)


         * - ``sample-point``
           - ``int``
           - .. code-block:: none

                Sample point in permille. This param is required if segments are not given. If the sample point is given, the segments are ignored.





   .. group-tab:: Deprecated node specific properties

      Deprecated properties not inherited from the base binding file.

      (None)

   .. group-tab:: Base properties

      Properties inherited from the base binding file, which defines
      common properties that may be set on many nodes. Not all of these
      may apply to the "bosch,m-can" compatible.

      .. list-table::
         :widths: 1 1 4
         :header-rows: 1

         * - Name
           - Type
           - Details

         * - ``reg``
           - ``array``
           - .. code-block:: none

                register space


             This property is **required**.

             See :ref:`dt-important-props` for more information.

         * - ``interrupts``
           - ``array``
           - .. code-block:: none

                interrupts for device


             This property is **required**.

             See :ref:`dt-important-props` for more information.

         * - ``status``
           - ``string``
           - .. code-block:: none

                indicates the operational status of a device


             Legal values: ``'ok'``, ``'okay'``, ``'disabled'``, ``'reserved'``, ``'fail'``, ``'fail-sss'``

             See :ref:`dt-important-props` for more information.

         * - ``compatible``
           - ``string-array``
           - .. code-block:: none

                compatible strings


             This property is **required**.

             See :ref:`dt-important-props` for more information.

         * - ``reg-names``
           - ``string-array``
           - .. code-block:: none

                name of each register space


         * - ``interrupts-extended``
           - ``compound``
           - .. code-block:: none

                extended interrupt specifier for device


         * - ``interrupt-names``
           - ``string-array``
           - .. code-block:: none

                name of each interrupt


         * - ``interrupt-parent``
           - ``phandle``
           - .. code-block:: none

                phandle to interrupt controller node


         * - ``label``
           - ``string``
           - .. code-block:: none

                Human readable string describing the device (used as device_get_binding() argument)


             See :ref:`dt-important-props` for more information.

         * - ``clocks``
           - ``phandle-array``
           - .. code-block:: none

                Clock gate information


         * - ``clock-names``
           - ``string-array``
           - .. code-block:: none

                name of each clock


         * - ``#address-cells``
           - ``int``
           - .. code-block:: none

                number of address cells in reg property


         * - ``#size-cells``
           - ``int``
           - .. code-block:: none

                number of size cells in reg property


         * - ``dmas``
           - ``phandle-array``
           - .. code-block:: none

                DMA channels specifiers


         * - ``dma-names``
           - ``string-array``
           - .. code-block:: none

                Provided names of DMA channel specifiers


         * - ``io-channels``
           - ``phandle-array``
           - .. code-block:: none

                IO channels specifiers


         * - ``io-channel-names``
           - ``string-array``
           - .. code-block:: none

                Provided names of IO channel specifiers


         * - ``mboxes``
           - ``phandle-array``
           - .. code-block:: none

                mailbox / IPM channels specifiers


         * - ``mbox-names``
           - ``string-array``
           - .. code-block:: none

                Provided names of mailbox / IPM channel specifiers


         * - ``wakeup-source``
           - ``boolean``
           - .. code-block:: none

                Property to identify that a device can be used as wake up source.

                When this property is provided a specific flag is set into the
                device that tells the system that the device is capable of
                wake up the system.

                Wake up capable devices are disabled (interruptions will not wake up
                the system) by default but they can be enabled at runtime if necessary.



         * - ``power-domain``
           - ``phandle``
           - .. code-block:: none


                Power domain the device belongs to.

                The device will be notified when the power domain it belongs to is either
                suspended or resumed.
```
