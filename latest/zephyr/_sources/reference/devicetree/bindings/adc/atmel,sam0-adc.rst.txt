## latest/zephyr/_sources/reference/devicetree/bindings/clock/fixed-clock.rst.txt
```
:orphan:

.. raw:: html

    <!--
    FIXME: do not limit page width until content uses another representation
    format other than tables
    -->
    <style>.wy-nav-content { max-width: none; !important }</style>

.. dtcompatible:: fixed-clock
.. _dtbinding_fixed_clock:

fixed-clock
###########

Vendor: :ref:`Generic or vendor-independent <dt_no_vendor>`

Description
***********



.. code-block:: none

   Generic fixed-rate clock provider

Properties
**********

.. tabs::

   .. group-tab:: Node specific properties

      Properties not inherited from the base binding file.

      .. list-table::
         :widths: 1 1 4
         :header-rows: 1

         * - Name
           - Type
           - Details

         * - ``clock-frequency``
           - ``int``
           - .. code-block:: none

                output clock frequency (Hz)


             This property is **required**.

         * - ``#clock-cells``
           - ``int``
           - .. code-block:: none

                Number of items to expect in a Clock specifier


             This property is **required**.



   .. group-tab:: Deprecated node specific properties

      Deprecated properties not inherited from the base binding file.

      (None)

   .. group-tab:: Base properties

      Properties inherited from the base binding file, which defines
      common properties that may be set on many nodes. Not all of these
      may apply to the "fixed-clock" compatible.

      .. list-table::
         :widths: 1 1 4
         :header-rows: 1

         * - Name
           - Type
           - Details

         * - ``label``
           - ``string``
           - .. code-block:: none

                Human readable string describing the device (used as device_get_binding() argument)


             See :ref:`dt-important-props` for more information.

         * - ``clocks``
           - ``array``
           - .. code-block:: none

                input clock source
```

## latest/zephyr/_sources/reference/devicetree/bindings/clock/litex,clk.rst.txt
```
:orphan:

.. raw:: html

    <!--
    FIXME: do not limit page width until content uses another representation
    format other than tables
    -->
    <style>.wy-nav-content { max-width: none; !important }</style>

.. dtcompatible:: litex,clk
.. _dtbinding_litex_clk:

litex,clk
#########

Vendor: :ref:`LiteX SoC builder <dt_vendor_litex>`

Description
***********



.. code-block:: none

   LiteX Mixed Mode Clock Manager
   Common clock driver with MMCM unit for dynamic reconfiguration
   of up to 7 clock outputs with ability to change frequency, duty
   cycle and phase offset

Properties
**********

.. tabs::

   .. group-tab:: Node specific properties

      Properties not inherited from the base binding file.

      .. list-table::
         :widths: 1 1 4
         :header-rows: 1

         * - Name
           - Type
           - Details

         * - ``#clock-cells``
           - ``int``
           - .. code-block:: none

                Number of items to expect in a Clock specifier


             This property is **required**.

             Constant value: ``1``

         * - ``clock-output-names``
           - ``string-array``
           - .. code-block:: none

                List of strings of clock output signal names indexed
                by the first cell in the clock specifier.



             This property is **required**.

         * - ``litex,lock-timeout``
           - ``int``
           - .. code-block:: none

                Number of ms to wait for MMCM to assert LOCK signal



             This property is **required**.

         * - ``litex,drdy-timeout``
           - ``int``
           - .. code-block:: none

                Number of ms to wait for MMCM to assert DRDY signal



             This property is **required**.

         * - ``litex,sys-clock-frequency``
           - ``int``
           - .. code-block:: none

                System clock frequency



             This property is **required**.

         * - ``litex,divclk-divide-min``
           - ``int``
           - .. code-block:: none

                minimal global divider



             This property is **required**.

         * - ``litex,divclk-divide-max``
           - ``int``
           - .. code-block:: none

                maximal global divider



             This property is **required**.

         * - ``litex,clkfbout-mult-min``
           - ``int``
           - .. code-block:: none

                minimal global multiplier



             This property is **required**.

         * - ``litex,clkfbout-mult-max``
           - ``int``
           - .. code-block:: none

                maximal global multiplier



             This property is **required**.

         * - ``litex,vco-freq-min``
           - ``int``
           - .. code-block:: none

                minimal frequency after global divider and multiplier



             This property is **required**.

         * - ``litex,vco-freq-max``
           - ``int``
           - .. code-block:: none

                maximal frequency after global divider and multiplier



             This property is **required**.

         * - ``litex,clkout-divide-min``
           - ``int``
           - .. code-block:: none

                minimal clock output divider



             This property is **required**.

         * - ``litex,clkout-divide-max``
           - ``int``
           - .. code-block:: none

                maximal clock output divider



             This property is **required**.

         * - ``litex,vco-margin``
           - ``int``
           - .. code-block:: none

                tolerancy for vco frequency



             This property is **required**.



   .. group-tab:: Deprecated node specific properties

      Deprecated properties not inherited from the base binding file.

      (None)

   .. group-tab:: Base properties

      Properties inherited from the base binding file, which defines
      common properties that may be set on many nodes. Not all of these
      may apply to the "litex,clk" compatible.

      .. list-table::
         :widths: 1 1 4
         :header-rows: 1

         * - Name
           - Type
           - Details

         * - ``reg``
           - ``array``
           - .. code-block:: none

                Base address and lengths of the register space


             See :ref:`dt-important-props` for more information.

         * - ``status``
           - ``string``
           - .. code-block:: none

                indicates the operational status of a device


             Legal values: ``'ok'``, ``'okay'``, ``'disabled'``, ``'reserved'``, ``'fail'``, ``'fail-sss'``

             See :ref:`dt-important-props` for more information.

         * - ``compatible``
           - ``string-array``
           - .. code-block:: none

                compatible strings


             This property is **required**.

             See :ref:`dt-important-props` for more information.

         * - ``reg-names``
           - ``string-array``
           - .. code-block:: none

                name of each register space


         * - ``interrupts``
           - ``array``
           - .. code-block:: none

                interrupts for device


             See :ref:`dt-important-props` for more information.

         * - ``interrupts-extended``
           - ``compound``
           - .. code-block:: none

                extended interrupt specifier for device


         * - ``interrupt-names``
           - ``string-array``
           - .. code-block:: none

                name of each interrupt


         * - ``interrupt-parent``
           - ``phandle``
           - .. code-block:: none

                phandle to interrupt controller node


         * - ``label``
           - ``string``
           - .. code-block:: none

                Human readable string describing the device (used as device_get_binding() argument)


             See :ref:`dt-important-props` for more information.

         * - ``clocks``
           - ``phandle-array``
           - .. code-block:: none

                Clock gate information


         * - ``clock-names``
           - ``string-array``
           - .. code-block:: none

                name of each clock


         * - ``#address-cells``
           - ``int``
           - .. code-block:: none

                number of address cells in reg property


         * - ``#size-cells``
           - ``int``
           - .. code-block:: none

                number of size cells in reg property


         * - ``dmas``
           - ``phandle-array``
           - .. code-block:: none

                DMA channels specifiers


         * - ``dma-names``
           - ``string-array``
           - .. code-block:: none

                Provided names of DMA channel specifiers


         * - ``io-channels``
           - ``phandle-array``
           - .. code-block:: none

                IO channels specifiers


         * - ``io-channel-names``
           - ``string-array``
           - .. code-block:: none

                Provided names of IO channel specifiers


         * - ``mboxes``
           - ``phandle-array``
           - .. code-block:: none

                mailbox / IPM channels specifiers


         * - ``mbox-names``
           - ``string-array``
           - .. code-block:: none

                Provided names of mailbox / IPM channel specifiers


         * - ``wakeup-source``
           - ``boolean``
           - .. code-block:: none

                Property to identify that a device can be used as wake up source.

                When this property is provided a specific flag is set into the
                device that tells the system that the device is capable of
                wake up the system.

                Wake up capable devices are disabled (interruptions will not wake up
                the system) by default but they can be enabled at runtime if necessary.



         * - ``power-domain``
           - ``phandle``
           - .. code-block:: none


                Power domain the device belongs to.

                The device will be notified when the power domain it belongs to is either
                suspended or resumed.






Specifier cell names
********************

- clock cells: id
```
