## latest/zephyr/_sources/reference/devicetree/bindings/clock/st,stm32h7-rcc.rst.txt
```
:orphan:

.. raw:: html

    <!--
    FIXME: do not limit page width until content uses another representation
    format other than tables
    -->
    <style>.wy-nav-content { max-width: none; !important }</style>

.. dtcompatible:: st,stm32h7-rcc
.. _dtbinding_st_stm32h7_rcc:

st,stm32h7-rcc
##############

Vendor: :ref:`STMicroelectronics <dt_vendor_st>`

Description
***********



.. code-block:: none

   STM32 Reset and Clock controller node for STM32H7 devices
   This node is in charge of system clock ('SYSCLK') source selection and
   System Clock Generation.

   Configuring STM32 Reset and Clock controller node:

   System clock source should be selected amongst the clock nodes available in "clocks"
   node (typically 'clk_hse, clk_csi', 'pll', ...).
   As part of this node configuration, SYSCLK frequency should also be defined, using
   "clock-frequency" property.
   Last, bus clocks (typically HCLK, PCLK1, PCLK2) should be configured using matching
   prescaler properties.
   Here is an example of correctly configured rcc node:
   &rcc {
            clocks = <&pll>;  /* Set pll as SYSCLK source */
            clock-frequency = <DT_FREQ_M(480)>; /* SYSCLK runs at 480MHz */
            d1cpre = <1>;
            hpre = <1>;
            d1ppre = <1>;
            d2ppre1 = <1>;
            d2ppre2 = <1>;
            d3ppre = <1>;
   }

   Specifying a gated clock:

   To specify a gated clock, a peripheral should define a "clocks" property encoded
   in the following way:
   ... {
            ...
            clocks = <&rcc STM32_CLOCK_BUS_APB2 0x00000020>;
            ...
   }
   After the phandle referring to rcc node, the first index specifies the registers of
   the bus controlling the peripheral and the second index specifies the bit used to
   control the peripheral clock in that bus register.

Properties
**********

.. tabs::

   .. group-tab:: Node specific properties

      Properties not inherited from the base binding file.

      .. list-table::
         :widths: 1 1 4
         :header-rows: 1

         * - Name
           - Type
           - Details

         * - ``#clock-cells``
           - ``int``
           - .. code-block:: none

                Number of items to expect in a Clock specifier


             This property is **required**.

             Constant value: ``2``

         * - ``clock-frequency``
           - ``int``
           - .. code-block:: none

                default frequency in Hz for clock output



             This property is **required**.

         * - ``d1cpre``
           - ``int``
           - .. code-block:: none

                D1 Domain, CPU1 clock prescaler. Sets a HCLK frequency (feeding Cortex-M Systick)
                lower than SYSCLK frequency (actual core frequency).
                Zephyr doesn't make a difference today between these two clocks.
                Changing this prescaler is not allowed until it is made possible to
                use them independently in Zephyr clock subsystem.



             This property is **required**.

             Legal values: ``1``

         * - ``hpre``
           - ``int``
           - .. code-block:: none

                D2 domain, CPU2 core clock and AHB(1/2/3/4) peripheral prescaler



             This property is **required**.

             Legal values: ``1``, ``2``, ``4``, ``8``, ``16``, ``64``, ``128``, ``256``, ``512``

         * - ``d1ppre``
           - ``int``
           - .. code-block:: none

                D1 domain, APB3 peripheral prescaler



             This property is **required**.

             Legal values: ``1``, ``2``, ``4``, ``8``, ``16``

         * - ``d2ppre1``
           - ``int``
           - .. code-block:: none

                D2 domain, APB1 peripheral prescaler



             This property is **required**.

             Legal values: ``1``, ``2``, ``4``, ``8``, ``16``

         * - ``d2ppre2``
           - ``int``
           - .. code-block:: none

                D2 domain, APB2 peripheral prescaler



             This property is **required**.

             Legal values: ``1``, ``2``, ``4``, ``8``, ``16``

         * - ``d3ppre``
           - ``int``
           - .. code-block:: none

                D3 domain, APB4 peripheral prescaler



             This property is **required**.

             Legal values: ``1``, ``2``, ``4``, ``8``, ``16``



   .. group-tab:: Deprecated node specific properties

      Deprecated properties not inherited from the base binding file.

      (None)

   .. group-tab:: Base properties

      Properties inherited from the base binding file, which defines
      common properties that may be set on many nodes. Not all of these
      may apply to the "st,stm32h7-rcc" compatible.

      .. list-table::
         :widths: 1 1 4
         :header-rows: 1

         * - Name
           - Type
           - Details

         * - ``reg``
           - ``array``
           - .. code-block:: none

                register space


             This property is **required**.

             See :ref:`dt-important-props` for more information.

         * - ``status``
           - ``string``
           - .. code-block:: none

                indicates the operational status of a device


             Legal values: ``'ok'``, ``'okay'``, ``'disabled'``, ``'reserved'``, ``'fail'``, ``'fail-sss'``

             See :ref:`dt-important-props` for more information.

         * - ``compatible``
           - ``string-array``
           - .. code-block:: none

                compatible strings


             This property is **required**.

             See :ref:`dt-important-props` for more information.

         * - ``reg-names``
           - ``string-array``
           - .. code-block:: none

                name of each register space


         * - ``interrupts``
           - ``array``
           - .. code-block:: none

                interrupts for device


             See :ref:`dt-important-props` for more information.

         * - ``interrupts-extended``
           - ``compound``
           - .. code-block:: none

                extended interrupt specifier for device


         * - ``interrupt-names``
           - ``string-array``
           - .. code-block:: none

                name of each interrupt


         * - ``interrupt-parent``
           - ``phandle``
           - .. code-block:: none

                phandle to interrupt controller node


         * - ``label``
           - ``string``
           - .. code-block:: none

                Human readable string describing the device (used as device_get_binding() argument)


             See :ref:`dt-important-props` for more information.

         * - ``clocks``
           - ``phandle-array``
           - .. code-block:: none

                Clock gate information


         * - ``clock-names``
           - ``string-array``
           - .. code-block:: none

                name of each clock


         * - ``#address-cells``
           - ``int``
           - .. code-block:: none

                number of address cells in reg property


         * - ``#size-cells``
           - ``int``
           - .. code-block:: none

                number of size cells in reg property


         * - ``dmas``
           - ``phandle-array``
           - .. code-block:: none

                DMA channels specifiers


         * - ``dma-names``
           - ``string-array``
           - .. code-block:: none

                Provided names of DMA channel specifiers


         * - ``io-channels``
           - ``phandle-array``
           - .. code-block:: none

                IO channels specifiers


         * - ``io-channel-names``
           - ``string-array``
           - .. code-block:: none

                Provided names of IO channel specifiers


         * - ``mboxes``
           - ``phandle-array``
           - .. code-block:: none

                mailbox / IPM channels specifiers


         * - ``mbox-names``
           - ``string-array``
           - .. code-block:: none

                Provided names of mailbox / IPM channel specifiers


         * - ``wakeup-source``
           - ``boolean``
           - .. code-block:: none

                Property to identify that a device can be used as wake up source.

                When this property is provided a specific flag is set into the
                device that tells the system that the device is capable of
                wake up the system.

                Wake up capable devices are disabled (interruptions will not wake up
                the system) by default but they can be enabled at runtime if necessary.



         * - ``power-domain``
           - ``phandle``
           - .. code-block:: none


                Power domain the device belongs to.

                The device will be notified when the power domain it belongs to is either
                suspended or resumed.






Specifier cell names
********************

- clock cells: bus, bits
```

## latest/zephyr/_sources/reference/devicetree/bindings/clock/st,stm32l0-pll-clock.rst.txt
```
:orphan:

.. raw:: html

    <!--
    FIXME: do not limit page width until content uses another representation
    format other than tables
    -->
    <style>.wy-nav-content { max-width: none; !important }</style>

.. dtcompatible:: st,stm32l0-pll-clock
.. _dtbinding_st_stm32l0_pll_clock:

st,stm32l0-pll-clock
####################

Vendor: :ref:`STMicroelectronics <dt_vendor_st>`

Description
***********



.. code-block:: none

   STM32L0 and STM32L1 Main PLL node binding:

   Takes one of clk_hse, clk_hsi or clk_msi as input clock, with an
   input frequency from 2 to 24 MHz.

   The desired PLL frequency can be computed with the following formula:

     f(PLL) = f(VCO clock) / PLLDIV  --> PLLCLK (System Clock)

       with f(VCO clock) = f(PLL clock input) × PLLMUL --> PLLVCO

   The PLL output frequency must not exceed 32 MHz.

Properties
**********

.. tabs::

   .. group-tab:: Node specific properties

      Properties not inherited from the base binding file.

      .. list-table::
         :widths: 1 1 4
         :header-rows: 1

         * - Name
           - Type
           - Details

         * - ``#clock-cells``
           - ``int``
           - .. code-block:: none

                Number of items to expect in a Clock specifier


             This property is **required**.

         * - ``div``
           - ``int``
           - .. code-block:: none

                PLL output division



             This property is **required**.

             Legal values: ``2``, ``3``, ``4``

         * - ``mul``
           - ``int``
           - .. code-block:: none

                PLL multiplication factor for VCO
                The PLL VCO clock frequency must not exceed:
                - 96 MHz when the product is in Range 1
                - 48 MHz when the product is in Range 2
                - 24 MHz when the product is in Range 3
                If the USB uses the PLL as clock source, the PLL VCO clock must be
                programmed to output a 96 MHz frequency (USBCLK = PLLVCO/2).



             This property is **required**.

             Legal values: ``3``, ``4``, ``6``, ``8``, ``12``, ``16``, ``24``, ``32``, ``48``



   .. group-tab:: Deprecated node specific properties

      Deprecated properties not inherited from the base binding file.

      (None)

   .. group-tab:: Base properties

      Properties inherited from the base binding file, which defines
      common properties that may be set on many nodes. Not all of these
      may apply to the "st,stm32l0-pll-clock" compatible.

      .. list-table::
         :widths: 1 1 4
         :header-rows: 1

         * - Name
           - Type
           - Details

         * - ``clocks``
           - ``phandle-array``
           - .. code-block:: none

                Clock gate information


             This property is **required**.

         * - ``status``
           - ``string``
           - .. code-block:: none

                indicates the operational status of a device


             Legal values: ``'ok'``, ``'okay'``, ``'disabled'``, ``'reserved'``, ``'fail'``, ``'fail-sss'``

             See :ref:`dt-important-props` for more information.

         * - ``compatible``
           - ``string-array``
           - .. code-block:: none

                compatible strings


             This property is **required**.

             See :ref:`dt-important-props` for more information.

         * - ``reg``
           - ``array``
           - .. code-block:: none

                register space


             See :ref:`dt-important-props` for more information.

         * - ``reg-names``
           - ``string-array``
           - .. code-block:: none

                name of each register space


         * - ``interrupts``
           - ``array``
           - .. code-block:: none

                interrupts for device


             See :ref:`dt-important-props` for more information.

         * - ``interrupts-extended``
           - ``compound``
           - .. code-block:: none

                extended interrupt specifier for device


         * - ``interrupt-names``
           - ``string-array``
           - .. code-block:: none

                name of each interrupt


         * - ``interrupt-parent``
           - ``phandle``
           - .. code-block:: none

                phandle to interrupt controller node


         * - ``label``
           - ``string``
           - .. code-block:: none

                Human readable string describing the device (used as device_get_binding() argument)


             See :ref:`dt-important-props` for more information.

         * - ``clock-names``
           - ``string-array``
           - .. code-block:: none

                name of each clock


         * - ``#address-cells``
           - ``int``
           - .. code-block:: none

                number of address cells in reg property


         * - ``#size-cells``
           - ``int``
           - .. code-block:: none

                number of size cells in reg property


         * - ``dmas``
           - ``phandle-array``
           - .. code-block:: none

                DMA channels specifiers


         * - ``dma-names``
           - ``string-array``
           - .. code-block:: none

                Provided names of DMA channel specifiers


         * - ``io-channels``
           - ``phandle-array``
           - .. code-block:: none

                IO channels specifiers


         * - ``io-channel-names``
           - ``string-array``
           - .. code-block:: none

                Provided names of IO channel specifiers


         * - ``mboxes``
           - ``phandle-array``
           - .. code-block:: none

                mailbox / IPM channels specifiers


         * - ``mbox-names``
           - ``string-array``
           - .. code-block:: none

                Provided names of mailbox / IPM channel specifiers


         * - ``wakeup-source``
           - ``boolean``
           - .. code-block:: none

                Property to identify that a device can be used as wake up source.

                When this property is provided a specific flag is set into the
                device that tells the system that the device is capable of
                wake up the system.

                Wake up capable devices are disabled (interruptions will not wake up
                the system) by default but they can be enabled at runtime if necessary.



         * - ``power-domain``
           - ``phandle``
           - .. code-block:: none


                Power domain the device belongs to.

                The device will be notified when the power domain it belongs to is either
                suspended or resumed.
```
