## latest/zephyr/_sources/reference/devicetree/bindings/regulator/regulator-pmic.rst.txt
```
:orphan:

.. raw:: html

    <!--
    FIXME: do not limit page width until content uses another representation
    format other than tables
    -->
    <style>.wy-nav-content { max-width: none; !important }</style>

.. dtcompatible:: regulator-pmic
.. _dtbinding_regulator_pmic:

regulator-pmic
##############

Vendor: :ref:`Generic or vendor-independent <dt_no_vendor>`

Description
***********



.. code-block:: none

   PMIC controlled regulator

Properties
**********

.. tabs::

   .. group-tab:: Node specific properties

      Properties not inherited from the base binding file.

      .. list-table::
         :widths: 1 1 4
         :header-rows: 1

         * - Name
           - Type
           - Details

         * - ``voltage-range``
           - ``array``
           - .. code-block:: none

                array of voltage values in uV, followed by the register value that
                must be written to enable the voltage. For example, [3300000, 0x3]
                denotes a value of 0x3 must be written to the register to set 3.3V



             This property is **required**.

         * - ``num-voltages``
           - ``int``
           - .. code-block:: none

                number of voltages present in the voltage-range array.


             This property is **required**.

         * - ``vsel-reg``
           - ``int``
           - .. code-block:: none

                I2C register to write voltage selection value to


             This property is **required**.

         * - ``vsel-mask``
           - ``int``
           - .. code-block:: none

                Mask to apply to the voltage range value when written to vsel
                register



             This property is **required**.

         * - ``enable-reg``
           - ``int``
           - .. code-block:: none

                I2C register to write enable value to


             This property is **required**.

         * - ``enable-mask``
           - ``int``
           - .. code-block:: none

                Mask to apply to the enable bit (either 1 for enabled,
                or 0 for disabled) when writing it to the I2C enable register.



             This property is **required**.

         * - ``enable-val``
           - ``int``
           - .. code-block:: none

                value to apply enable-mask to, and write to enable-reg in order
                to enable the regulator output.



             This property is **required**.

         * - ``min-uV``
           - ``int``
           - .. code-block:: none

                Minimum voltage in microvolts that this regulator supports



             This property is **required**.

         * - ``max-uV``
           - ``int``
           - .. code-block:: none

                Maximum voltage in microvolts that this regulator supports



             This property is **required**.

         * - ``enable-inverted``
           - ``boolean``
           - .. code-block:: none

                If the enable bit should be zero to turn the regulator on, add this
                property.



         * - ``current-levels``
           - ``array``
           - .. code-block:: none

                Array of current limit values in uA, followed by the register value
                that must be written to enable the current limit. For example,
                [800000, 0x3] denotes a value of 0x3 must be written to the register
                to set a current limit of 800mA



         * - ``num-current-levels``
           - ``int``
           - .. code-block:: none

                Number of current limit levels this regulator supports. If left as
                default, regulator current support will be disabled.



         * - ``ilim-reg``
           - ``int``
           - .. code-block:: none

                Register to write the register value given in current-levels into
                to set the current limit



         * - ``ilim-mask``
           - ``int``
           - .. code-block:: none

                Mask to apply to the current-levels value before writing it to the
                ilim-reg value to set the current limit



         * - ``regulator-always-on``
           - ``boolean``
           - .. code-block:: none

                regulator should always be on


         * - ``regulator-boot-on``
           - ``boolean``
           - .. code-block:: none

                regulator should be turned on at startup


         * - ``supply-gpios``
           - ``phandle-array``
           - .. code-block:: none

                GPIO specifier that controls power to the device.

                This property should be provided when the device has a dedicated
                switch that controls power to the device.  The supply state is
                entirely the responsibility of the device driver.

                Contrast with vin-supply.



         * - ``vin-supply``
           - ``phandle``
           - .. code-block:: none

                Reference to the regulator that controls power to the device.
                The referenced devicetree node must have a regulator compatible.

                This property should be provided when device power is supplied
                by a shared regulator.  The supply state is dependent on the
                request status of all devices fed by the regulator.

                Contrast with supply-gpios.  If both properties are provided
                then the regulator must be requested before the supply GPIOS is
                set to an active state, and the supply GPIOS must be set to an
                inactive state before releasing the regulator.





   .. group-tab:: Deprecated node specific properties

      Deprecated properties not inherited from the base binding file.

      (None)

   .. group-tab:: Base properties

      Properties inherited from the base binding file, which defines
      common properties that may be set on many nodes. Not all of these
      may apply to the "regulator-pmic" compatible.

      .. list-table::
         :widths: 1 1 4
         :header-rows: 1

         * - Name
           - Type
           - Details

         * - ``label``
           - ``string``
           - .. code-block:: none

                Human readable string describing the device (used as device_get_binding() argument)


             See :ref:`dt-important-props` for more information.

         * - ``status``
           - ``string``
           - .. code-block:: none

                indicates the operational status of a device


             Legal values: ``'ok'``, ``'okay'``, ``'disabled'``, ``'reserved'``, ``'fail'``, ``'fail-sss'``

             See :ref:`dt-important-props` for more information.

         * - ``compatible``
           - ``string-array``
           - .. code-block:: none

                compatible strings


             This property is **required**.

             See :ref:`dt-important-props` for more information.

         * - ``reg``
           - ``array``
           - .. code-block:: none

                register space


             See :ref:`dt-important-props` for more information.

         * - ``reg-names``
           - ``string-array``
           - .. code-block:: none

                name of each register space


         * - ``interrupts``
           - ``array``
           - .. code-block:: none

                interrupts for device


             See :ref:`dt-important-props` for more information.

         * - ``interrupts-extended``
           - ``compound``
           - .. code-block:: none

                extended interrupt specifier for device


         * - ``interrupt-names``
           - ``string-array``
           - .. code-block:: none

                name of each interrupt


         * - ``interrupt-parent``
           - ``phandle``
           - .. code-block:: none

                phandle to interrupt controller node


         * - ``clocks``
           - ``phandle-array``
           - .. code-block:: none

                Clock gate information


         * - ``clock-names``
           - ``string-array``
           - .. code-block:: none

                name of each clock


         * - ``#address-cells``
           - ``int``
           - .. code-block:: none

                number of address cells in reg property


         * - ``#size-cells``
           - ``int``
           - .. code-block:: none

                number of size cells in reg property


         * - ``dmas``
           - ``phandle-array``
           - .. code-block:: none

                DMA channels specifiers


         * - ``dma-names``
           - ``string-array``
           - .. code-block:: none

                Provided names of DMA channel specifiers


         * - ``io-channels``
           - ``phandle-array``
           - .. code-block:: none

                IO channels specifiers


         * - ``io-channel-names``
           - ``string-array``
           - .. code-block:: none

                Provided names of IO channel specifiers


         * - ``mboxes``
           - ``phandle-array``
           - .. code-block:: none

                mailbox / IPM channels specifiers


         * - ``mbox-names``
           - ``string-array``
           - .. code-block:: none

                Provided names of mailbox / IPM channel specifiers


         * - ``wakeup-source``
           - ``boolean``
           - .. code-block:: none

                Property to identify that a device can be used as wake up source.

                When this property is provided a specific flag is set into the
                device that tells the system that the device is capable of
                wake up the system.

                Wake up capable devices are disabled (interruptions will not wake up
                the system) by default but they can be enabled at runtime if necessary.



         * - ``power-domain``
           - ``phandle``
           - .. code-block:: none


                Power domain the device belongs to.

                The device will be notified when the power domain it belongs to is either
                suspended or resumed.
```

## latest/zephyr/_sources/reference/devicetree/bindings/reserved-memory/reserved-memory.rst.txt
```
:orphan:

.. raw:: html

    <!--
    FIXME: do not limit page width until content uses another representation
    format other than tables
    -->
    <style>.wy-nav-content { max-width: none; !important }</style>

.. dtcompatible:: reserved-memory
.. _dtbinding_reserved_memory:

reserved-memory
###############

Vendor: :ref:`Generic or vendor-independent <dt_no_vendor>`

Description
***********



.. code-block:: none

   Reserved memory - Each child of the reserved-memory node specifies one or
   more regions of reserved memory. Regions in the /reserved-memory node may be
   referenced by other device nodes by adding a memory-region property to the
   device node.

Properties
**********

Top level properties
====================


These property descriptions apply to "reserved-memory"
nodes themselves. This page also describes child node
properties in the following sections.

.. tabs::

   .. group-tab:: Node specific properties

      Properties not inherited from the base binding file.

      (None)

   .. group-tab:: Deprecated node specific properties

      Deprecated properties not inherited from the base binding file.

      (None)

   .. group-tab:: Base properties

      Properties inherited from the base binding file, which defines
      common properties that may be set on many nodes. Not all of these
      may apply to the "reserved-memory" compatible.

      .. list-table::
         :widths: 1 1 4
         :header-rows: 1

         * - Name
           - Type
           - Details

         * - ``#address-cells``
           - ``int``
           - .. code-block:: none

                number of address cells in reg property


         * - ``#size-cells``
           - ``int``
           - .. code-block:: none

                number of size cells in reg property





Child node properties
=====================

.. list-table::
   :widths: 1 1 4
   :header-rows: 1

   * - Name
     - Type
     - Details

   * - ``label``
     - ``string``
     - .. code-block:: none

          Human readable string describing the device (used as device_get_binding() argument)


       See :ref:`dt-important-props` for more information.

   * - ``reg``
     - ``array``
     - .. code-block:: none

          register space


       This property is **required**.

       See :ref:`dt-important-props` for more information.
```
