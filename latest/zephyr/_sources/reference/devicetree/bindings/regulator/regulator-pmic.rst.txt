## latest/zephyr/_sources/reference/devicetree/bindings/spi/nxp,kinetis-dspi.rst.txt
```
:orphan:

.. raw:: html

    <!--
    FIXME: do not limit page width until content uses another representation
    format other than tables
    -->
    <style>.wy-nav-content { max-width: none; !important }</style>

.. dtcompatible:: nxp,kinetis-dspi
.. _dtbinding_nxp_kinetis_dspi:

nxp,kinetis-dspi
################

Vendor: :ref:`NXP Semiconductors <dt_vendor_nxp>`

Description
***********

These nodes are "spi" bus nodes.

.. code-block:: none

   NXP Kinetis DSPI controller

Properties
**********

.. tabs::

   .. group-tab:: Node specific properties

      Properties not inherited from the base binding file.

      .. list-table::
         :widths: 1 1 4
         :header-rows: 1

         * - Name
           - Type
           - Details

         * - ``pcs-sck-delay``
           - ``int``
           - .. code-block:: none

                Delay in nanoseconds from the chip select assert to the first clock
                edge. If not set, the minimum supported delay is used.



         * - ``sck-pcs-delay``
           - ``int``
           - .. code-block:: none

                Delay in nanoseconds from the last clock edge to the chip select
                deassert. If not set, the minimum supported delay is used.



         * - ``transfer-delay``
           - ``int``
           - .. code-block:: none

                Delay in nanoseconds from the chip select deassert to the next chip
                select assert. If not set, the minimum supported delay is used.



         * - ``pinctrl-0``
           - ``phandles``
           - This property is **required**.

         * - ``nxp,rx-tx-chn-share``
           - ``boolean``
           - .. code-block:: none

                If the edma channel shared with tx and rx


         * - ``ctar``
           - ``int``
           - .. code-block:: none

                ctar register selection range form 0-1 for master mode, 0 for slave mode



         * - ``sample-point``
           - ``int``
           - .. code-block:: none

                Controls when the DSPI master samples SIN in the Modified Transfer Format.
                This field is valid only when the CPHA bit in the CTAR register is 0.



         * - ``continuous-sck``
           - ``boolean``
           - .. code-block:: none

                continuous SCK enable. Note that the continuous SCK is only
                supported for CPHA = 1.



         * - ``rx-fifo-overwrite``
           - ``boolean``
           - .. code-block:: none

                receive FIFO overflow overwrite enable. If ROOE = 0, the incoming
                data is ignored and the data from the transfer that generated the overflow
                is also ignored. If ROOE = 1, the incoming data is shifted to the
                shift register.



         * - ``modified-timing-format``
           - ``boolean``
           - .. code-block:: none

                Enables a modified transfer format to be used if true.



         * - ``tx-fifo-size``
           - ``int``
           - .. code-block:: none

                tx fifo size



         * - ``rx-fifo-size``
           - ``int``
           - .. code-block:: none

                rx fifo size



         * - ``clock-frequency``
           - ``int``
           - .. code-block:: none

                Clock frequency the SPI peripheral is being driven at, in Hz.



         * - ``cs-gpios``
           - ``phandle-array``
           - .. code-block:: none

                An array of chip select GPIOs to use. Each element
                in the array specifies a GPIO. The index in the array
                corresponds to the child node that the CS gpio controls.

                Example:

                  spi@... {
                          cs-gpios = <&gpio0 23 GPIO_ACTIVE_LOW>,
                                        <&gpio1 10 GPIO_ACTIVE_LOW>,
                                        ...;

                          spi-device@0 {
                                  reg = <0>;
                                  ...
                          };
                          spi-device@1 {
                                  reg = <1>;
                                  ...
                          };
                          ...
                  };

                The child node "spi-device@0" specifies a SPI device with
                chip select controller gpio0, pin 23, and devicetree
                GPIO flags GPIO_ACTIVE_LOW. Similarly, "spi-device@1" has CS GPIO
                controller gpio1, pin 10, and flags GPIO_ACTIVE_LOW. Additional
                devices can be configured in the same way.

                If unsure about the flags cell, GPIO_ACTIVE_LOW is generally a safe
                choice for a typical "CSn" pin. GPIO_ACTIVE_HIGH may be used if
                intervening hardware inverts the signal to the peripheral device or
                the line itself is active high.

                If this property is not defined, no chip select GPIOs are set.
                SPI controllers with dedicated CS pins do not need to define
                the cs-gpios property.





   .. group-tab:: Deprecated node specific properties

      Deprecated properties not inherited from the base binding file.

      (None)

   .. group-tab:: Base properties

      Properties inherited from the base binding file, which defines
      common properties that may be set on many nodes. Not all of these
      may apply to the "nxp,kinetis-dspi" compatible.

      .. list-table::
         :widths: 1 1 4
         :header-rows: 1

         * - Name
           - Type
           - Details

         * - ``reg``
           - ``array``
           - .. code-block:: none

                register space


             This property is **required**.

             See :ref:`dt-important-props` for more information.

         * - ``interrupts``
           - ``array``
           - .. code-block:: none

                interrupts for device


             This property is **required**.

             See :ref:`dt-important-props` for more information.

         * - ``clocks``
           - ``phandle-array``
           - .. code-block:: none

                Clock gate information


             This property is **required**.

         * - ``#address-cells``
           - ``int``
           - .. code-block:: none

                number of address cells in reg property


             This property is **required**.

             Constant value: ``1``

         * - ``#size-cells``
           - ``int``
           - .. code-block:: none

                number of size cells in reg property


             This property is **required**.

         * - ``label``
           - ``string``
           - .. code-block:: none

                Human readable string describing the device (used as device_get_binding() argument)


             This property is **required**.

             See :ref:`dt-important-props` for more information.

         * - ``status``
           - ``string``
           - .. code-block:: none

                indicates the operational status of a device


             Legal values: ``'ok'``, ``'okay'``, ``'disabled'``, ``'reserved'``, ``'fail'``, ``'fail-sss'``

             See :ref:`dt-important-props` for more information.

         * - ``compatible``
           - ``string-array``
           - .. code-block:: none

                compatible strings


             This property is **required**.

             See :ref:`dt-important-props` for more information.

         * - ``reg-names``
           - ``string-array``
           - .. code-block:: none

                name of each register space


         * - ``interrupts-extended``
           - ``compound``
           - .. code-block:: none

                extended interrupt specifier for device


         * - ``interrupt-names``
           - ``string-array``
           - .. code-block:: none

                name of each interrupt


         * - ``interrupt-parent``
           - ``phandle``
           - .. code-block:: none

                phandle to interrupt controller node


         * - ``clock-names``
           - ``string-array``
           - .. code-block:: none

                name of each clock


         * - ``dmas``
           - ``phandle-array``
           - .. code-block:: none

                DMA channels specifiers


         * - ``dma-names``
           - ``string-array``
           - .. code-block:: none

                Provided names of DMA channel specifiers


         * - ``io-channels``
           - ``phandle-array``
           - .. code-block:: none

                IO channels specifiers


         * - ``io-channel-names``
           - ``string-array``
           - .. code-block:: none

                Provided names of IO channel specifiers


         * - ``mboxes``
           - ``phandle-array``
           - .. code-block:: none

                mailbox / IPM channels specifiers


         * - ``mbox-names``
           - ``string-array``
           - .. code-block:: none

                Provided names of mailbox / IPM channel specifiers


         * - ``wakeup-source``
           - ``boolean``
           - .. code-block:: none

                Property to identify that a device can be used as wake up source.

                When this property is provided a specific flag is set into the
                device that tells the system that the device is capable of
                wake up the system.

                Wake up capable devices are disabled (interruptions will not wake up
                the system) by default but they can be enabled at runtime if necessary.



         * - ``power-domain``
           - ``phandle``
           - .. code-block:: none


                Power domain the device belongs to.

                The device will be notified when the power domain it belongs to is either
                suspended or resumed.
```
