## latest/zephyr/_sources/reference/devicetree/bindings/sensor/we,wsen-itds.rst.txt
```
:orphan:

.. raw:: html

    <!--
    FIXME: do not limit page width until content uses another representation
    format other than tables
    -->
    <style>.wy-nav-content { max-width: none; !important }</style>

.. dtcompatible:: we,wsen-itds
.. _dtbinding_we_wsen_itds:

we,wsen-itds (on i2c bus)
#########################

Vendor: :ref:`Würth Elektronik GmbH. <dt_vendor_we>`

Description
***********



.. code-block:: none

   WSEN-ITDS 3-axis accel sensor

Properties
**********

.. tabs::

   .. group-tab:: Node specific properties

      Properties not inherited from the base binding file.

      .. list-table::
         :widths: 1 1 4
         :header-rows: 1

         * - Name
           - Type
           - Details

         * - ``int-gpios``
           - ``phandle-array``
           - .. code-block:: none

                This property specifies the connection for INT0, the driver maps
                all interrupts to INT0 as default. The signal to output high when
                data produced by the sensor.



         * - ``odr``
           - ``string``
           - .. code-block:: none

                Output data rate in Hz


             This property is **required**.

             Legal values: ``'1.6'``, ``'12.5'``, ``'25'``, ``'50'``, ``'100'``, ``'200'``, ``'400'``, ``'800'``, ``'1600'``

         * - ``op-mode``
           - ``string``
           - .. code-block:: none

                Operating mode of sensor


             This property is **required**.

             Legal values: ``'low-power'``, ``'normal'``, ``'high-perf'``

         * - ``supply-gpios``
           - ``phandle-array``
           - .. code-block:: none

                GPIO specifier that controls power to the device.

                This property should be provided when the device has a dedicated
                switch that controls power to the device.  The supply state is
                entirely the responsibility of the device driver.

                Contrast with vin-supply.



         * - ``vin-supply``
           - ``phandle``
           - .. code-block:: none

                Reference to the regulator that controls power to the device.
                The referenced devicetree node must have a regulator compatible.

                This property should be provided when device power is supplied
                by a shared regulator.  The supply state is dependent on the
                request status of all devices fed by the regulator.

                Contrast with supply-gpios.  If both properties are provided
                then the regulator must be requested before the supply GPIOS is
                set to an active state, and the supply GPIOS must be set to an
                inactive state before releasing the regulator.





   .. group-tab:: Deprecated node specific properties

      Deprecated properties not inherited from the base binding file.

      (None)

   .. group-tab:: Base properties

      Properties inherited from the base binding file, which defines
      common properties that may be set on many nodes. Not all of these
      may apply to the "we,wsen-itds" compatible.

      .. list-table::
         :widths: 1 1 4
         :header-rows: 1

         * - Name
           - Type
           - Details

         * - ``reg``
           - ``array``
           - .. code-block:: none

                device address on i2c bus


             This property is **required**.

             See :ref:`dt-important-props` for more information.

         * - ``label``
           - ``string``
           - .. code-block:: none

                Human readable string describing the device (used as device_get_binding() argument)


             This property is **required**.

             See :ref:`dt-important-props` for more information.

         * - ``status``
           - ``string``
           - .. code-block:: none

                indicates the operational status of a device


             Legal values: ``'ok'``, ``'okay'``, ``'disabled'``, ``'reserved'``, ``'fail'``, ``'fail-sss'``

             See :ref:`dt-important-props` for more information.

         * - ``compatible``
           - ``string-array``
           - .. code-block:: none

                compatible strings


             This property is **required**.

             See :ref:`dt-important-props` for more information.

         * - ``reg-names``
           - ``string-array``
           - .. code-block:: none

                name of each register space


         * - ``interrupts``
           - ``array``
           - .. code-block:: none

                interrupts for device


             See :ref:`dt-important-props` for more information.

         * - ``interrupts-extended``
           - ``compound``
           - .. code-block:: none

                extended interrupt specifier for device


         * - ``interrupt-names``
           - ``string-array``
           - .. code-block:: none

                name of each interrupt


         * - ``interrupt-parent``
           - ``phandle``
           - .. code-block:: none

                phandle to interrupt controller node


         * - ``clocks``
           - ``phandle-array``
           - .. code-block:: none

                Clock gate information


         * - ``clock-names``
           - ``string-array``
           - .. code-block:: none

                name of each clock


         * - ``#address-cells``
           - ``int``
           - .. code-block:: none

                number of address cells in reg property


         * - ``#size-cells``
           - ``int``
           - .. code-block:: none

                number of size cells in reg property


         * - ``dmas``
           - ``phandle-array``
           - .. code-block:: none

                DMA channels specifiers


         * - ``dma-names``
           - ``string-array``
           - .. code-block:: none

                Provided names of DMA channel specifiers


         * - ``io-channels``
           - ``phandle-array``
           - .. code-block:: none

                IO channels specifiers


         * - ``io-channel-names``
           - ``string-array``
           - .. code-block:: none

                Provided names of IO channel specifiers


         * - ``mboxes``
           - ``phandle-array``
           - .. code-block:: none

                mailbox / IPM channels specifiers


         * - ``mbox-names``
           - ``string-array``
           - .. code-block:: none

                Provided names of mailbox / IPM channel specifiers


         * - ``wakeup-source``
           - ``boolean``
           - .. code-block:: none

                Property to identify that a device can be used as wake up source.

                When this property is provided a specific flag is set into the
                device that tells the system that the device is capable of
                wake up the system.

                Wake up capable devices are disabled (interruptions will not wake up
                the system) by default but they can be enabled at runtime if necessary.



         * - ``power-domain``
           - ``phandle``
           - .. code-block:: none


                Power domain the device belongs to.

                The device will be notified when the power domain it belongs to is either
                suspended or resumed.
```

## latest/zephyr/_sources/reference/devicetree/bindings/serial/atmel,sam0-uart.rst.txt
```
:orphan:

.. raw:: html

    <!--
    FIXME: do not limit page width until content uses another representation
    format other than tables
    -->
    <style>.wy-nav-content { max-width: none; !important }</style>

.. dtcompatible:: atmel,sam0-uart
.. _dtbinding_atmel_sam0_uart:

atmel,sam0-uart
###############

Vendor: :ref:`Atmel Corporation <dt_vendor_atmel>`

Description
***********

These nodes are "uart" bus nodes.

.. code-block:: none

   Atmel SAM0 SERCOM UART driver

Properties
**********

.. tabs::

   .. group-tab:: Node specific properties

      Properties not inherited from the base binding file.

      .. list-table::
         :widths: 1 1 4
         :header-rows: 1

         * - Name
           - Type
           - Details

         * - ``rxpo``
           - ``int``
           - .. code-block:: none

                Receive Data Pinout


             This property is **required**.

         * - ``txpo``
           - ``int``
           - .. code-block:: none

                Transmit Data Pinout


             This property is **required**.

         * - ``collision-detection``
           - ``boolean``
           - .. code-block:: none

                Enable collision detection for half-duplex mode.


         * - ``pinctrl-0``
           - ``phandles``
           - .. code-block:: none

                PORT pin configuration for RXD & TRD signals.  We expect that
                the phandles will reference pinctrl nodes.  These nodes will
                have a nodelabel that matches the Atmel SoC HAL defines and
                be of the form p<port><pin><periph>_<inst>_<signal>.

                For example the SERCOM0 on SAMR21 would be
                   pinctrl-0 = <&pa5d_sercom0_pad1 &pa4d_sercom0_pad0>;



             This property is **required**.

         * - ``clock-frequency``
           - ``int``
           - .. code-block:: none

                Clock frequency information for UART operation


         * - ``current-speed``
           - ``int``
           - .. code-block:: none

                Initial baud rate setting for UART


         * - ``hw-flow-control``
           - ``boolean``
           - .. code-block:: none

                Set to enable RTS/CTS flow control at boot time


         * - ``parity``
           - ``string``
           - .. code-block:: none

                Configures the parity of the adapter. Enumeration id 0 for none, 1 for odd
                and 2 for even parity. Default to none if not specified.



             Legal values: ``'none'``, ``'odd'``, ``'even'``



   .. group-tab:: Deprecated node specific properties

      Deprecated properties not inherited from the base binding file.

      (None)

   .. group-tab:: Base properties

      Properties inherited from the base binding file, which defines
      common properties that may be set on many nodes. Not all of these
      may apply to the "atmel,sam0-uart" compatible.

      .. list-table::
         :widths: 1 1 4
         :header-rows: 1

         * - Name
           - Type
           - Details

         * - ``reg``
           - ``array``
           - .. code-block:: none

                register space


             This property is **required**.

             See :ref:`dt-important-props` for more information.

         * - ``interrupts``
           - ``array``
           - .. code-block:: none

                interrupts for device


             This property is **required**.

             See :ref:`dt-important-props` for more information.

         * - ``clocks``
           - ``phandle-array``
           - .. code-block:: none

                Clock gate information


             This property is **required**.

         * - ``clock-names``
           - ``string-array``
           - .. code-block:: none

                name of each clock


             This property is **required**.

         * - ``dmas``
           - ``phandle-array``
           - .. code-block:: none

                Optional TX & RX dma specifiers.  Each specifier will have a phandle
                reference to the dmac controller, the channel number, and peripheral
                trigger source.

                For example dmas for TX, RX on SERCOM3
                   dmas = <&dmac 0 0xb>, <&dmac 0 0xa>;



         * - ``dma-names``
           - ``string-array``
           - .. code-block:: none

                Required if the dmas property exists.  This should be "tx" and "rx"
                to match the dmas property.

                For example
                   dma-names = "tx", "rx";



         * - ``label``
           - ``string``
           - .. code-block:: none

                Human readable string describing the device (used as device_get_binding() argument)


             This property is **required**.

             See :ref:`dt-important-props` for more information.

         * - ``status``
           - ``string``
           - .. code-block:: none

                indicates the operational status of a device


             Legal values: ``'ok'``, ``'okay'``, ``'disabled'``, ``'reserved'``, ``'fail'``, ``'fail-sss'``

             See :ref:`dt-important-props` for more information.

         * - ``compatible``
           - ``string-array``
           - .. code-block:: none

                compatible strings


             This property is **required**.

             See :ref:`dt-important-props` for more information.

         * - ``reg-names``
           - ``string-array``
           - .. code-block:: none

                name of each register space


         * - ``interrupts-extended``
           - ``compound``
           - .. code-block:: none

                extended interrupt specifier for device


         * - ``interrupt-names``
           - ``string-array``
           - .. code-block:: none

                name of each interrupt


         * - ``interrupt-parent``
           - ``phandle``
           - .. code-block:: none

                phandle to interrupt controller node


         * - ``#address-cells``
           - ``int``
           - .. code-block:: none

                number of address cells in reg property


         * - ``#size-cells``
           - ``int``
           - .. code-block:: none

                number of size cells in reg property


         * - ``io-channels``
           - ``phandle-array``
           - .. code-block:: none

                IO channels specifiers


         * - ``io-channel-names``
           - ``string-array``
           - .. code-block:: none

                Provided names of IO channel specifiers


         * - ``mboxes``
           - ``phandle-array``
           - .. code-block:: none

                mailbox / IPM channels specifiers


         * - ``mbox-names``
           - ``string-array``
           - .. code-block:: none

                Provided names of mailbox / IPM channel specifiers


         * - ``wakeup-source``
           - ``boolean``
           - .. code-block:: none

                Property to identify that a device can be used as wake up source.

                When this property is provided a specific flag is set into the
                device that tells the system that the device is capable of
                wake up the system.

                Wake up capable devices are disabled (interruptions will not wake up
                the system) by default but they can be enabled at runtime if necessary.



         * - ``power-domain``
           - ``phandle``
           - .. code-block:: none


                Power domain the device belongs to.

                The device will be notified when the power domain it belongs to is either
                suspended or resumed.
```
