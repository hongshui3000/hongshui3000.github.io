## latest/zephyr/_sources/reference/devicetree/bindings/sensor/invensense,mpu9250.rst.txt
```
:orphan:

.. raw:: html

    <!--
    FIXME: do not limit page width until content uses another representation
    format other than tables
    -->
    <style>.wy-nav-content { max-width: none; !important }</style>

.. dtcompatible:: invensense,mpu9250
.. _dtbinding_invensense_mpu9250:

invensense,mpu9250 (on i2c bus)
###############################

Vendor: :ref:`InvenSense Inc. <dt_vendor_invensense>`

Description
***********



.. code-block:: none

   InvenSense MPU-9250 Nine-Axis (Gyro + Accelerometer + Compass). See more
   info at https://www.invensense.com/products/motion-tracking/9-axis/mpu-9250/

Properties
**********

.. tabs::

   .. group-tab:: Node specific properties

      Properties not inherited from the base binding file.

      .. list-table::
         :widths: 1 1 4
         :header-rows: 1

         * - Name
           - Type
           - Details

         * - ``irq-gpios``
           - ``phandle-array``
           - .. code-block:: none

                The INT signal default configuration is active-high.  The
                property value should ensure the flags properly describe the
                signal that is presented to the driver.
                This property is required when the trigger mode is used.



         * - ``gyro-sr-div``
           - ``int``
           - .. code-block:: none

                Default gyrscope sample rate divider. This divider is only effective
                when gyro-dlpf is in range 5-184.
                rate = sample_rate / (1 + gyro-sr-div)
                Valid range: 0 - 255



             This property is **required**.

         * - ``gyro-dlpf``
           - ``int``
           - .. code-block:: none

                Default digital low pass filter frequency of gyroscope.
                Maps to DLPF_CFG field in Configuration setting.



             This property is **required**.

             Legal values: ``250``, ``184``, ``92``, ``41``, ``20``, ``10``, ``5``, ``3600``

         * - ``gyro-fs``
           - ``int``
           - .. code-block:: none

                Default full scale of gyroscope. (Unit - DPS).
                Maps to GYRO_FS_SEL field in Gyroscope Configuration setting.



             This property is **required**.

             Legal values: ``250``, ``500``, ``1000``, ``2000``

         * - ``accel-fs``
           - ``int``
           - .. code-block:: none

                Default full scale of accelerometer. (Unit - g)
                Maps to ACCEL_FS_SEL field in Accelerometer Configuration setting



             This property is **required**.

             Legal values: ``2``, ``4``, ``8``, ``16``

         * - ``accel-dlpf``
           - ``string``
           - .. code-block:: none

                Default digital low pass filter frequency of accelerometer.
                Maps to DLPF_CFG field in Accelerometer Configuration 2 setting.



             This property is **required**.

             Legal values: ``'218.1'``, ``'218.1a'``, ``'99'``, ``'44.8'``, ``'21.2'``, ``'10.2'``, ``'5.05'``, ``'420'``

         * - ``supply-gpios``
           - ``phandle-array``
           - .. code-block:: none

                GPIO specifier that controls power to the device.

                This property should be provided when the device has a dedicated
                switch that controls power to the device.  The supply state is
                entirely the responsibility of the device driver.

                Contrast with vin-supply.



         * - ``vin-supply``
           - ``phandle``
           - .. code-block:: none

                Reference to the regulator that controls power to the device.
                The referenced devicetree node must have a regulator compatible.

                This property should be provided when device power is supplied
                by a shared regulator.  The supply state is dependent on the
                request status of all devices fed by the regulator.

                Contrast with supply-gpios.  If both properties are provided
                then the regulator must be requested before the supply GPIOS is
                set to an active state, and the supply GPIOS must be set to an
                inactive state before releasing the regulator.





   .. group-tab:: Deprecated node specific properties

      Deprecated properties not inherited from the base binding file.

      (None)

   .. group-tab:: Base properties

      Properties inherited from the base binding file, which defines
      common properties that may be set on many nodes. Not all of these
      may apply to the "invensense,mpu9250" compatible.

      .. list-table::
         :widths: 1 1 4
         :header-rows: 1

         * - Name
           - Type
           - Details

         * - ``reg``
           - ``array``
           - .. code-block:: none

                device address on i2c bus


             This property is **required**.

             See :ref:`dt-important-props` for more information.

         * - ``label``
           - ``string``
           - .. code-block:: none

                Human readable string describing the device (used as device_get_binding() argument)


             This property is **required**.

             See :ref:`dt-important-props` for more information.

         * - ``status``
           - ``string``
           - .. code-block:: none

                indicates the operational status of a device


             Legal values: ``'ok'``, ``'okay'``, ``'disabled'``, ``'reserved'``, ``'fail'``, ``'fail-sss'``

             See :ref:`dt-important-props` for more information.

         * - ``compatible``
           - ``string-array``
           - .. code-block:: none

                compatible strings


             This property is **required**.

             See :ref:`dt-important-props` for more information.

         * - ``reg-names``
           - ``string-array``
           - .. code-block:: none

                name of each register space


         * - ``interrupts``
           - ``array``
           - .. code-block:: none

                interrupts for device


             See :ref:`dt-important-props` for more information.

         * - ``interrupts-extended``
           - ``compound``
           - .. code-block:: none

                extended interrupt specifier for device


         * - ``interrupt-names``
           - ``string-array``
           - .. code-block:: none

                name of each interrupt


         * - ``interrupt-parent``
           - ``phandle``
           - .. code-block:: none

                phandle to interrupt controller node


         * - ``clocks``
           - ``phandle-array``
           - .. code-block:: none

                Clock gate information


         * - ``clock-names``
           - ``string-array``
           - .. code-block:: none

                name of each clock


         * - ``#address-cells``
           - ``int``
           - .. code-block:: none

                number of address cells in reg property


         * - ``#size-cells``
           - ``int``
           - .. code-block:: none

                number of size cells in reg property


         * - ``dmas``
           - ``phandle-array``
           - .. code-block:: none

                DMA channels specifiers


         * - ``dma-names``
           - ``string-array``
           - .. code-block:: none

                Provided names of DMA channel specifiers


         * - ``io-channels``
           - ``phandle-array``
           - .. code-block:: none

                IO channels specifiers


         * - ``io-channel-names``
           - ``string-array``
           - .. code-block:: none

                Provided names of IO channel specifiers


         * - ``mboxes``
           - ``phandle-array``
           - .. code-block:: none

                mailbox / IPM channels specifiers


         * - ``mbox-names``
           - ``string-array``
           - .. code-block:: none

                Provided names of mailbox / IPM channel specifiers


         * - ``wakeup-source``
           - ``boolean``
           - .. code-block:: none

                Property to identify that a device can be used as wake up source.

                When this property is provided a specific flag is set into the
                device that tells the system that the device is capable of
                wake up the system.

                Wake up capable devices are disabled (interruptions will not wake up
                the system) by default but they can be enabled at runtime if necessary.



         * - ``power-domain``
           - ``phandle``
           - .. code-block:: none


                Power domain the device belongs to.

                The device will be notified when the power domain it belongs to is either
                suspended or resumed.
```
