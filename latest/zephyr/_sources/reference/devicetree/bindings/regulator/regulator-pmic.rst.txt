## latest/zephyr/_sources/reference/devicetree/bindings/serial/nordic,nrf-uart.rst.txt
```
:orphan:

.. raw:: html

    <!--
    FIXME: do not limit page width until content uses another representation
    format other than tables
    -->
    <style>.wy-nav-content { max-width: none; !important }</style>

.. dtcompatible:: nordic,nrf-uart
.. _dtbinding_nordic_nrf_uart:

nordic,nrf-uart
###############

Vendor: :ref:`Nordic Semiconductor <dt_vendor_nordic>`

Description
***********

These nodes are "uart" bus nodes.

.. code-block:: none

   Nordic nRF family UART.

   This is the binding for the peripheral without EasyDMA support.
   See the "nordic,nrf-uarte" binding for UARTE, i.e. UART with
   EasyDMA.

Properties
**********

.. tabs::

   .. group-tab:: Node specific properties

      Properties not inherited from the base binding file.

      .. list-table::
         :widths: 1 1 4
         :header-rows: 1

         * - Name
           - Type
           - Details

         * - ``disable-rx``
           - ``boolean``
           - .. code-block:: none

                Disable UART reception capabilities (only required to disable reception
                if CONFIG_PINCTRL is enabled).



         * - ``current-speed``
           - ``int``
           - .. code-block:: none

                Initial baud rate setting for UART. Only a fixed set of baud
                rates are selectable on these devices.



             Legal values: ``1200``, ``2400``, ``4800``, ``9600``, ``14400``, ``19200``, ``28800``, ``31250``, ``38400``, ``56000``, ``57600``, ``76800``, ``115200``, ``230400``, ``250000``, ``460800``, ``921600``, ``1000000``

         * - ``tx-pin``
           - ``int``
           - .. code-block:: none

                IMPORTANT: This option will only be used if the new pin control driver
                is not enabled. It will be deprecated in the future.

                The TX pin to use.

                For pins P0.0 through P0.31, use the pin number. For example,
                to use P0.16 for TX, set:

                  tx-pin = <16>;

                For pins P1.0 through P1.31, add 32 to the pin number. For
                example, to use P1.2 for TX, set:

                  tx-pin = <34>;  /* 32 + 2 */



         * - ``rx-pin``
           - ``int``
           - .. code-block:: none

                IMPORTANT: This option will only be used if the new pin control driver
                is not enabled. It will be deprecated in the future.

                The RX pin to use. The pin numbering scheme is the same as the
                tx-pin property's.



         * - ``rts-pin``
           - ``int``
           - .. code-block:: none

                IMPORTANT: This option will only be used if the new pin control driver
                is not enabled. It will be deprecated in the future.

                The RTS pin to use. The pin numbering scheme is the same as the
                tx-pin property's.



         * - ``cts-pin``
           - ``int``
           - .. code-block:: none

                IMPORTANT: This option will only be used if the new pin control driver
                is not enabled. It will be deprecated in the future.

                The CTS pin to use. The pin numbering scheme is the same as the
                tx-pin property's.



         * - ``rx-pull-up``
           - ``boolean``
           - .. code-block:: none

                IMPORTANT: This option will only be used if the new pin control driver
                is not enabled. It will be deprecated in the future.

                Enable pull-up resistor on the RX pin.



         * - ``cts-pull-up``
           - ``boolean``
           - .. code-block:: none

                IMPORTANT: This option will only be used if the new pin control driver
                is not enabled. It will be deprecated in the future.

                Enable pull-up resistor on the CTS pin.



         * - ``clock-frequency``
           - ``int``
           - .. code-block:: none

                Clock frequency information for UART operation


         * - ``hw-flow-control``
           - ``boolean``
           - .. code-block:: none

                Set to enable RTS/CTS flow control at boot time


         * - ``parity``
           - ``string``
           - .. code-block:: none

                Configures the parity of the adapter. Enumeration id 0 for none, 1 for odd
                and 2 for even parity. Default to none if not specified.



             Legal values: ``'none'``, ``'odd'``, ``'even'``

         * - ``pinctrl-0``
           - ``phandles``
           - .. code-block:: none

                Pin configuration/s for the first state. Content is specific to the
                selected pin controller driver implementation.



         * - ``pinctrl-1``
           - ``phandles``
           - .. code-block:: none

                Pin configuration/s for the second state. See pinctrl-0.



         * - ``pinctrl-2``
           - ``phandles``
           - .. code-block:: none

                Pin configuration/s for the third state. See pinctrl-0.



         * - ``pinctrl-3``
           - ``phandles``
           - .. code-block:: none

                Pin configuration/s for the fourth state. See pinctrl-0.



         * - ``pinctrl-4``
           - ``phandles``
           - .. code-block:: none

                Pin configuration/s for the fifth state. See pinctrl-0.



         * - ``pinctrl-names``
           - ``string-array``
           - .. code-block:: none

                Names for the provided states. The number of names needs to match the
                number of states.





   .. group-tab:: Deprecated node specific properties

      Deprecated properties not inherited from the base binding file.

      (None)

   .. group-tab:: Base properties

      Properties inherited from the base binding file, which defines
      common properties that may be set on many nodes. Not all of these
      may apply to the "nordic,nrf-uart" compatible.

      .. list-table::
         :widths: 1 1 4
         :header-rows: 1

         * - Name
           - Type
           - Details

         * - ``reg``
           - ``array``
           - .. code-block:: none

                register space


             This property is **required**.

             See :ref:`dt-important-props` for more information.

         * - ``interrupts``
           - ``array``
           - .. code-block:: none

                interrupts for device


             This property is **required**.

             See :ref:`dt-important-props` for more information.

         * - ``label``
           - ``string``
           - .. code-block:: none

                Human readable string describing the device (used as device_get_binding() argument)


             This property is **required**.

             See :ref:`dt-important-props` for more information.

         * - ``status``
           - ``string``
           - .. code-block:: none

                indicates the operational status of a device


             Legal values: ``'ok'``, ``'okay'``, ``'disabled'``, ``'reserved'``, ``'fail'``, ``'fail-sss'``

             See :ref:`dt-important-props` for more information.

         * - ``compatible``
           - ``string-array``
           - .. code-block:: none

                compatible strings


             This property is **required**.

             See :ref:`dt-important-props` for more information.

         * - ``reg-names``
           - ``string-array``
           - .. code-block:: none

                name of each register space


         * - ``interrupts-extended``
           - ``compound``
           - .. code-block:: none

                extended interrupt specifier for device


         * - ``interrupt-names``
           - ``string-array``
           - .. code-block:: none

                name of each interrupt


         * - ``interrupt-parent``
           - ``phandle``
           - .. code-block:: none

                phandle to interrupt controller node


         * - ``clocks``
           - ``phandle-array``
           - .. code-block:: none

                Clock gate information


         * - ``clock-names``
           - ``string-array``
           - .. code-block:: none

                name of each clock


         * - ``#address-cells``
           - ``int``
           - .. code-block:: none

                number of address cells in reg property


         * - ``#size-cells``
           - ``int``
           - .. code-block:: none

                number of size cells in reg property


         * - ``dmas``
           - ``phandle-array``
           - .. code-block:: none

                DMA channels specifiers


         * - ``dma-names``
           - ``string-array``
           - .. code-block:: none

                Provided names of DMA channel specifiers


         * - ``io-channels``
           - ``phandle-array``
           - .. code-block:: none

                IO channels specifiers


         * - ``io-channel-names``
           - ``string-array``
           - .. code-block:: none

                Provided names of IO channel specifiers


         * - ``mboxes``
           - ``phandle-array``
           - .. code-block:: none

                mailbox / IPM channels specifiers


         * - ``mbox-names``
           - ``string-array``
           - .. code-block:: none

                Provided names of mailbox / IPM channel specifiers


         * - ``wakeup-source``
           - ``boolean``
           - .. code-block:: none

                Property to identify that a device can be used as wake up source.

                When this property is provided a specific flag is set into the
                device that tells the system that the device is capable of
                wake up the system.

                Wake up capable devices are disabled (interruptions will not wake up
                the system) by default but they can be enabled at runtime if necessary.



         * - ``power-domain``
           - ``phandle``
           - .. code-block:: none


                Power domain the device belongs to.

                The device will be notified when the power domain it belongs to is either
                suspended or resumed.
```
