## latest/zephyr/_sources/reference/devicetree/bindings/sensor/bosch,bmp388-i2c.rst.txt
```
:orphan:

.. raw:: html

    <!--
    FIXME: do not limit page width until content uses another representation
    format other than tables
    -->
    <style>.wy-nav-content { max-width: none; !important }</style>


.. _dtbinding_bosch_bmp388_i2c:

bosch,bmp388 (on i2c bus)
#########################

Vendor: :ref:`Bosch Sensortec GmbH <dt_vendor_bosch>`

Description
***********



.. code-block:: none

   Bosch BMP388 pressure sensor accessed through I2C bus

Properties
**********

.. tabs::

   .. group-tab:: Node specific properties

      Properties not inherited from the base binding file.

      .. list-table::
         :widths: 1 1 4
         :header-rows: 1

         * - Name
           - Type
           - Details

         * - ``supply-gpios``
           - ``phandle-array``
           - .. code-block:: none

                GPIO specifier that controls power to the device.

                This property should be provided when the device has a dedicated
                switch that controls power to the device.  The supply state is
                entirely the responsibility of the device driver.

                Contrast with vin-supply.



         * - ``vin-supply``
           - ``phandle``
           - .. code-block:: none

                Reference to the regulator that controls power to the device.
                The referenced devicetree node must have a regulator compatible.

                This property should be provided when device power is supplied
                by a shared regulator.  The supply state is dependent on the
                request status of all devices fed by the regulator.

                Contrast with supply-gpios.  If both properties are provided
                then the regulator must be requested before the supply GPIOS is
                set to an active state, and the supply GPIOS must be set to an
                inactive state before releasing the regulator.



         * - ``int-gpios``
           - ``phandle-array``
           - 

         * - ``odr``
           - ``string``
           - .. code-block:: none

                Default output data rate in Hz. Only the following values are allowed:
                  200   - 200     - 5ms  (default; chip reset value)
                  100   - 100     - 10ms
                  50    - 50      - 20ms
                  25    - 25      - 40ms
                  12.5  - 25/2    - 80ms
                  6.25  - 25/4    - 160ms
                  3.125 - 25/8    - 320ms
                  1.563 - 25/16   - 640ms
                  .781  - 25/32   - 1.28s
                  .391  - 25/64   - 2.56s
                  .195  - 25/128  - 5.12s
                  .098  - 25/256  - 10.24s
                  .049  - 25/512  - 20.48s
                  .024  - 25/1024 - 40.96s
                  .012  - 25/2048 - 81.92s
                  .006  - 25/4096 - 163.84s
                  .003  - 25/8192 - 327.68s



             Default value: ``200``

             Legal values: ``'200'``, ``'100'``, ``'50'``, ``'25'``, ``'12.5'``, ``'6.25'``, ``'3.125'``, ``'1.563'``, ``'.781'``, ``'.391'``, ``'.195'``, ``'.098'``, ``'.049'``, ``'.024'``, ``'.012'``, ``'.006'``, ``'.003'``

         * - ``osr-press``
           - ``int``
           - .. code-block:: none

                Default pressure oversampling rate. Only the following values are
                allowed:
                  1 sample, 16-bit, 2.64 Pa
                  2 samples, 17-bit, 1.32 Pa
                  4 samples, 18-bit, 0.66 Pa (default; chip reset value)
                  8 samples, 19-bit, 0.33 Pa
                  16 samples, 20-bit, 0.17 Pa
                  32 Samples, 21-bit, 0.085 Pa



             Default value: ``4``

             Legal values: ``1``, ``2``, ``4``, ``8``, ``16``, ``32``

         * - ``osr-temp``
           - ``int``
           - .. code-block:: none

                Default temperature oversampling rate. Only the following values are
                allowed:
                  1 sample, 16-bit, .0050 C (default; chip reset value)
                  2 samples, 17-bit, .0025 C
                  4 samples, 18-bit, .0012 C
                  8 samples, 19-bit, .0006 C
                  16 samples, 20-bit, .0003 C
                  32 Samples, 21-bit, .00015 C



             Default value: ``1``

             Legal values: ``1``, ``2``, ``4``, ``8``, ``16``, ``32``

         * - ``iir-filter``
           - ``int``
           - .. code-block:: none

                Default IIR filter coefficient. The default 0 is the chip reset value.



             Legal values: ``0``, ``1``, ``3``, ``7``, ``15``, ``31``, ``63``, ``127``



   .. group-tab:: Deprecated node specific properties

      Deprecated properties not inherited from the base binding file.

      (None)

   .. group-tab:: Base properties

      Properties inherited from the base binding file, which defines
      common properties that may be set on many nodes. Not all of these
      may apply to the "bosch,bmp388" compatible.

      .. list-table::
         :widths: 1 1 4
         :header-rows: 1

         * - Name
           - Type
           - Details

         * - ``reg``
           - ``array``
           - .. code-block:: none

                device address on i2c bus


             This property is **required**.

             See :ref:`dt-important-props` for more information.

         * - ``label``
           - ``string``
           - .. code-block:: none

                Human readable string describing the device (used as device_get_binding() argument)


             This property is **required**.

             See :ref:`dt-important-props` for more information.

         * - ``status``
           - ``string``
           - .. code-block:: none

                indicates the operational status of a device


             Legal values: ``'ok'``, ``'okay'``, ``'disabled'``, ``'reserved'``, ``'fail'``, ``'fail-sss'``

             See :ref:`dt-important-props` for more information.

         * - ``compatible``
           - ``string-array``
           - .. code-block:: none

                compatible strings


             This property is **required**.

             See :ref:`dt-important-props` for more information.

         * - ``reg-names``
           - ``string-array``
           - .. code-block:: none

                name of each register space


         * - ``interrupts``
           - ``array``
           - .. code-block:: none

                interrupts for device


             See :ref:`dt-important-props` for more information.

         * - ``interrupts-extended``
           - ``compound``
           - .. code-block:: none

                extended interrupt specifier for device


         * - ``interrupt-names``
           - ``string-array``
           - .. code-block:: none

                name of each interrupt


         * - ``interrupt-parent``
           - ``phandle``
           - .. code-block:: none

                phandle to interrupt controller node


         * - ``clocks``
           - ``phandle-array``
           - .. code-block:: none

                Clock gate information


         * - ``clock-names``
           - ``string-array``
           - .. code-block:: none

                name of each clock


         * - ``#address-cells``
           - ``int``
           - .. code-block:: none

                number of address cells in reg property


         * - ``#size-cells``
           - ``int``
           - .. code-block:: none

                number of size cells in reg property


         * - ``dmas``
           - ``phandle-array``
           - .. code-block:: none

                DMA channels specifiers


         * - ``dma-names``
           - ``string-array``
           - .. code-block:: none

                Provided names of DMA channel specifiers


         * - ``io-channels``
           - ``phandle-array``
           - .. code-block:: none

                IO channels specifiers


         * - ``io-channel-names``
           - ``string-array``
           - .. code-block:: none

                Provided names of IO channel specifiers


         * - ``mboxes``
           - ``phandle-array``
           - .. code-block:: none

                mailbox / IPM channels specifiers


         * - ``mbox-names``
           - ``string-array``
           - .. code-block:: none

                Provided names of mailbox / IPM channel specifiers


         * - ``wakeup-source``
           - ``boolean``
           - .. code-block:: none

                Property to identify that a device can be used as wake up source.

                When this property is provided a specific flag is set into the
                device that tells the system that the device is capable of
                wake up the system.

                Wake up capable devices are disabled (interruptions will not wake up
                the system) by default but they can be enabled at runtime if necessary.



         * - ``power-domain``
           - ``phandle``
           - .. code-block:: none


                Power domain the device belongs to.

                The device will be notified when the power domain it belongs to is either
                suspended or resumed.
```
